## packages/esp_bt_audio/examples/bt_audio/sdkconfig.defaults.esp32s31.classic
```kconfig
#
# Serial flasher config
#
CONFIG_ESPTOOLPY_FLASHFREQ_80M=y
CONFIG_ESPTOOLPY_FLASHFREQ="80m"

CONFIG_FLASHMODE_QIO=y
CONFIG_ESPTOOLPY_FLASHMODE_QIO=y

CONFIG_ESPTOOLPY_FLASHSIZE_16MB=y
CONFIG_ESPTOOLPY_FLASHSIZE="16MB"

#
# Partition Table
#
CONFIG_PARTITION_TABLE_CUSTOM=y
CONFIG_PARTITION_TABLE_CUSTOM_FILENAME="partitions_esp32s31.csv"
CONFIG_PARTITION_TABLE_FILENAME="partitions_esp32s31.csv"
CONFIG_PARTITION_TABLE_OFFSET=0xA000
# end of Partition Table

#
# Bluetooth
#
CONFIG_BT_ENABLED=y
CONFIG_BT_BLUEDROID_ENABLED=y
# CONFIG_BT_NIMBLE_ENABLED is not set
# CONFIG_BT_CONTROLLER_ONLY is not set
CONFIG_BT_CONTROLLER_ENABLED=y
# CONFIG_BT_CONTROLLER_DISABLED is not set
CONFIG_BTDM_CTRL_BR_EDR_MAX_SYNC_CONN=1
CONFIG_BT_ALLOCATION_FROM_SPIRAM_FIRST=y
CONFIG_BT_BLE_DYNAMIC_ENV_MEMORY=y

#
# Bluedroid Options
#
CONFIG_BT_CLASSIC_ENABLED=y
CONFIG_BT_ENC_KEY_SIZE_CTRL_VSC=y
# CONFIG_BT_ENC_KEY_SIZE_CTRL_NONE is not set
# CONFIG_BT_CLASSIC_BQB_ENABLED is not set
CONFIG_BT_A2DP_ENABLE=y
CONFIG_BT_A2DP_USE_EXTERNAL_CODEC=y
CONFIG_BT_A2DP_CODEC_AAC_ENABLED=y
CONFIG_BT_AVRCP_ENABLED=y

#
# AVRCP Features
#
CONFIG_BT_AVRCP_CT_COVER_ART_ENABLED=y
# end of AVRCP Features

CONFIG_BT_HFP_ENABLE=y
CONFIG_BT_HFP_CLIENT_ENABLE=y
CONFIG_BT_HFP_AG_ENABLE=y
# CONFIG_BT_HFP_AUDIO_DATA_PATH_PCM is not set
CONFIG_BT_HFP_AUDIO_DATA_PATH_HCI=y
CONFIG_BT_HFP_USE_EXTERNAL_CODEC=y
CONFIG_BT_PBAC_ENABLED=y
CONFIG_GMF_EXAMPLE_PBAP_PCE=y
# CONFIG_BT_BLE_ENABLED is not set
#
# Controller Options
#
CONFIG_BTDM_CTRL_MODE_BR_EDR_ONLY=y
# end of Bluetooth

#
# FreeRTOS
#
CONFIG_FREERTOS_HZ=1000
# end of Kernel

CONFIG_ESP_BT_AUDIO_GMF_IO_SUPPORT=y

CONFIG_SPIRAM=y
CONFIG_SPIRAM_XIP_FROM_PSRAM=y
CONFIG_SPIRAM_MALLOC_ALWAYSINTERNAL=0
CONFIG_SPIRAM_TRY_ALLOCATE_WIFI_LWIP=y
CONFIG_SPIRAM_ALLOW_BSS_SEG_EXTERNAL_MEMORY=y
CONFIG_SPIRAM_ALLOW_NOINIT_SEG_EXTERNAL_MEMORY=y

#
# LVGL (required when CONFIG_EXAMPLE_BT_UI_ENABLE=y)
#
CONFIG_LV_CONF_SKIP=y
CONFIG_LV_USE_CLIB_MALLOC=y
CONFIG_LV_COLOR_DEPTH_16=y
CONFIG_LV_COLOR_DEPTH=16
# CONFIG_LV_BUILD_EXAMPLES is not set
# CONFIG_LV_BUILD_DEMOS is not set
# CONFIG_LV_FONT_MONTSERRAT_14 is not set
CONFIG_LV_FONT_MONTSERRAT_28=y
CONFIG_LV_FONT_MONTSERRAT_32=y
CONFIG_LV_FONT_FMT_TXT_LARGE=y
CONFIG_LV_FONT_CUSTOM_DECLARE="LV_FONT_DECLARE(lv_font_notosanssc_regular_28)"
CONFIG_LV_FONT_DEFAULT_CUSTOM=y
CONFIG_LV_USE_LABEL=y
CONFIG_LV_USE_BUTTON=y
CONFIG_LV_USE_TABVIEW=y
CONFIG_LV_USE_LIST=y
CONFIG_LV_USE_CANVAS=y
CONFIG_LV_USE_IMAGE=y
CONFIG_LV_USE_FLEX=y
CONFIG_LV_USE_GRID=y
```

## packages/esp_capture/Kconfig
```kconfig
menu "Espressif Capture Configuration"
    config ESP_CAPTURE_ENABLE_AUDIO
        bool "Enable Audio Capture"
        default y

    config ESP_CAPTURE_ENABLE_VIDEO
        bool "Enable Video Capture"
        default y

    config ESP_CAPTURE_MAX_SINK_NUM
        int "Capture maximum sink number"
        default 3
        range 1 8

    config ESP_CAPTURE_ENABLE_VIDEO_OVERLAY
        bool "Enable Video Overlay for Capture"
        default y
        depends on ESP_CAPTURE_ENABLE_VIDEO

    config ESP_CAPTURE_ENABLE_VIDEO_DECODER
        bool "Enable Video Decoder for Capture"
        default n
        depends on ESP_CAPTURE_ENABLE_VIDEO

    config ESP_CAPTURE_VIDEO_DEC_OUT_POOL_SIZE
        int "Video decoder output pool frame count"
        default 2
        range 2 4
        depends on ESP_CAPTURE_ENABLE_VIDEO_DECODER
        help
            Number of decoded frames kept in the decoder output pool when
            full_speed_decode is enabled in esp_capture_cfg_t.
            Prefer 2 so decode can run ahead of encode without blocking.

    config ESP_CAPTURE_ENABLE_PERF_MON
        bool "Enable Performance Monitor for Capture"
        default n

    rsource "impl/capture_text_overlay/Kconfig"
endmenu
```

## packages/esp_player/Kconfig
```kconfig
menu "ESP Player"

    config ESP_PLAYER_ENABLE_AUDIO
        bool "Enable Audio Playback Path"
        default y
        help
            When disabled, the esp_player component is built without the audio decoder/render
            pipeline and without linking gmf_audio / esp_audio_render. Runtime APIs that
            require audio (e.g. esp_player_set_av_mask with ESP_PLAYER_MASK_AUDIO) return
            ESP_PLAYER_ERR_NOT_SUPPORT.

            Finer codec/container trimming remains in the dependent components (e.g.
            esp_audio_codec menuconfig), independent of this switch.

    config ESP_PLAYER_ENABLE_VIDEO
        bool "Enable Video Playback Path"
        default y
        help
            When disabled, the esp_player component is built without the video decoder/render
            pipeline and without linking gmf_video / esp_video_codec / esp_video_render.

    comment "At least one of the two options above must stay enabled for a usable player."

    menu "Input IO sources"
        config ESP_PLAYER_ENABLE_FILE_IO
            bool "Enable file:// input IO"
            default y
            help
                When disabled, file:// and bare VFS paths are rejected at esp_player_set_url()
                with ESP_PLAYER_ERR_INVALID_ARG.

        config ESP_PLAYER_ENABLE_HTTP_IO
            bool "Enable http(s):// input IO"
            default y
            help
                When disabled, http:// and https:// URLs (non-HLS) are rejected at
                esp_player_set_url() with ESP_PLAYER_ERR_INVALID_ARG.

        config ESP_PLAYER_ENABLE_HLS_IO
            bool "Enable HLS (.m3u8) input IO"
            default y
            select ESP_PLAYER_ENABLE_HTTP_IO
            help
                When enabled, also enables http(s):// input IO (HLS fetches segments over
                HTTP). When disabled, http(s) URLs ending with .m3u8 fall back to plain
                HTTP if HTTP IO is enabled; esp_hls_stream is not linked. fill:// /
                block:// URLs are unaffected.
    endmenu

endmenu
```

## packages/esp_player/examples/audio_player/sdkconfig.defaults
```kconfig
#
# Common defaults for the audio_player example
#

#
# Serial flasher config
#
CONFIG_ESPTOOLPY_BEFORE_RESET=y
CONFIG_ESPTOOLPY_FLASHFREQ_80M=y
CONFIG_ESPTOOLPY_FLASHSIZE_4MB=y

#
# Partition Table
#
CONFIG_PARTITION_TABLE_CUSTOM=y
CONFIG_PARTITION_TABLE_CUSTOM_FILENAME="partitions.csv"
CONFIG_PARTITION_TABLE_FILENAME="partitions.csv"
CONFIG_PARTITION_TABLE_OFFSET=0x8000
CONFIG_PARTITION_TABLE_MD5=y

#
# Compiler options
#
CONFIG_COMPILER_OPTIMIZATION_PERF=y

#
# SPI RAM
#
CONFIG_SPIRAM=y

#
# Main task / FreeRTOS
#
CONFIG_ESP_MAIN_TASK_STACK_SIZE=8192
CONFIG_ESP_TASK_WDT_EN=n
CONFIG_FREERTOS_HZ=1000
CONFIG_FREERTOS_ENABLE_BACKWARD_COMPATIBILITY=y
CONFIG_FREERTOS_TASK_CREATE_ALLOW_EXT_MEM=y

#
# FAT Filesystem support
#
CONFIG_FATFS_LFN_HEAP=y

#
# ESP Player: audio path only
#
CONFIG_ESP_PLAYER_ENABLE_AUDIO=y
CONFIG_ESP_PLAYER_ENABLE_VIDEO=n
CONFIG_ESP_PLAYER_ENABLE_FILE_IO=y
# CONFIG_ESP_PLAYER_ENABLE_HTTP_IO is not set
# CONFIG_ESP_PLAYER_ENABLE_HLS_IO is not set

#
# Extractor (esp_extractor): ES elementary stream only (naked .mp3 / .aac)
#
CONFIG_EXTRACTOR_CUSTOM_SUPPORT=n
CONFIG_AUDIO_ES_EXTRACTOR_SUPPORT=y
CONFIG_WAV_EXTRACTOR_SUPPORT=n
CONFIG_MP4_EXTRACTOR_SUPPORT=n
CONFIG_TS_EXTRACTOR_SUPPORT=n
CONFIG_OGG_EXTRACTOR_SUPPORT=n
CONFIG_AVI_EXTRACTOR_SUPPORT=n
CONFIG_CAF_EXTRACTOR_SUPPORT=n
CONFIG_FLV_EXTRACTOR_SUPPORT=n

#
# Audio decoder / encoder (esp_audio_codec): MP3 + AAC only
#
CONFIG_AUDIO_DECODER_MP3_SUPPORT=y
CONFIG_AUDIO_DECODER_AAC_SUPPORT=y
CONFIG_AUDIO_DECODER_G711_SUPPORT=n
CONFIG_AUDIO_DECODER_G722_SUPPORT=n
CONFIG_AUDIO_DECODER_AMRNB_SUPPORT=n
CONFIG_AUDIO_DECODER_AMRWB_SUPPORT=n
CONFIG_AUDIO_DECODER_FLAC_SUPPORT=n
CONFIG_AUDIO_DECODER_VORBIS_SUPPORT=n
CONFIG_AUDIO_DECODER_OPUS_SUPPORT=n
CONFIG_AUDIO_DECODER_ADPCM_SUPPORT=n
CONFIG_AUDIO_DECODER_ALAC_SUPPORT=n
CONFIG_AUDIO_DECODER_PCM_SUPPORT=n
CONFIG_AUDIO_DECODER_SBC_SUPPORT=n
CONFIG_AUDIO_DECODER_LC3_SUPPORT=n

CONFIG_AUDIO_SIMPLE_DEC_WAV_SUPPORT=n
CONFIG_AUDIO_SIMPLE_DEC_M4A_SUPPORT=n
CONFIG_AUDIO_SIMPLE_DEC_TS_SUPPORT=n
CONFIG_AUDIO_SIMPLE_DEC_OGG_SUPPORT=n

CONFIG_AUDIO_ENCODER_AAC_SUPPORT=n
CONFIG_AUDIO_ENCODER_G711_SUPPORT=n
CONFIG_AUDIO_ENCODER_G722_SUPPORT=n
CONFIG_AUDIO_ENCODER_AMRNB_SUPPORT=n
CONFIG_AUDIO_ENCODER_AMRWB_SUPPORT=n
CONFIG_AUDIO_ENCODER_OPUS_SUPPORT=n
CONFIG_AUDIO_ENCODER_ADPCM_SUPPORT=n
CONFIG_AUDIO_ENCODER_ALAC_SUPPORT=n
CONFIG_AUDIO_ENCODER_PCM_SUPPORT=n
CONFIG_AUDIO_ENCODER_SBC_SUPPORT=n
CONFIG_AUDIO_ENCODER_LC3_SUPPORT=n
```

## packages/esp_player/examples/video_player/sdkconfig.defaults.esp32s3
```kconfig
#
# ESP32-S3 target defaults
#
CONFIG_IDF_TARGET="esp32s3"
CONFIG_ESP_DEFAULT_CPU_FREQ_MHZ_240=y
CONFIG_ESP32S3_DATA_CACHE_LINE_64B=y
CONFIG_ESPTOOLPY_FLASHSIZE_8MB=y

#
# SPI RAM
#
CONFIG_SPIRAM_MODE_OCT=y
CONFIG_SPIRAM_SPEED_80M=y
CONFIG_SPIRAM_TRY_ALLOCATE_WIFI_LWIP=y
CONFIG_SPIRAM_MALLOC_ALWAYSINTERNAL=128
```

## packages/esp_player/test_apps/sdkconfig.defaults
```kconfig
# Common defaults for esp_player test
CONFIG_ESPTOOLPY_FLASHSIZE_16MB=y
CONFIG_PARTITION_TABLE_CUSTOM=y
CONFIG_PARTITION_TABLE_CUSTOM_FILENAME="partitions.csv"
CONFIG_PARTITION_TABLE_OFFSET=0x9000
CONFIG_COMPILER_OPTIMIZATION_PERF=y
CONFIG_SPIRAM=y
CONFIG_ESP_MAIN_TASK_STACK_SIZE=10240
CONFIG_ESP_TASK_WDT_EN=n
CONFIG_FATFS_LFN_HEAP=y
CONFIG_HEAP_TRACING_STANDALONE=y
CONFIG_FREERTOS_TASK_CREATE_ALLOW_EXT_MEM=y
CONFIG_ESP_HOSTED_SDIO_TX_Q_SIZE=10
CONFIG_ESP_HOSTED_SDIO_RX_Q_SIZE=10
CONFIG_ESP_PLAYER_ENABLE_AUDIO=y
CONFIG_ESP_PLAYER_ENABLE_VIDEO=y
CONFIG_ESP_PLAYER_ENABLE_FILE_IO=y
CONFIG_ESP_PLAYER_ENABLE_HTTP_IO=y
CONFIG_ESP_PLAYER_ENABLE_HLS_IO=y
# CONFIG_FREERTOS_IN_IRAM is not set
CONFIG_ESP_WIFI_IRAM_OPT=n
CONFIG_ESP_WIFI_RX_IRAM_OPT=n
# CONFIG_ESP_WIFI_EXTRA_IRAM_OPT is not set
# CONFIG_ESP_WIFI_SLP_IRAM_OPT is not set
# CONFIG_LWIP_IRAM_OPTIMIZATION is not set
# CONFIG_LWIP_EXTRA_IRAM_OPTIMIZATION is not set
CONFIG_RINGBUF_PLACE_FUNCTIONS_INTO_FLASH=y
CONFIG_RINGBUF_PLACE_ISR_FUNCTIONS_INTO_FLASH=y
# CONFIG_ESP_EVENT_POST_FROM_IRAM_ISR is not set
```

## packages/esp_player/test_apps/sdkconfig.defaults.esp32s3
```kconfig
# ESP32-S3 specific defaults for esp_player test
CONFIG_IDF_TARGET="esp32s3"
CONFIG_ESP32S3_DATA_CACHE_LINE_64B=y
CONFIG_ESPTOOLPY_FLASHSIZE_8MB=y
CONFIG_PARTITION_TABLE_CUSTOM=y
CONFIG_PARTITION_TABLE_CUSTOM_FILENAME="partitions.csv"
CONFIG_COMPILER_OPTIMIZATION_PERF=y
CONFIG_SPIRAM_MODE_OCT=y
CONFIG_SPIRAM_SPEED_80M=y
CONFIG_ESP_MAIN_TASK_STACK_SIZE=10240
CONFIG_ESP_INT_WDT_TIMEOUT_MS=2000
```

## packages/gmf_fft/Kconfig
```kconfig
menu "GMF FFT Configuration"

    config GMF_FFT_S31_USE_ASM
        bool "Use ESP32-S31 PIE assembly-optimized FFT"
        depends on IDF_TARGET_ESP32S31
        default n
        help
            Select the RISC-V PIE assembly implementation for ESP32-S31.
            Disable this option to use the portable C implementation.
            When PIE assembly is enabled, related *_process() calls must
            run on Core 1.

endmenu
```
