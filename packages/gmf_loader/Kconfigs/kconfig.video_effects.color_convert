## packages/gmf_loader/Kconfigs/kconfig.video_effects.color_convert
```kconfig
rsource "kconfig.fourcc"

config GMF_VIDEO_EFFECTS_INIT_COLOR_CONVERT
    bool "Initialize Video Color Convert"
    default n
    help
        Initialize the video color convert element
        This element converts between different color formats and spaces
        Features:
            - Support multiple input/output pixel formats
            - Support different color space standards (BT.601/709/2020)
            - Hardware accelerated conversion
        Common use cases:
            - Convert RGB to YUV for video encoding
            - Convert YUV to RGB for display
            - Change color space for different display standards

menu "Video Effects Color Convert Configuration"
    depends on GMF_VIDEO_EFFECTS_INIT_COLOR_CONVERT

    config GMF_VIDEO_EFFECTS_CC_INPUT_WIDTH
        int "Width of the Input Frame"
        default 320
        range 1 65536
        help
            The width resolution of the input frame for color conversion

    config GMF_VIDEO_EFFECTS_CC_INPUT_HEIGHT
        int "Height of the Input Frame"
        default 240
        range 1 65536
        help
            The height resolution of the input frame for color conversion

    choice
        prompt "Input Pixel Format"
        default GMF_VIDEO_EFFECTS_CC_INPUT_FMT_YUYV
        help
            Select input pixel format for color conversion

        config GMF_VIDEO_EFFECTS_CC_INPUT_FMT_GREY
            bool "GREY"
        config GMF_VIDEO_EFFECTS_CC_INPUT_FMT_I420
            bool "YUV420 (I420)"
        config GMF_VIDEO_EFFECTS_CC_INPUT_FMT_O_UYY_E_VYY
            bool "OUEV"
        config GMF_VIDEO_EFFECTS_CC_INPUT_FMT_RGB565_LE
            bool "RGB565 Little Endian"
        config GMF_VIDEO_EFFECTS_CC_INPUT_FMT_BGR565_LE
            bool "BGR565 Little Endian"
        config GMF_VIDEO_EFFECTS_CC_INPUT_FMT_RGB565_BE
            bool "RGB565 Big Endian"
        config GMF_VIDEO_EFFECTS_CC_INPUT_FMT_BGR565_BE
            bool "BGR565 Big Endian"
        config GMF_VIDEO_EFFECTS_CC_INPUT_FMT_YUYV
            bool "YUV422(order as YUYV)"
        config GMF_VIDEO_EFFECTS_CC_INPUT_FMT_UYVY
            bool "YUV422(order as UYVY)"
        config GMF_VIDEO_EFFECTS_CC_INPUT_FMT_RGB888
            bool "RGB888"
        config GMF_VIDEO_EFFECTS_CC_INPUT_FMT_BGR888
            bool "BGR888"
        config GMF_VIDEO_EFFECTS_CC_INPUT_FMT_YUV_PLANNER
            bool "YUV444 Planner (444P)"
        config GMF_VIDEO_EFFECTS_CC_INPUT_FMT_YUV_PACKET
            bool "YUV Packet (V308)"
        config GMF_VIDEO_EFFECTS_CC_INPUT_FMT_ARGB888
            bool "ARGB888 (AB24)"
        config GMF_VIDEO_EFFECTS_CC_INPUT_FMT_ABGR888
            bool "ABGR888 (AR24)"
    endchoice

    config GMF_VIDEO_EFFECTS_CC_INPUT_PIXEL_FORMAT
        hex
        help
            FourCC pixel format codes for input format
        default FOURCC_GREY     if GMF_VIDEO_EFFECTS_CC_INPUT_FMT_GREY
        default FOURCC_YUV420P  if GMF_VIDEO_EFFECTS_CC_INPUT_FMT_I420
        default FOURCC_OUYY_EVYY if GMF_VIDEO_EFFECTS_CC_INPUT_FMT_O_UYY_E_VYY
        default FOURCC_RGB16    if GMF_VIDEO_EFFECTS_CC_INPUT_FMT_RGB565_LE
        default FOURCC_BGR16    if GMF_VIDEO_EFFECTS_CC_INPUT_FMT_BGR565_LE
        default FOURCC_RGB16_BE if GMF_VIDEO_EFFECTS_CC_INPUT_FMT_RGB565_BE
        default FOURCC_BGR16_BE if GMF_VIDEO_EFFECTS_CC_INPUT_FMT_BGR565_BE
        default FOURCC_YUYV     if GMF_VIDEO_EFFECTS_CC_INPUT_FMT_YUYV
        default FOURCC_UYVY     if GMF_VIDEO_EFFECTS_CC_INPUT_FMT_UYVY
        default FOURCC_RGB24    if GMF_VIDEO_EFFECTS_CC_INPUT_FMT_RGB888
        default FOURCC_BGR24    if GMF_VIDEO_EFFECTS_CC_INPUT_FMT_BGR888
        default FOURCC_YUV444P  if GMF_VIDEO_EFFECTS_CC_INPUT_FMT_YUV_PLANNER
        default FOURCC_YUV      if GMF_VIDEO_EFFECTS_CC_INPUT_FMT_YUV_PACKET
        default FOURCC_ARGB32   if GMF_VIDEO_EFFECTS_CC_INPUT_FMT_ARGB888
        default FOURCC_ABGR32   if GMF_VIDEO_EFFECTS_CC_INPUT_FMT_ABGR888

    choice
        prompt "Output Pixel Format"
        default GMF_VIDEO_EFFECTS_CC_OUTPUT_FMT_RGB565_LE
        help
            Select output pixel format for color conversion
            Below table shows supported input and output format combinations:
            | Input Format                 | Supported Output Formats                                  |
            |----------------------------  |-----------------------------------------------------------|
            | RGB/BGR565_LE/BE  RGB/BGR888 | RGB565_LE/BGR/RGB565_LE/BE RGB/BGR888 YUV_PLANAR/PACKET YUYV/UYVY  O_UYY_E_VYY/I420   |                                               
            | ARGB/BGR888                  | RGB565_LE/BGR/RGB565_LE/BE RGB/BGR888 YUV_PLANAR O_UYY_E_VYY/I420    |
            | YUV_PACKET/UYVY/YUYV         | RGB565_LE/BGR/RGB565_LE/BE RGB/BGR888 O_UYY_E_VYY/I420     |
            | O_UYY_E_VYY/I420             | RGB565_LE/BGR/RGB565_LE/BE RGB/BGR888 O_UYY_E_VYY     |

        config GMF_VIDEO_EFFECTS_CC_OUTPUT_FMT_GREY
            bool "GREY"
        config GMF_VIDEO_EFFECTS_CC_OUTPUT_FMT_I420
            bool "YUV420 (I420)"
        config GMF_VIDEO_EFFECTS_CC_OUTPUT_FMT_O_UYY_E_VYY
            bool "OUEV"
        config GMF_VIDEO_EFFECTS_CC_OUTPUT_FMT_RGB565_LE
            bool "RGB565 Little Endian"
        config GMF_VIDEO_EFFECTS_CC_OUTPUT_FMT_BGR565_LE
            bool "BGR565 Little Endian"
        config GMF_VIDEO_EFFECTS_CC_OUTPUT_FMT_RGB565_BE
            bool "RGB565 Big Endian"
        config GMF_VIDEO_EFFECTS_CC_OUTPUT_FMT_BGR565_BE
            bool "BGR565 Big Endian"
        config GMF_VIDEO_EFFECTS_CC_OUTPUT_FMT_YUYV
            bool "YUV422(order as YUYV)"
        config GMF_VIDEO_EFFECTS_CC_OUTPUT_FMT_UYVY
            bool "YUV422(order as UYVY)"
        config GMF_VIDEO_EFFECTS_CC_OUTPUT_FMT_RGB888
            bool "RGB888"
        config GMF_VIDEO_EFFECTS_CC_OUTPUT_FMT_BGR888
            bool "BGR888"
        config GMF_VIDEO_EFFECTS_CC_OUTPUT_FMT_YUV_PLANNER
            bool "YUV444 Planner (444P)"
        config GMF_VIDEO_EFFECTS_CC_OUTPUT_FMT_YUV_PACKET
            bool "YUV Packet (V308)"
    endchoice

    config GMF_VIDEO_EFFECTS_CC_OUTPUT_PIXEL_FORMAT
        hex
        default FOURCC_GREY     if GMF_VIDEO_EFFECTS_CC_OUTPUT_FMT_GREY
        default FOURCC_YUV420P  if GMF_VIDEO_EFFECTS_CC_OUTPUT_FMT_I420
        default FOURCC_OUYY_EVYY if GMF_VIDEO_EFFECTS_CC_OUTPUT_FMT_O_UYY_E_VYY
        default FOURCC_RGB16    if GMF_VIDEO_EFFECTS_CC_OUTPUT_FMT_RGB565_LE
        default FOURCC_BGR16    if GMF_VIDEO_EFFECTS_CC_OUTPUT_FMT_BGR565_LE
        default FOURCC_RGB16_BE if GMF_VIDEO_EFFECTS_CC_OUTPUT_FMT_RGB565_BE
        default FOURCC_BGR16_BE if GMF_VIDEO_EFFECTS_CC_OUTPUT_FMT_BGR565_BE
        default FOURCC_YUYV     if GMF_VIDEO_EFFECTS_CC_OUTPUT_FMT_YUYV
        default FOURCC_UYVY     if GMF_VIDEO_EFFECTS_CC_OUTPUT_FMT_UYVY
        default FOURCC_RGB24    if GMF_VIDEO_EFFECTS_CC_OUTPUT_FMT_RGB888
        default FOURCC_BGR24    if GMF_VIDEO_EFFECTS_CC_OUTPUT_FMT_BGR888
        default FOURCC_YUV444P  if GMF_VIDEO_EFFECTS_CC_OUTPUT_FMT_YUV_PLANNER
        default FOURCC_YUV      if GMF_VIDEO_EFFECTS_CC_OUTPUT_FMT_YUV_PACKET

    choice
        prompt "Color Space Standard"
        default GMF_VIDEO_EFFECTS_CC_COLOR_SPACE_BT601
        help
            Select color space standard for conversion
                - BT.601: Standard for SDTV (Standard Definition TV)
                - BT.709: Standard for HDTV (High Definition TV)
                - BT.2020: Standard for UHDTV (Ultra High Definition TV)

        config GMF_VIDEO_EFFECTS_CC_COLOR_SPACE_BT601
            bool "BT.601 (SDTV)"
        config GMF_VIDEO_EFFECTS_CC_COLOR_SPACE_BT709
            bool "BT.709 (HDTV)"
        config GMF_VIDEO_EFFECTS_CC_COLOR_SPACE_BT2020
            bool "BT.2020 (UHDTV)"

    endchoice

    config GMF_VIDEO_EFFECTS_CC_COLOR_SPACE
        int
        default 0 if GMF_VIDEO_EFFECTS_CC_COLOR_SPACE_BT601    # ESP_IMGFX_COLOR_SPACE_STD_BT601
        default 1 if GMF_VIDEO_EFFECTS_CC_COLOR_SPACE_BT709    # ESP_IMGFX_COLOR_SPACE_STD_BT709
        default 2 if GMF_VIDEO_EFFECTS_CC_COLOR_SPACE_BT2020   # ESP_IMGFX_COLOR_SPACE_STD_BT2020

endmenu
```

## packages/gmf_loader/test_apps/sdkconfig.defaults
```kconfig
# General options for additional checks
CONFIG_BOOTLOADER_LOG_LEVEL_WARN=y
CONFIG_FREERTOS_WATCHPOINT_END_OF_STACK=y
CONFIG_COMPILER_STACK_CHECK_MODE_STRONG=y
CONFIG_COMPILER_STACK_CHECK=y

CONFIG_ESPTOOLPY_FLASHFREQ_80M=y
CONFIG_ESPTOOLPY_FLASHFREQ="80m"
CONFIG_ESPTOOLPY_FLASHSIZE_8MB=y
CONFIG_ESPTOOLPY_FLASHSIZE="8MB"

#
# Partition Table
#
CONFIG_PARTITION_TABLE_CUSTOM=y
CONFIG_PARTITION_TABLE_CUSTOM_FILENAME="partitions.csv"
CONFIG_PARTITION_TABLE_FILENAME="partitions.csv"
CONFIG_PARTITION_TABLE_OFFSET=0x8000
CONFIG_PARTITION_TABLE_MD5=y
# end of Partition Table

# disable task watchdog since this app uses an interactive menu
CONFIG_ESP_TASK_WDT_INIT=n

# some tests verify file name encoding
CONFIG_FATFS_LFN_HEAP=y
CONFIG_FATFS_API_ENCODING_UTF_8=y
CONFIG_FATFS_CODEPAGE_936=y

CONFIG_ESP_GDBSTUB_ENABLED=y

CONFIG_FREERTOS_HZ=1000
CONFIG_COMPILER_OPTIMIZATION_PERF=y

CONFIG_SPIRAM=y

CONFIG_LOG_DEFAULT_LEVEL_DEBUG=y
CONFIG_LOG_DEFAULT_LEVEL=4
CONFIG_UNITY_ENABLE_64BIT=y

#
# GMF Video Configurations
#

#
# GMF Video Effects
#
CONFIG_GMF_VIDEO_EFFECTS_INIT_PPA=y
CONFIG_GMF_VIDEO_EFFECTS_INIT_FPS_CONVERT=y
CONFIG_GMF_VIDEO_EFFECTS_INIT_OVERLAY=y
CONFIG_GMF_VIDEO_EFFECTS_INIT_COLOR_CONVERT=y

#
# Video effects color convert Configuration
#
CONFIG_GMF_VIDEO_EFFECTS_CC_INPUT_WIDTH=320
CONFIG_GMF_VIDEO_EFFECTS_CC_INPUT_HEIGHT=240
CONFIG_GMF_VIDEO_EFFECTS_CC_INPUT_FMT_GREY=y
CONFIG_GMF_VIDEO_EFFECTS_CC_INPUT_PIXEL_FORMAT=0x59455247
CONFIG_GMF_VIDEO_EFFECTS_CC_OUTPUT_FMT_RGB565_LE=y
CONFIG_GMF_VIDEO_EFFECTS_CC_OUTPUT_PIXEL_FORMAT=0x4C424752
CONFIG_GMF_VIDEO_EFFECTS_CC_COLOR_SPACE_BT601=y
CONFIG_GMF_VIDEO_EFFECTS_CC_COLOR_SPACE=0


CONFIG_GMF_VIDEO_EFFECTS_INIT_SCALE=y

#
# Video effects scale Configuration
#
CONFIG_GMF_VIDEO_EFFECTS_SCALE_INPUT_WIDTH=320
CONFIG_GMF_VIDEO_EFFECTS_SCALE_INPUT_HEIGHT=240
CONFIG_GMF_VIDEO_EFFECTS_SCALE_INPUT_FMT_RGB565_LE=y
CONFIG_GMF_VIDEO_EFFECTS_SCALE_INPUT_PIXEL_FORMAT=0x4C424752
CONFIG_GMF_VIDEO_EFFECTS_SCALE_OUTPUT_WIDTH=160
CONFIG_GMF_VIDEO_EFFECTS_SCALE_OUTPUT_HEIGHT=120
CONFIG_GMF_VIDEO_EFFECTS_SCALE_FILTER_DOWN_RESAMPLE=y
CONFIG_GMF_VIDEO_EFFECTS_SCALE_FILTER_TYPE=0


CONFIG_GMF_VIDEO_EFFECTS_INIT_CROP=y

#
# Video effects crop Configuration
#
CONFIG_GMF_VIDEO_EFFECTS_CROP_INPUT_WIDTH=320
CONFIG_GMF_VIDEO_EFFECTS_CROP_INPUT_HEIGHT=240
CONFIG_GMF_VIDEO_EFFECTS_CROP_INPUT_FMT_RGB565_LE=y
CONFIG_GMF_VIDEO_EFFECTS_CROP_INPUT_PIXEL_FORMAT=0x4C424752
CONFIG_GMF_VIDEO_EFFECTS_CROP_X_POS=0
CONFIG_GMF_VIDEO_EFFECTS_CROP_Y_POS=0
CONFIG_GMF_VIDEO_EFFECTS_CROP_OUTPUT_WIDTH=160
CONFIG_GMF_VIDEO_EFFECTS_CROP_OUTPUT_HEIGHT=120


CONFIG_GMF_VIDEO_EFFECTS_INIT_ROTATE=y

#
# Video effects rotate Configuration
#
CONFIG_GMF_VIDEO_EFFECTS_ROTATE_INPUT_WIDTH=320
CONFIG_GMF_VIDEO_EFFECTS_ROTATE_INPUT_HEIGHT=240
CONFIG_GMF_VIDEO_EFFECTS_ROTATE_INPUT_FMT_RGB565_LE=y
CONFIG_GMF_VIDEO_EFFECTS_ROTATE_INPUT_PIXEL_FORMAT=0x4C424752
CONFIG_GMF_VIDEO_EFFECTS_ROTATE_DEGREE=0

#
# Compiler options
#
CONFIG_COMPILER_OPTIMIZATION_PERF=y
CONFIG_COMPILER_OPTIMIZATION_ASSERTIONS_ENABLE=y
CONFIG_COMPILER_ASSERT_NDEBUG_EVALUATE=y
CONFIG_COMPILER_FLOAT_LIB_FROM_GCCLIB=y
CONFIG_COMPILER_OPTIMIZATION_ASSERTION_LEVEL=2
CONFIG_COMPILER_HIDE_PATHS_MACROS=y
CONFIG_COMPILER_STACK_CHECK_MODE_STRONG=y
CONFIG_COMPILER_STACK_CHECK=y
CONFIG_COMPILER_DISABLE_DEFAULT_ERRORS=y
CONFIG_COMPILER_RT_LIB_GCCLIB=y
CONFIG_COMPILER_RT_LIB_NAME="gcc"
CONFIG_COMPILER_ORPHAN_SECTIONS_WARNING=y
# end of Compiler options
```

## packages/gmf_loader/test_apps/sdkconfig.defaults.esp32
```kconfig
CONFIG_SR_WN_WN9_HILEXIN=y

CONFIG_ESP32_DEFAULT_CPU_FREQ_240=y

#
# Partition Table
#
CONFIG_PARTITION_TABLE_CUSTOM=y
CONFIG_PARTITION_TABLE_CUSTOM_FILENAME="partitions_esp32.csv"
CONFIG_PARTITION_TABLE_FILENAME="partitions_esp32.csv"
CONFIG_PARTITION_TABLE_OFFSET=0xA000
CONFIG_PARTITION_TABLE_MD5=y
# end of Partition Table
```

## packages/gmf_loader/test_apps/sdkconfig.defaults.esp32p4
```kconfig
# See gmf_core/test_apps/sdkconfig.defaults.esp32p4 for rationale: route console
# over USB-Serial-JTAG so pytest-embedded's writes to /dev/ttyACM0 reach the unity menu.
CONFIG_ESP_CONSOLE_USB_SERIAL_JTAG=y
CONFIG_ESP_CONSOLE_SECONDARY_NONE=y

#
# Chip revision
#
CONFIG_ESP32P4_SELECTS_REV_LESS_V3=n
CONFIG_ESP32P4_REV_MIN_301=y

#
# SPI RAM config
#
CONFIG_IDF_EXPERIMENTAL_FEATURES=y
CONFIG_SPIRAM_SPEED_250M=y
```

## packages/gmf_loader/test_apps/sdkconfig.defaults.esp32s31
```kconfig
CONFIG_IDF_CMAKE=y
CONFIG_IDF_TARGET_ARCH_XTENSA=y
CONFIG_IDF_TARGET="esp32s31"
CONFIG_IDF_TARGET_ESP32S31=y
CONFIG_IDF_FIRMWARE_CHIP_ID=0x0009

CONFIG_ESPTOOLPY_FLASHMODE_DIO=y
CONFIG_ESPTOOLPY_FLASHFREQ_80M=y
CONFIG_ESPTOOLPY_FLASHFREQ="80m"
CONFIG_ESPTOOLPY_FLASHSIZE_16MB=y
CONFIG_ESPTOOLPY_FLASHSIZE="16MB"

#
# Partition Table
#
CONFIG_PARTITION_TABLE_CUSTOM=y
CONFIG_PARTITION_TABLE_CUSTOM_FILENAME="partitions_16m.csv"
CONFIG_PARTITION_TABLE_FILENAME="partitions_16m.csv"
CONFIG_PARTITION_TABLE_OFFSET=0xA000
CONFIG_PARTITION_TABLE_MD5=y
# end of Partition Table

CONFIG_SPIRAM_SPEED_200M=y
CONFIG_SPIRAM_TRY_ALLOCATE_WIFI_LWIP=y
CONFIG_SPIRAM_ALLOW_STACK_EXTERNAL_MEMORY=y
CONFIG_SPIRAM_MALLOC_ALWAYSINTERNAL=1024
CONFIG_SPIRAM_MODE_OCT=y
```
