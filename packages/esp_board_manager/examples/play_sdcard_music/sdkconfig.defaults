## packages/esp_board_manager/examples/play_sdcard_music/sdkconfig.defaults
```kconfig
CONFIG_FREERTOS_ENABLE_BACKWARD_COMPATIBILITY=y

#
# Serial flasher config
#
CONFIG_ESPTOOLPY_BEFORE_RESET=y
CONFIG_ESPTOOLPY_FLASHSIZE_4MB=y
CONFIG_ESPTOOLPY_FLASHFREQ_80M=y
# end of Serial flasher config

#
# Partition Table
#
CONFIG_PARTITION_TABLE_SINGLE_APP=y
CONFIG_PARTITION_TABLE_CUSTOM=y
CONFIG_PARTITION_TABLE_CUSTOM_FILENAME="partitions.csv"
CONFIG_PARTITION_TABLE_FILENAME="partitions.csv"
CONFIG_PARTITION_TABLE_OFFSET=0x8000
CONFIG_PARTITION_TABLE_MD5=y
# end of Partition Table

CONFIG_COMPILER_OPTIMIZATION_PERF=y

CONFIG_FREERTOS_HZ=1000

CONFIG_SPIRAM=y
CONFIG_SPIRAM_SPEED_80M=y
CONFIG_SPIRAM_ALLOW_STACK_EXTERNAL_MEMORY=y
CONFIG_SPIRAM_MALLOC_ALWAYSINTERNAL=1024
CONFIG_SPIRAM_TYPE_AUTO=y

#
# FAT Filesystem support
#
CONFIG_FATFS_VOLUME_COUNT=2
CONFIG_FATFS_LFN_HEAP=y
CONFIG_FATFS_SECTOR_4096=y
CONFIG_FATFS_CODEPAGE_936=y
CONFIG_FATFS_CODEPAGE=936
CONFIG_FATFS_MAX_LFN=255
CONFIG_FATFS_API_ENCODING_UTF_8=y
CONFIG_FATFS_FS_LOCK=5
CONFIG_FATFS_TIMEOUT_MS=10000
CONFIG_FATFS_PER_FILE_CACHE=y
CONFIG_FATFS_VFS_FSTAT_BLKSIZE=0
```

## packages/esp_board_manager/examples/record_and_play/sdkconfig.defaults
```kconfig
CONFIG_FREERTOS_ENABLE_BACKWARD_COMPATIBILITY=y

#
# Serial flasher config
#
CONFIG_ESPTOOLPY_BEFORE_RESET=y
CONFIG_ESPTOOLPY_FLASHSIZE_4MB=y
CONFIG_ESPTOOLPY_FLASHFREQ_80M=y
# end of Serial flasher config

CONFIG_COMPILER_OPTIMIZATION_PERF=y

CONFIG_FREERTOS_HZ=1000

CONFIG_SPIRAM=y
CONFIG_SPIRAM_SPEED_80M=y
CONFIG_SPIRAM_ALLOW_STACK_EXTERNAL_MEMORY=y
CONFIG_SPIRAM_MALLOC_ALWAYSINTERNAL=1024
CONFIG_SPIRAM_TYPE_AUTO=y
```

## packages/esp_board_manager/gen_codes/Kconfig.in
```kconfig
menu "Peripheral Support"

config ESP_BOARD_PERIPH_ADC_SUPPORT
    bool "Peripheral 'adc' support"
    help
        Enable adc peripheral support.
        This option enables the adc peripheral driver.
        The driver is located at: peripherals/periph_adc

config ESP_BOARD_PERIPH_ANACMPR_SUPPORT
    bool "Peripheral 'anacmpr' support"
    help
        Enable anacmpr peripheral support.
        This option enables the anacmpr peripheral driver.
        The driver is located at: peripherals/periph_anacmpr

config ESP_BOARD_PERIPH_DAC_SUPPORT
    bool "Peripheral 'dac' support"
    help
        Enable dac peripheral support.
        This option enables the dac peripheral driver.
        The driver is located at: peripherals/periph_dac

config ESP_BOARD_PERIPH_DSI_SUPPORT
    bool "Peripheral 'dsi' support"
    help
        Enable dsi peripheral support.
        This option enables the dsi peripheral driver.
        The driver is located at: peripherals/periph_dsi

config ESP_BOARD_PERIPH_GPIO_SUPPORT
    bool "Peripheral 'gpio' support"
    help
        Enable gpio peripheral support.
        This option enables the gpio peripheral driver.
        The driver is located at: peripherals/periph_gpio

config ESP_BOARD_PERIPH_I2C_SUPPORT
    bool "Peripheral 'i2c' support"
    help
        Enable i2c peripheral support.
        This option enables the i2c peripheral driver.
        The driver is located at: peripherals/periph_i2c

config ESP_BOARD_PERIPH_I2S_SUPPORT
    bool "Peripheral 'i2s' support"
    help
        Enable i2s peripheral support.
        This option enables the i2s peripheral driver.
        The driver is located at: peripherals/periph_i2s

config ESP_BOARD_PERIPH_LDO_SUPPORT
    bool "Peripheral 'ldo' support"
    help
        Enable ldo peripheral support.
        This option enables the ldo peripheral driver.
        The driver is located at: peripherals/periph_ldo

config ESP_BOARD_PERIPH_LEDC_SUPPORT
    bool "Peripheral 'ledc' support"
    help
        Enable ledc peripheral support.
        This option enables the ledc peripheral driver.
        The driver is located at: peripherals/periph_ledc

config ESP_BOARD_PERIPH_MCPWM_SUPPORT
    bool "Peripheral 'mcpwm' support"
    help
        Enable mcpwm peripheral support.
        This option enables the mcpwm peripheral driver.
        The driver is located at: peripherals/periph_mcpwm

config ESP_BOARD_PERIPH_PCNT_SUPPORT
    bool "Peripheral 'pcnt' support"
    help
        Enable pcnt peripheral support.
        This option enables the pcnt peripheral driver.
        The driver is located at: peripherals/periph_pcnt

config ESP_BOARD_PERIPH_RMT_SUPPORT
    bool "Peripheral 'rmt' support"
    help
        Enable rmt peripheral support.
        This option enables the rmt peripheral driver.
        The driver is located at: peripherals/periph_rmt

config ESP_BOARD_PERIPH_SDM_SUPPORT
    bool "Peripheral 'sdm' support"
    help
        Enable sdm peripheral support.
        This option enables the sdm peripheral driver.
        The driver is located at: peripherals/periph_sdm

config ESP_BOARD_PERIPH_SPI_SUPPORT
    bool "Peripheral 'spi' support"
    help
        Enable spi peripheral support.
        This option enables the spi peripheral driver.
        The driver is located at: peripherals/periph_spi

config ESP_BOARD_PERIPH_UART_SUPPORT
    bool "Peripheral 'uart' support"
    help
        Enable uart peripheral support.
        This option enables the uart peripheral driver.
        The driver is located at: peripherals/periph_uart

endmenu

menu "Device Support"

config ESP_BOARD_DEV_AUDIO_CODEC_SUPPORT
    bool "Device 'audio_codec' support"
    help
        Enable audio_codec device support.
        This option enables the audio_codec device driver.
        The driver is located at: devices/dev_audio_codec

config ESP_BOARD_DEV_BUTTON_SUPPORT
    bool "Device 'button' support"
    help
        Enable button device support.
        This option enables the button device driver.
        The driver is located at: devices/dev_button

if ESP_BOARD_DEV_BUTTON_SUPPORT

    config ESP_BOARD_DEV_BUTTON_SUB_ADC_MULTI_SUPPORT
        bool "Device 'button' adc_multi sub-type support"
        help
            Enable button adc_multi sub-type support.
            This option enables the button adc_multi sub-type driver.

    config ESP_BOARD_DEV_BUTTON_SUB_ADC_SINGLE_SUPPORT
        bool "Device 'button' adc_single sub-type support"
        help
            Enable button adc_single sub-type support.
            This option enables the button adc_single sub-type driver.

    config ESP_BOARD_DEV_BUTTON_SUB_GPIO_SUPPORT
        bool "Device 'button' gpio sub-type support"
        help
            Enable button gpio sub-type support.
            This option enables the button gpio sub-type driver.

endif

config ESP_BOARD_DEV_CAMERA_SUPPORT
    bool "Device 'camera' support"
    help
        Enable camera device support.
        This option enables the camera device driver.
        The driver is located at: devices/dev_camera

if ESP_BOARD_DEV_CAMERA_SUPPORT

    config ESP_BOARD_DEV_CAMERA_SUB_CSI_SUPPORT
        bool "Device 'camera' csi sub-type support"
        help
            Enable camera csi sub-type support.
            This option enables the camera csi sub-type driver.

    config ESP_BOARD_DEV_CAMERA_SUB_DVP_SUPPORT
        bool "Device 'camera' dvp sub-type support"
        help
            Enable camera dvp sub-type support.
            This option enables the camera dvp sub-type driver.

    config ESP_BOARD_DEV_CAMERA_SUB_SPI_SUPPORT
        bool "Device 'camera' spi sub-type support"
        help
            Enable camera spi sub-type support.
            This option enables the camera spi sub-type driver.

endif

config ESP_BOARD_DEV_CUSTOM_SUPPORT
    bool "Device 'custom' support"
    help
        Enable custom device support.
        This option enables the custom device driver.
        The driver is located at: devices/dev_custom

config ESP_BOARD_DEV_DISPLAY_LCD_SUPPORT
    bool "Device 'display_lcd' support"
    help
        Enable display_lcd device support.
        This option enables the display_lcd device driver.
        The driver is located at: devices/dev_display_lcd

if ESP_BOARD_DEV_DISPLAY_LCD_SUPPORT

    config ESP_BOARD_DEV_DISPLAY_LCD_SUB_DSI_SUPPORT
        bool "Device 'display_lcd' dsi sub-type support"
        help
            Enable display_lcd dsi sub-type support.
            This option enables the display_lcd dsi sub-type driver.

    config ESP_BOARD_DEV_DISPLAY_LCD_SUB_PARLIO_SUPPORT
        bool "Device 'display_lcd' parlio sub-type support"
        help
            Enable display_lcd parlio sub-type support.
            This option enables the display_lcd parlio sub-type driver.

    config ESP_BOARD_DEV_DISPLAY_LCD_SUB_SPI_SUPPORT
        bool "Device 'display_lcd' spi sub-type support"
        help
            Enable display_lcd spi sub-type support.
            This option enables the display_lcd spi sub-type driver.

endif

config ESP_BOARD_DEV_FS_FAT_SUPPORT
    bool "Device 'fs_fat' support"
    help
        Enable fs_fat device support.
        This option enables the fs_fat device driver.
        The driver is located at: devices/dev_fs_fat

if ESP_BOARD_DEV_FS_FAT_SUPPORT

    config ESP_BOARD_DEV_FS_FAT_SUB_SDMMC_SUPPORT
        bool "Device 'fs_fat' sdmmc sub-type support"
        help
            Enable fs_fat sdmmc sub-type support.
            This option enables the fs_fat sdmmc sub-type driver.

    config ESP_BOARD_DEV_FS_FAT_SUB_SPI_SUPPORT
        bool "Device 'fs_fat' spi sub-type support"
        help
            Enable fs_fat spi sub-type support.
            This option enables the fs_fat spi sub-type driver.

endif

config ESP_BOARD_DEV_FS_SPIFFS_SUPPORT
    bool "Device 'fs_spiffs' support"
    help
        Enable fs_spiffs device support.
        This option enables the fs_spiffs device driver.
        The driver is located at: devices/dev_fs_spiffs

config ESP_BOARD_DEV_GPIO_CTRL_SUPPORT
    bool "Device 'gpio_ctrl' support"
    help
        Enable gpio_ctrl device support.
        This option enables the gpio_ctrl device driver.
        The driver is located at: devices/dev_gpio_ctrl

config ESP_BOARD_DEV_GPIO_EXPANDER_SUPPORT
    bool "Device 'gpio_expander' support"
    help
        Enable gpio_expander device support.
        This option enables the gpio_expander device driver.
        The driver is located at: devices/dev_gpio_expander

config ESP_BOARD_DEV_LCD_TOUCH_I2C_SUPPORT
    bool "Device 'lcd_touch_i2c' support"
    help
        Enable lcd_touch_i2c device support.
        This option enables the lcd_touch_i2c device driver.
        The driver is located at: devices/dev_lcd_touch_i2c

config ESP_BOARD_DEV_LEDC_CTRL_SUPPORT
    bool "Device 'ledc_ctrl' support"
    help
        Enable ledc_ctrl device support.
        This option enables the ledc_ctrl device driver.
        The driver is located at: devices/dev_ledc_ctrl

config ESP_BOARD_DEV_POWER_CTRL_SUPPORT
    bool "Device 'power_ctrl' support"
    help
        Enable power_ctrl device support.
        This option enables the power_ctrl device driver.
        The driver is located at: devices/dev_power_ctrl

if ESP_BOARD_DEV_POWER_CTRL_SUPPORT

    config ESP_BOARD_DEV_POWER_CTRL_SUB_GPIO_SUPPORT
        bool "Device 'power_ctrl' gpio sub-type support"
        help
            Enable power_ctrl gpio sub-type support.
            This option enables the power_ctrl gpio sub-type driver.

endif

endmenu
```

## packages/esp_board_manager/test_apps/components/board_customer/boards/esp32_s3_devkitc/sdkconfig.defaults.board
```kconfig
CONFIG_CODEC_ES8389_SUPPORT=n
CONFIG_CODEC_ES8374_SUPPORT=n
CONFIG_CODEC_ES8388_SUPPORT=n
CONFIG_CODEC_TAS5805M_SUPPORT=n
CONFIG_CODEC_ES7243_SUPPORT=n
CONFIG_CODEC_ES7243E_SUPPORT=n
CONFIG_CODEC_ES8156_SUPPORT=n
CONFIG_CODEC_AW88298_SUPPORT=n
CONFIG_CODEC_ES7210_SUPPORT=n

CONFIG_ESPTOOLPY_FLASHSIZE_32MB=y
CONFIG_ESPTOOLPY_FLASHSIZE="32MB"
CONFIG_SPIRAM_MODE_OCT=y
```

## packages/esp_board_manager/test_apps/sdkconfig.defaults.esp32s2
```kconfig
CONFIG_IDF_CMAKE=y
CONFIG_IDF_TARGET_ARCH_XTENSA=y
CONFIG_IDF_TARGET="esp32s2"
CONFIG_IDF_TARGET_ESP32S2=y
CONFIG_IDF_FIRMWARE_CHIP_ID=0x0002
```

## packages/esp_board_manager/test_apps/test_single_board/Kconfig
```kconfig
config BOARD_TEST_SINGLE_BOARD
    bool "Test Single Board"
    depends on SOC_ESP32S3
```

## packages/esp_bt_audio/examples/bt_audio/sdkconfig.defaults.esp32
```kconfig
#
# Bluetooth
#
CONFIG_BT_ENABLED=y
CONFIG_BT_BLUEDROID_ENABLED=y
# CONFIG_BT_NIMBLE_ENABLED is not set
# CONFIG_BT_CONTROLLER_ONLY is not set
CONFIG_BT_CONTROLLER_ENABLED=y
# CONFIG_BT_CONTROLLER_DISABLED is not set
CONFIG_BTDM_CTRL_BR_EDR_MAX_SYNC_CONN=1

#
# Bluedroid Options
#
CONFIG_BT_CLASSIC_ENABLED=y
CONFIG_BT_ENC_KEY_SIZE_CTRL_VSC=y
# CONFIG_BT_ENC_KEY_SIZE_CTRL_NONE is not set
# CONFIG_BT_CLASSIC_BQB_ENABLED is not set
CONFIG_BT_A2DP_ENABLE=y
CONFIG_BT_A2DP_USE_EXTERNAL_CODEC=y
CONFIG_BT_AVRCP_ENABLED=y

#
# AVRCP Features
#
CONFIG_BT_AVRCP_CT_COVER_ART_ENABLED=y
# end of AVRCP Features

CONFIG_BT_HFP_ENABLE=y
CONFIG_BT_HFP_CLIENT_ENABLE=y
CONFIG_BT_HFP_AG_ENABLE=y
# CONFIG_BT_HFP_AUDIO_DATA_PATH_PCM is not set
CONFIG_BT_HFP_AUDIO_DATA_PATH_HCI=y
CONFIG_BT_HFP_USE_EXTERNAL_CODEC=y
# CONFIG_BT_BLE_ENABLED is not set
#
# Controller Options
#
CONFIG_BTDM_CTRL_MODE_BR_EDR_ONLY=y
# end of Bluetooth

#
# ESP PSRAM
#
CONFIG_SPIRAM=y

#
# SPI RAM config
#
CONFIG_SPIRAM_MODE_QUAD=y
CONFIG_SPIRAM_TYPE_AUTO=y
CONFIG_SPIRAM_SPEED_80M=y
CONFIG_SPIRAM_SPEED=80
CONFIG_SPIRAM_BOOT_HW_INIT=y
CONFIG_SPIRAM_CACHE_WORKAROUND=y
# end of ESP PSRAM

#
# ESP System Settings
#
CONFIG_ESP_DEFAULT_CPU_FREQ_MHZ_240=y
CONFIG_ESP_DEFAULT_CPU_FREQ_MHZ=240
```
