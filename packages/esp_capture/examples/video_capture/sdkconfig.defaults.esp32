## packages/gmf_loader/Kconfigs/kconfig.audio_muxer
```kconfig
menu "GMF Audio Muxer"

    config GMF_AUDIO_MUXER_INIT
        bool "Initialize GMF Audio Muxer"
        default n
        help
            Initialize GMF audio muxer element

    choice
        prompt "Select Default GMF Audio Muxer Type for Element"
        default GMF_AUDIO_MUXER_DEFAULT_TYPE_TS
        depends on GMF_AUDIO_MUXER_INIT
        help
            Select the default muxer type for the initialized element.
            This is used when creating the default muxer element instance.
            Multiple muxers can be registered, but only one element instance is created by default.

        config GMF_AUDIO_MUXER_DEFAULT_TYPE_TS
            bool "TS Muxer"
            depends on ESP_MUXER_TS_SUPPORT
        config GMF_AUDIO_MUXER_DEFAULT_TYPE_MP4
            bool "MP4 Muxer"
            depends on ESP_MUXER_MP4_SUPPORT
        config GMF_AUDIO_MUXER_DEFAULT_TYPE_FLV
            bool "FLV Muxer"
            depends on ESP_MUXER_FLV_SUPPORT
        config GMF_AUDIO_MUXER_DEFAULT_TYPE_WAV
            bool "WAV Muxer"
            depends on ESP_MUXER_WAV_SUPPORT
        config GMF_AUDIO_MUXER_DEFAULT_TYPE_CAF
            bool "CAF Muxer"
            depends on ESP_MUXER_CAF_SUPPORT
        config GMF_AUDIO_MUXER_DEFAULT_TYPE_AVI
            bool "AVI Muxer"
            depends on ESP_MUXER_AVI_SUPPORT
        config GMF_AUDIO_MUXER_DEFAULT_TYPE_OGG
            bool "OGG Muxer"
            depends on ESP_MUXER_OGG_SUPPORT
    endchoice

    choice
        prompt "Select Default Audio Codec for Muxer"
        default GMF_AUDIO_MUXER_AUDIO_CODEC_AAC
        depends on GMF_AUDIO_MUXER_INIT
        help
            Select the default audio codec type for muxer

        config GMF_AUDIO_MUXER_AUDIO_CODEC_AAC
            bool "AAC"
            depends on GMF_AUDIO_MUXER_DEFAULT_TYPE_MP4 || \
                       GMF_AUDIO_MUXER_DEFAULT_TYPE_TS || \
                       GMF_AUDIO_MUXER_DEFAULT_TYPE_FLV || \
                       GMF_AUDIO_MUXER_DEFAULT_TYPE_WAV || \
                       GMF_AUDIO_MUXER_DEFAULT_TYPE_CAF || \
                       GMF_AUDIO_MUXER_DEFAULT_TYPE_AVI
        config GMF_AUDIO_MUXER_AUDIO_CODEC_PCM
            bool "PCM"
            depends on GMF_AUDIO_MUXER_DEFAULT_TYPE_MP4 || \
                       GMF_AUDIO_MUXER_DEFAULT_TYPE_FLV || \
                       GMF_AUDIO_MUXER_DEFAULT_TYPE_WAV || \
                       GMF_AUDIO_MUXER_DEFAULT_TYPE_CAF || \
                       GMF_AUDIO_MUXER_DEFAULT_TYPE_AVI
        config GMF_AUDIO_MUXER_AUDIO_CODEC_MP3
            bool "MP3"
            depends on GMF_AUDIO_MUXER_DEFAULT_TYPE_MP4 || \
                       GMF_AUDIO_MUXER_DEFAULT_TYPE_TS || \
                       GMF_AUDIO_MUXER_DEFAULT_TYPE_FLV || \
                       GMF_AUDIO_MUXER_DEFAULT_TYPE_WAV || \
                       GMF_AUDIO_MUXER_DEFAULT_TYPE_AVI
        config GMF_AUDIO_MUXER_AUDIO_CODEC_ADPCM
            bool "ADPCM"
            depends on GMF_AUDIO_MUXER_DEFAULT_TYPE_WAV || \
                       GMF_AUDIO_MUXER_DEFAULT_TYPE_CAF
        config GMF_AUDIO_MUXER_AUDIO_CODEC_G711A
            bool "G711A"
            depends on GMF_AUDIO_MUXER_DEFAULT_TYPE_WAV || \
                       GMF_AUDIO_MUXER_DEFAULT_TYPE_CAF
        config GMF_AUDIO_MUXER_AUDIO_CODEC_G711U
            bool "G711U"
            depends on GMF_AUDIO_MUXER_DEFAULT_TYPE_WAV || \
                       GMF_AUDIO_MUXER_DEFAULT_TYPE_CAF
        config GMF_AUDIO_MUXER_AUDIO_CODEC_AMR_NB
            bool "AMR-NB"
            depends on GMF_AUDIO_MUXER_DEFAULT_TYPE_WAV
        config GMF_AUDIO_MUXER_AUDIO_CODEC_AMR_WB
            bool "AMR-WB"
            depends on GMF_AUDIO_MUXER_DEFAULT_TYPE_WAV
        config GMF_AUDIO_MUXER_AUDIO_CODEC_ALAC
            bool "ALAC"
            depends on GMF_AUDIO_MUXER_DEFAULT_TYPE_MP4 || \
                       GMF_AUDIO_MUXER_DEFAULT_TYPE_CAF
        config GMF_AUDIO_MUXER_AUDIO_CODEC_OPUS
            bool "OPUS"
            depends on GMF_AUDIO_MUXER_DEFAULT_TYPE_OGG || \
                       GMF_AUDIO_MUXER_DEFAULT_TYPE_AVI
    endchoice

    choice
        prompt "Select Muxer Output Type"
        default GMF_AUDIO_MUXER_OUTPUT_TYPE_STREAMING
        depends on GMF_AUDIO_MUXER_INIT
        help
            Select the output type for muxer:
            - Streaming: data is output through databus (suitable for TS, FLV and WAV muxers)
            - File: data is written to file using file writer

        config GMF_AUDIO_MUXER_OUTPUT_TYPE_STREAMING
            bool "Streaming"
            help
                Streaming output mode, data is output through databus
                Only valid for TS, FLV and WAV muxers

        config GMF_AUDIO_MUXER_OUTPUT_TYPE_FILE
            bool "File"
            help
                File output mode, data is written to file using file writer

    endchoice

    config GMF_AUDIO_MUXER_SLICE_DURATION
        int "Muxer File Segment Duration (ms)"
        default 60000
        range 0 4294967295
        depends on GMF_AUDIO_MUXER_INIT
        help
            Set the muxer file segment duration in milliseconds.
            When set to 0, the default value will be used.
            This determines how long each file segment will be before creating a new segment.
            Valid range: 0-4294967295

endmenu
```

## packages/gmf_loader/Kconfigs/kconfig.io.reader
```kconfig
menu "GMF IO Reader"
    config GMF_IO_INIT_CODEC_DEV_RX
        bool "Initialize GMF CODEC Device Reader"
        default y
        help
            Initialize GMF codec device reader

        menu "CODEC Device Reader Configuration"
            depends on GMF_IO_INIT_CODEC_DEV_RX

            config GMF_IO_CODEC_DEV_RX_TASK_STACK
                int "CODEC Device Reader Task Stack Size"
                default 0
                range 0 16384
                help
                    Configure the task stack size for the GMF CODEC Device Reader.

            config GMF_IO_CODEC_DEV_RX_TASK_CORE
                int "CODEC Device Reader Task Core"
                default 0
                range 0 1
                help
                    Configure the core on which the GMF CODEC Device Reader task will run.

            config GMF_IO_CODEC_DEV_RX_TASK_PRIORITY
                int "CODEC Device Reader Task Priority"
                default 5
                range 1 10
                help
                    Configure the task priority for the GMF CODEC Device Reader.

            config GMF_IO_CODEC_DEV_RX_STACK_IN_EXT
                bool "CODEC Device Reader Stack in External Memory"
                default n
                help
                    Enable this option to allocate the CODEC Device Reader stack in external memory.

            config GMF_IO_CODEC_DEV_RX_IO_SIZE
                int "CODEC Device Reader IO Size"
                default 3072
                range 1024 20480
                help
                    Configure the size of the io for the GMF CODEC Device Reader.

            config GMF_IO_CODEC_DEV_RX_OUT_BUF_SIZE
                int "CODEC Device Reader Output Buffer Size"
                default 16384
                range 8192 65536
                help
                    Configure the size of the output buffer for the GMF CODEC Device Reader.

            config GMF_IO_CODEC_DEV_RX_SPEED_MONITOR
                bool "CODEC Device Reader Speed Monitor Enable"
                default n
                help
                    Configure the speed monitor enable for the GMF CODEC Device Reader.
        endmenu

    config GMF_IO_INIT_FILE_READER
        bool "Initialize GMF File Reader"
        default y
        help
            Initialize GMF File Reader

        menu "IO File Configuration"
            depends on GMF_IO_INIT_FILE_READER

            config GMF_IO_FILE_READ_CACHE_SIZE
                int "IO File Read Cache Size"
                default 2048
                range 0 65536
                help
                    Configure the buffer size for the GMF IO File Reader.
                    This setting affects the performance of file reading operations.
                    Larger buffer sizes may improve read performance but consume more memory.
                    If the SOC does not have the SOC_SDMMC_PSRAM_DMA_CAPABLE capability, internal memory will be used.

            config GMF_IO_FILE_READER_TASK_STACK
                int "File Reader Task Stack Size"
                default 0
                range 0 16384
                help
                    Configure the task stack size for the GMF File Reader.

            config GMF_IO_FILE_READER_TASK_CORE
                int "File Reader Task Core"
                default 0
                range 0 1
                help
                    Configure the core on which the GMF File Reader task will run.

            config GMF_IO_FILE_READER_TASK_PRIORITY
                int "File Reader Task Priority"
                default 5
                range 1 10
                help
                    Configure the task priority for the GMF File Reader.

            config GMF_IO_FILE_READER_STACK_IN_EXT
                bool "File Reader Stack in External Memory"
                default n
                help
                    Enable this option to allocate the File Reader stack in external memory.

            config GMF_IO_FILE_READER_IO_SIZE
                int "File Reader IO Size"
                default 3072
                range 1024 20480
                help
                    Configure the size of the io for the GMF File Reader.

            config GMF_IO_FILE_READER_OUT_BUF_SIZE
                int "File Reader Output Buffer Size"
                default 16384
                range 8192 65536
                help
                    Configure the size of the output buffer for the GMF File Reader.

            config GMF_IO_FILE_READER_SPEED_MONITOR
                bool "File Reader Speed Monitor Enable"
                default n
                help
                    Configure the speed monitor enable for the GMF File Reader.
        endmenu

    config GMF_IO_INIT_HTTP_READER
        bool "Initialize GMF HTTP Reader"
        default y
        help
            Initialize GMF HTTP Reader

        menu "HTTP Reader Configuration"
            depends on GMF_IO_INIT_HTTP_READER

            config GMF_IO_HTTP_READER_TASK_STACK
                int "HTTP Reader Task Stack Size"
                default 3072
                range 1024 16384
                help
                    Configure the task stack size for the GMF HTTP Reader.

            config GMF_IO_HTTP_READER_TASK_CORE
                int "HTTP Reader Task Core"
                default 0
                range 0 1
                help
                    Configure the core on which the GMF HTTP Reader task will run.

            config GMF_IO_HTTP_READER_TASK_PRIORITY
                int "HTTP Reader Task Priority"
                default 5
                range 1 10
                help
                    Configure the task priority for the GMF HTTP Reader.

            config GMF_IO_HTTP_READER_STACK_IN_EXT
                bool "HTTP Reader Stack in External Memory"
                default n
                help
                    Enable this option to allocate the HTTP Reader stack in external memory.

            config GMF_IO_HTTP_READER_IO_SIZE
                int "HTTP Reader IO Size"
                default 3072
                range 1024 20480
                help
                    Configure the size of the io for the GMF HTTP Reader.

            config GMF_IO_HTTP_READER_OUT_BUF_SIZE
                int "HTTP Reader Output Buffer Size"
                default 65536
                range 16384 1048576
                help
                    Configure the size of the output buffer for the GMF HTTP Reader.

            config GMF_IO_HTTP_READER_SPEED_MONITOR
                bool "HTTP Reader Speed Monitor Enable"
                default n
                help
                    Configure the speed monitor enable for the GMF HTTP Reader.

            config GMF_IO_HTTP_READER_CERT_PEM
                string "HTTP Reader SSL Certificate (PEM)"
                default ""
                help
                    Provide the SSL server certificate in PEM format for the GMF HTTP Reader.
        endmenu

    config GMF_IO_INIT_FLASH_READER
        bool "Initialize GMF Flash Reader"
        default y
        help
            Initialize GMF Flash Reader

        menu "Flash Reader Configuration"
            depends on GMF_IO_INIT_FLASH_READER

            config GMF_IO_FLASH_READER_SPEED_MONITOR
                bool "Flash Reader Speed Monitor Enable"
                default n
                help
                    Configure the speed monitor enable for the GMF Flash Reader.
        endmenu
endmenu
```
