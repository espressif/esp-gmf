## packages/gmf_loader/Kconfigs/kconfig.io.writer
```kconfig
menu "GMF IO Writer"
    config GMF_IO_INIT_CODEC_DEV_TX
        bool "Initialize GMF CODEC Device Writer"
        default y
        help
            Initialize GMF codec device writer

        menu "CODEC Device Writer Configuration"
            depends on GMF_IO_INIT_CODEC_DEV_TX

            config GMF_IO_CODEC_DEV_TX_TASK_STACK
                int "CODEC Device Writer Task Stack Size"
                default 0
                range 0 16384
                help
                    Configure the task stack size for the GMF CODEC Device Writer.

            config GMF_IO_CODEC_DEV_TX_TASK_CORE
                int "CODEC Device Writer Task Core"
                default 0
                range 0 1
                help
                    Configure the core on which the GMF CODEC Device Writer task will run.

            config GMF_IO_CODEC_DEV_TX_TASK_PRIORITY
                int "CODEC Device Writer Task Priority"
                default 5
                range 1 10
                help
                    Configure the task priority for the GMF CODEC Device Writer.

            config GMF_IO_CODEC_DEV_TX_STACK_IN_EXT
                bool "CODEC Device Writer Stack in External Memory"
                default n
                help
                    Enable this option to allocate the CODEC Device Writer stack in external memory.

            config GMF_IO_CODEC_DEV_TX_IO_SIZE
                int "CODEC Device Writer IO Size"
                default 3072
                range 1024 20480
                help
                    Configure the size of the io for the GMF CODEC Device Writer.

            config GMF_IO_CODEC_DEV_TX_OUT_BUF_SIZE
                int "CODEC Device Writer Output Buffer Size"
                default 16384
                range 8192 65536
                help
                    Configure the size of the output buffer for the GMF CODEC Device Writer.

            config GMF_IO_CODEC_DEV_TX_SPEED_MONITOR
                bool "CODEC Device Writer Speed Monitor Enable"
                default n
                help
                    Configure the speed monitor enable for the GMF CODEC Device Writer.
        endmenu

    config GMF_IO_INIT_FILE_WRITER
        bool "Initialize GMF File Writer"
        default y
        help
            Initialize GMF file writer

        menu "IO File Configuration"
            depends on GMF_IO_INIT_FILE_WRITER

            config GMF_IO_FILE_WRITE_CACHE_SIZE
                int "IO File Write Cache Size"
                default 4096
                range 0 65536
                help
                    Configure the buffer size for the GMF IO File Writer.
                    This setting affects the performance of file writing operations.
                    Larger buffer sizes may improve write performance but consume more memory.
                    If the SOC does not have the SOC_SDMMC_PSRAM_DMA_CAPABLE capability, internal memory will be used.

            config GMF_IO_FILE_WRITER_TASK_STACK
                int "File Writer Task Stack Size"
                default 0
                range 0 16384
                help
                    Configure the task stack size for the GMF File Writer.

            config GMF_IO_FILE_WRITER_TASK_CORE
                int "File Writer Task Core"
                default 0
                range 0 1
                help
                    Configure the core on which the GMF File Writer task will run.

            config GMF_IO_FILE_WRITER_TASK_PRIORITY
                int "File Writer Task Priority"
                default 5
                range 1 10
                help
                    Configure the task priority for the GMF File Writer.

            config GMF_IO_FILE_WRITER_STACK_IN_EXT
                bool "File Writer Stack in External Memory"
                default n
                help
                    Enable this option to allocate the File Writer stack in external memory.

            config GMF_IO_FILE_WRITER_IO_SIZE
                int "File Writer IO Size"
                default 3072
                range 1024 20480
                help
                    Configure the size of the io for the GMF File Writer.

            config GMF_IO_FILE_WRITER_OUT_BUF_SIZE
                int "File Writer Output Buffer Size"
                default 16384
                range 8192 65536
                help
                    Configure the size of the output buffer for the GMF File Writer.

            config GMF_IO_FILE_WRITER_SPEED_MONITOR
                bool "File Writer Speed Monitor Enable"
                default n
                help
                    Configure the speed monitor enable for the GMF File Writer.
        endmenu

    config GMF_IO_INIT_HTTP_WRITER
        bool "Initialize GMF HTTP Writer"
        default n
        help
            Initialize GMF HTTP Writer

        menu "HTTP Writer Configuration"
            depends on GMF_IO_INIT_HTTP_WRITER

            config GMF_IO_HTTP_WRITER_TASK_STACK
                int "HTTP Writer Task Stack Size"
                default 3072
                range 1024 16384
                help
                    Configure the task stack size for the GMF HTTP Writer.

            config GMF_IO_HTTP_WRITER_TASK_CORE
                int "HTTP Writer Task Core"
                default 0
                range 0 1
                help
                    Configure the core on which the GMF HTTP Writer task will run.

            config GMF_IO_HTTP_WRITER_TASK_PRIORITY
                int "HTTP Writer Task Priority"
                default 5
                range 1 10
                help
                    Configure the task priority for the GMF HTTP Writer.

            config GMF_IO_HTTP_WRITER_STACK_IN_EXT
                bool "HTTP Writer Stack in External Memory"
                default n
                help
                    Enable this option to allocate the HTTP Writer stack in external memory.

            config GMF_IO_HTTP_WRITER_IO_SIZE
                int "HTTP Writer IO Size"
                default 3072
                range 1024 20480
                help
                    Configure the size of the io for the GMF HTTP Writer.

            config GMF_IO_HTTP_WRITER_OUT_BUF_SIZE
                int "HTTP Writer Output Buffer Size"
                default 65536
                range 16384 1048576
                help
                    Configure the size of the output buffer for the GMF HTTP Writer.

            config GMF_IO_HTTP_WRITER_SPEED_MONITOR
                bool "HTTP Writer Speed Monitor Enable"
                default n
                help
                    Configure the speed monitor enable for the GMF HTTP Writer.

            config GMF_IO_HTTP_WRITER_CERT_PEM
                string "HTTP Writer SSL Certificate (PEM)"
                default ""
                help
                    Provide the SSL server certificate in PEM format for the GMF HTTP Writer.
        endmenu
endmenu
```

## packages/gmf_loader/Kconfigs/kconfig.video_codec.dec
```kconfig
rsource "kconfig.fourcc"

config GMF_VIDEO_CODEC_INIT_DECODER
    bool "Initialize Video Decoder"
    default n
    help
        Initialize the video decoder element.

choice
    depends on GMF_VIDEO_CODEC_INIT_DECODER
    prompt "Video Decoder Configuration"
    default GMF_VIDEO_DEC_CODEC_TYPE_AUTO
    help
        Select the video decoder codec type.
        Please select the video decoder types to register in the "Video Decoder Configuration" menu under "Video Codec Configuration"

    config GMF_VIDEO_DEC_CODEC_TYPE_AUTO
        bool "Auto"
        help
            Auto select the video decoder codec type.

    config GMF_VIDEO_DEC_CODEC_TYPE_SW_H264
        bool "Software H264"
        depends on VIDEO_DECODER_SW_H264_SUPPORT
        help
            Software H264 video decoder.

    config GMF_VIDEO_DEC_CODEC_TYPE_SW_MJPEG
        bool "Software MJPEG"
        depends on VIDEO_DECODER_SW_MJPEG_SUPPORT
        help
            Software MJPEG video decoder.

    config GMF_VIDEO_DEC_CODEC_TYPE_HW_MJPEG
        bool "Hardware MJPEG"
        depends on VIDEO_DECODER_HW_MJPEG_SUPPORT
        help
            Hardware MJPEG video decoder.
endchoice

config GMF_VIDEO_DEC_CODEC_TYPE
    hex
    default 0x00000000 if GMF_VIDEO_DEC_CODEC_TYPE_AUTO
    default FOURCC_H264 if GMF_VIDEO_DEC_CODEC_TYPE_SW_H264
    default FOURCC_MJPG if GMF_VIDEO_DEC_CODEC_TYPE_SW_MJPEG
    default FOURCC_MJPG if GMF_VIDEO_DEC_CODEC_TYPE_HW_MJPEG
```

## packages/gmf_loader/Kconfigs/kconfig.video_codec.enc
```kconfig
rsource "kconfig.fourcc"

config GMF_VIDEO_CODEC_INIT_ENCODER
    bool "Initialize Video Encoder"
    default n
    help
        Initialize the video encoder element.

choice
    depends on GMF_VIDEO_CODEC_INIT_ENCODER
    prompt "Video Encoder Configuration"
    default GMF_VIDEO_ENC_CODEC_TYPE_AUTO
    help
        Select the video encoder codec type.
        Please select the video encoder types to register in the "Video Encoder Configuration" menu under "Video Codec Configuration"

    config GMF_VIDEO_ENC_CODEC_TYPE_AUTO
        bool "Auto"
        help
            Auto select the video encoder codec type.

    config GMF_VIDEO_ENC_CODEC_TYPE_SW_H264
        bool "Software H264"
        depends on VIDEO_ENCODER_SW_H264_SUPPORT
        help
            Software H264 video encoder.

    config GMF_VIDEO_ENC_CODEC_TYPE_HW_H264
        bool "Hardware H264"
        depends on VIDEO_ENCODER_HW_H264_SUPPORT
        help
            Hardware H264 video encoder.

    config GMF_VIDEO_ENC_CODEC_TYPE_SW_MJPEG
        bool "Software MJPEG"
        depends on VIDEO_ENCODER_SW_MJPEG_SUPPORT
        help
            Software MJPEG video encoder.

    config GMF_VIDEO_ENC_CODEC_TYPE_HW_MJPEG
        bool "Hardware MJPEG"
        depends on VIDEO_ENCODER_HW_MJPEG_SUPPORT
        help
            Hardware MJPEG video encoder.
endchoice

config GMF_VIDEO_ENC_CODEC_TYPE
    hex
    default 0x00000000 if GMF_VIDEO_ENC_CODEC_TYPE_AUTO
    default FOURCC_H264 if GMF_VIDEO_ENC_CODEC_TYPE_SW_H264
    default FOURCC_H264 if GMF_VIDEO_ENC_CODEC_TYPE_HW_H264
    default FOURCC_MJPG if GMF_VIDEO_ENC_CODEC_TYPE_SW_MJPEG
    default FOURCC_MJPG if GMF_VIDEO_ENC_CODEC_TYPE_HW_MJPEG
```

## packages/gmf_loader/Kconfigs/kconfig.video_effects
```kconfig
menu "GMF Video Effects"

    config GMF_VIDEO_EFFECTS_INIT_PPA
        bool "Initialize Video PPA"
        default n
        depends on IDF_TARGET_ESP32P4 || IDF_TARGET_ESP32S31
        help
            Initialize the video PPA element
            This feature is available on ESP32-P4 and ESP32-S31

    config GMF_VIDEO_EFFECTS_INIT_FPS_CONVERT
        bool "Initialize Video FPS Convert"
        default n
        help
            Initialize the video FPS convert element

    config GMF_VIDEO_EFFECTS_INIT_OVERLAY
        bool "Initialize Video Overlay"
        default n
        help
            Initialize the video overlay element

    rsource "kconfig.video_effects.color_convert"
    rsource "kconfig.video_effects.scale"
    rsource "kconfig.video_effects.crop"
    rsource "kconfig.video_effects.rotate"

endmenu
```
