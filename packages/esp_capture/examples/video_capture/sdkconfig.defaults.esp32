## packages/esp_capture/examples/video_capture/sdkconfig.defaults.esp32s3
```kconfig
CONFIG_ESPTOOLPY_FLASHFREQ_120M=y
CONFIG_ESPTOOLPY_FLASHSIZE_4MB=y

CONFIG_SPIRAM_MODE_OCT=y
CONFIG_SPIRAM_SPEED_120M=y
CONFIG_ESP32S3_SPIRAM_SUPPORT=y

# Wifi static buffer refine
CONFIG_ESP_WIFI_STATIC_RX_BUFFER_NUM=8
CONFIG_ESP_WIFI_STATIC_TX_BUFFER_NUM=8
CONFIG_ESP_WIFI_DYNAMIC_RX_MGMT_BUFFER=y
CONFIG_ESP_WIFI_IRAM_OPT=n
CONFIG_ESP_WIFI_RX_IRAM_OPT=n

CONFIG_COMPILER_OPTIMIZATION_PERF=y

CONFIG_ESP_DEFAULT_CPU_FREQ_MHZ_240=y
CONFIG_ESP32S3_INSTRUCTION_CACHE_32KB=y
CONFIG_ESP32S3_DATA_CACHE_64KB=y
CONFIG_ESP32S3_DATA_CACHE_LINE_64B=y

CONFIG_FLASHMODE_QIO=y
CONFIG_ESPTOOLPY_FLASHMODE_QIO=y

CONFIG_SPIRAM_MALLOC_ALWAYSINTERNAL=128
CONFIG_SPIRAM_TRY_ALLOCATE_WIFI_LWIP=y
CONFIG_MBEDTLS_EXTERNAL_MEM_ALLOC=y
CONFIG_SPIRAM_MALLOC_RESERVE_INTERNAL=16384

CONFIG_ESP_ALLOW_BSS_SEG_EXTERNAL_MEMORY=y
CONFIG_SPIRAM_ALLOW_BSS_SEG_EXTERNAL_MEMORY=y
CONFIG_CAMERA_TASK_STACK_SIZE=4096
CONFIG_OV7670_SUPPORT=n
CONFIG_OV7725_SUPPORT=n
CONFIG_NT99141_SUPPORT=n
CONFIG_OV7725_SUPPORT=n
CONFIG_NT99141_SUPPORT=n
CONFIG_OV5640_SUPPORT=n
CONFIG_GC2145_SUPPORT=n
CONFIG_GC032A_SUPPORT=n
# change following is not set to =n
CONFIG_GC0308_SUPPORT=n
CONFIG_BF3005_SUPPORT=n
CONFIG_BF20A6_SUPPORT=n
CONFIG_SC101IOT_SUPPORT=n
CONFIG_SC030IOT_SUPPORT=n
CONFIG_SC031GS_SUPPORT=n
CONFIG_MEGA_CCM_SUPPORT=n

CONFIG_AUDIO_DECODER_AAC_SUPPORT=n
CONFIG_AUDIO_DECODER_MP3_SUPPORT=n
CONFIG_AUDIO_DECODER_AMRNB_SUPPORT=n
CONFIG_AUDIO_DECODER_AMRWB_SUPPORT=n
CONFIG_AUDIO_DECODER_FLAC_SUPPORT=n
CONFIG_AUDIO_DECODER_VORBIS_SUPPORT=n
CONFIG_AUDIO_DECODER_ADPCM_SUPPORT=n
CONFIG_AUDIO_DECODER_ALAC_SUPPORT=n
CONFIG_AUDIO_DECODER_PCM_SUPPORT=n

CONFIG_AUDIO_SIMPLE_DEC_WAV_SUPPORT=n
CONFIG_AUDIO_SIMPLE_DEC_M4A_SUPPORT=n
CONFIG_AUDIO_SIMPLE_DEC_TS_SUPPORT=n

CONFIG_AUDIO_ENCODER_AMRNB_SUPPORT=n
CONFIG_AUDIO_ENCODER_AMRWB_SUPPORT=n
CONFIG_AUDIO_ENCODER_ADPCM_SUPPORT=n
CONFIG_AUDIO_ENCODER_ALAC_SUPPORT=n
CONFIG_AUDIO_ENCODER_PCM_SUPPORT=n

CONFIG_VIDEO_DECODER_SW_H264_SUPPORT=n
CONFIG_VIDEO_DECODER_SW_MJPEG_SUPPORT=n

## Camera support
CONFIG_CAMERA_OV3660=y
CONFIG_CAMERA_OV3660_DVP_RGB565_640X480_10FPS=y
```

## packages/esp_capture/test_apps/sdkconfig.defaults
```kconfig
# Enable SPIRAM
CONFIG_SPIRAM=y

# Enable GDBStub
CONFIG_ESP_SYSTEM_PANIC_GDBSTUB=y

# Enable FreeRTOS trace
CONFIG_FREERTOS_USE_TRACE_FACILITY=y
CONFIG_FREERTOS_VTASKLIST_INCLUDE_COREID=y
CONFIG_FREERTOS_GENERATE_RUN_TIME_STATS=y
CONFIG_FREERTOS_HZ=1000

# Enable experimental features
CONFIG_IDF_EXPERIMENTAL_FEATURES=y

# Use customer partition table
CONFIG_PARTITION_TABLE_CUSTOM=y

#
# Compiler options
#
CONFIG_COMPILER_OPTIMIZATION_PERF=y

#
# ESP WDT CONFIG
#
# CONFIG_TASK_WDT_PANIC is not set
CONFIG_ESP_TASK_WDT_EN=n
CONFIG_ESP_INT_WDT=n

#
# Capture
#
CONFIG_ESP_CAPTURE_ENABLE_PERF_MON=y

#
# Heap Tracing
#
CONFIG_HEAP_TRACING_STANDALONE=y
CONFIG_HEAP_TRACING=y
CONFIG_HEAP_TRACING_STACK_DEPTH=6

#
# UT setting
#
CONFIG_UNITY_HEAP_TRACE_RECORDS=1000
```

## packages/esp_capture/test_apps/sdkconfig.defaults.esp32s31
```kconfig
CONFIG_ESPTOOLPY_FLASHSIZE_4MB=y

CONFIG_COMPILER_OPTIMIZATION_PERF=y

CONFIG_CAMERA_TASK_STACK_SIZE=4096

CONFIG_AUDIO_DECODER_AAC_SUPPORT=n
CONFIG_AUDIO_DECODER_MP3_SUPPORT=n
CONFIG_AUDIO_DECODER_AMRNB_SUPPORT=n
CONFIG_AUDIO_DECODER_AMRWB_SUPPORT=n
CONFIG_AUDIO_DECODER_FLAC_SUPPORT=n
CONFIG_AUDIO_DECODER_VORBIS_SUPPORT=n
CONFIG_AUDIO_DECODER_ADPCM_SUPPORT=n
CONFIG_AUDIO_DECODER_ALAC_SUPPORT=n
CONFIG_AUDIO_DECODER_PCM_SUPPORT=n

CONFIG_AUDIO_SIMPLE_DEC_WAV_SUPPORT=n
CONFIG_AUDIO_SIMPLE_DEC_M4A_SUPPORT=n
CONFIG_AUDIO_SIMPLE_DEC_TS_SUPPORT=n

CONFIG_AUDIO_ENCODER_AMRNB_SUPPORT=n
CONFIG_AUDIO_ENCODER_AMRWB_SUPPORT=n
CONFIG_AUDIO_ENCODER_ADPCM_SUPPORT=n
CONFIG_AUDIO_ENCODER_ALAC_SUPPORT=n
CONFIG_AUDIO_ENCODER_PCM_SUPPORT=n

CONFIG_VIDEO_DECODER_SW_H264_SUPPORT=y
CONFIG_VIDEO_DECODER_SW_MJPEG_SUPPORT=y
```

## packages/esp_video_render/Kconfig
```kconfig
menu "Video Render Configuration"
    config ESP_VIDEO_RENDER_LVGL_BACKEND_SUPPORT
        bool "Video render LVGL backend support"
        default n
     config ESP_VIDEO_RENDER_WIDGET_SUPPORT
        bool "Video render widget support"
        default y
     config ESP_VIDEO_RENDER_TEXT_WIDGET_SUPPORT
        bool "Video render text widget support"
        depends on ESP_VIDEO_RENDER_WIDGET_SUPPORT
        default n

    config ESP_VIDEO_RENDER_BLEND_THREAD_STACK_SIZE
        int "Video render blend thread stack size"
        default 20480

    config ESP_VIDEO_RENDER_BLEND_THREAD_CORE_ID
        int "Video render blend thread core id"
        default 0

    config ESP_VIDEO_RENDER_BLEND_THREAD_PRIORITY
        int "Video render blend thread priority"
        default 8

    config VIDEO_RENDER_MEASURE_ENABLE
        bool "Video render measurement enable"
        default n
endmenu
```

## packages/esp_video_render/examples/dual_eyes/sdkconfig.defaults.esp32p4
```kconfig
# Flash setting
CONFIG_FLASHMODE_QIO=y

CONFIG_SPIRAM_SPEED_200M=y

# If you use serial JTAG turn on this option
CONFIG_ESP_CONSOLE_USB_SERIAL_JTAG=y

# Enable ISP pipelines
CONFIG_ESP_VIDEO_ENABLE_ISP_PIPELINE_CONTROLLER=y

# Set Slave target type
CONFIG_IDF_SLAVE_TARGET="esp32c6"
CONFIG_SLAVE_IDF_TARGET_ESP32C6=y
```

## packages/esp_video_render/examples/video_player/sdkconfig.defaults.esp32p4
```kconfig
# Flash setting
CONFIG_FLASHMODE_QIO=y

CONFIG_SPIRAM_SPEED_200M=y

# If you use serial JTAG turn on this option
CONFIG_ESP_CONSOLE_USB_SERIAL_JTAG=y

# Set Slave target type
CONFIG_IDF_SLAVE_TARGET="esp32c6"
CONFIG_SLAVE_IDF_TARGET_ESP32C6=y

# GMF app utils setting
CONFIG_CODEC_BOARD="ESP32_P4_DEV_V14"

# FatFS setting
CONFIG_FATFS_LFN_HEAP=y
```

## packages/esp_video_render/examples/video_render/sdkconfig.defaults
```kconfig
# Enable SPIRAM
CONFIG_SPIRAM=y

# Enable GDBStub
CONFIG_ESP_SYSTEM_PANIC_GDBSTUB=y

# Enable FreeRTOS trace
CONFIG_FREERTOS_USE_TRACE_FACILITY=y
CONFIG_FREERTOS_VTASKLIST_INCLUDE_COREID=y
CONFIG_FREERTOS_GENERATE_RUN_TIME_STATS=y
CONFIG_FREERTOS_HZ=1000

# Enable heap tracing
CONFIG_HEAP_TRACING=y
CONFIG_HEAP_TRACING_STACK_DEPTH=6

# Use new I2C master
CONFIG_CODEC_I2C_BACKWARD_COMPATIBLE=n

# Enable experimental features
CONFIG_IDF_EXPERIMENTAL_FEATURES=y

# Use customer partition table
CONFIG_PARTITION_TABLE_CUSTOM=y

#
# Compiler options
#
CONFIG_COMPILER_OPTIMIZATION_PERF=y

# FatFS setting
CONFIG_FATFS_LFN_HEAP=y

# Flash size setting
CONFIG_ESPTOOLPY_FLASHSIZE_4MB=y

#
# Video render setting
#
CONFIG_ESP_VIDEO_RENDER_LVGL_BACKEND_SUPPORT=y
CONFIG_ESP_VIDEO_RENDER_TEXT_WIDGET_SUPPORT=n
```

## packages/esp_video_render/test_apps/sdkconfig.defaults.esp32p4
```kconfig
# Flash setting
CONFIG_FLASHMODE_QIO=y

CONFIG_SPIRAM_SPEED_200M=y

# If you use serial JTAG turn on this option
CONFIG_ESP_CONSOLE_USB_SERIAL_JTAG=y
```

## packages/gmf_app_utils/Kconfig.projbuild
```kconfig
menu "GMF APP Configuration"

# Extra components for wifi configuration
source "${IDF_PATH}/examples/common_components/protocol_examples_common/Kconfig.projbuild"

menu "Unit Test"

    config UNITY_FREERTOS_PRIORITY
        int "Priority of Unity test task"
        default 5

    config UNITY_FREERTOS_CPU
        int "CPU to run Unity test task on"
        default 0

    config UNITY_FREERTOS_STACK_SIZE
        int "Stack size of Unity test task, in bytes"
        default 8192

    config UNITY_WARN_LEAK_LEVEL_GENERAL
        int "Leak warning level"
        default 255

    config UNITY_CRITICAL_LEAK_LEVEL_GENERAL
        int "Critical leak"
        default 1200

    config UNITY_CRITICAL_LEAK_LEVEL_LWIP
        int "Critical leak for UT which use LWIP component"
        default 4095

    config UNITY_HEAP_TRACE_RECORDS
        int "Number of heap trace records to allocate for Unity test"
        default 200

endmenu

endmenu
```

## packages/gmf_app_utils/test_apps/sdkconfig.defaults
```kconfig
# General options for additional checks
CONFIG_BOOTLOADER_LOG_LEVEL_WARN=y
CONFIG_FREERTOS_WATCHPOINT_END_OF_STACK=y
CONFIG_COMPILER_STACK_CHECK_MODE_STRONG=y
CONFIG_COMPILER_STACK_CHECK=y

CONFIG_ESPTOOLPY_FLASHFREQ_80M=y
CONFIG_ESPTOOLPY_FLASHFREQ="80m"
CONFIG_ESPTOOLPY_FLASHSIZE_8MB=y
CONFIG_ESPTOOLPY_FLASHSIZE="8MB"

# disable task watchdog since this app uses an interactive menu
CONFIG_ESP_TASK_WDT_INIT=n

# some tests verify file name encoding
CONFIG_FATFS_LFN_HEAP=y
CONFIG_FATFS_API_ENCODING_UTF_8=y
CONFIG_FATFS_CODEPAGE_936=y

CONFIG_ESP_GDBSTUB_ENABLED=y

CONFIG_FREERTOS_HZ=1000
CONFIG_COMPILER_OPTIMIZATION_PERF=y

CONFIG_LOG_DEFAULT_LEVEL_DEBUG=y
CONFIG_LOG_DEFAULT_LEVEL=4
CONFIG_UNITY_ENABLE_64BIT=y

# some of the tests verify concurrent operation of FAT partitions in
# an SD card and in Flash, so need to use a custom partition table.
CONFIG_PARTITION_TABLE_CUSTOM=y
CONFIG_PARTITION_TABLE_CUSTOM_FILENAME="partitions.csv"

#
# Compiler options
#
CONFIG_COMPILER_OPTIMIZATION_PERF=y
CONFIG_COMPILER_OPTIMIZATION_ASSERTIONS_ENABLE=y
CONFIG_COMPILER_ASSERT_NDEBUG_EVALUATE=y
CONFIG_COMPILER_FLOAT_LIB_FROM_GCCLIB=y
CONFIG_COMPILER_OPTIMIZATION_ASSERTION_LEVEL=2
CONFIG_COMPILER_HIDE_PATHS_MACROS=y
CONFIG_COMPILER_STACK_CHECK_MODE_STRONG=y
CONFIG_COMPILER_STACK_CHECK=y
CONFIG_COMPILER_DISABLE_DEFAULT_ERRORS=y
CONFIG_COMPILER_RT_LIB_GCCLIB=y
CONFIG_COMPILER_RT_LIB_NAME="gcc"
CONFIG_COMPILER_ORPHAN_SECTIONS_WARNING=y
# end of Compiler options
```

## packages/gmf_fft/examples/fft_spectrum_print/sdkconfig.defaults
```kconfig
# Optimize the example for throughput and leave enough stack for log formatting.
CONFIG_COMPILER_OPTIMIZATION_PERF=y
CONFIG_ESP_MAIN_TASK_STACK_SIZE=8192
```

## packages/gmf_fft/test_apps/sdkconfig.defaults
```kconfig
# -O2 optimization
CONFIG_COMPILER_OPTIMIZATION_PERF=y

CONFIG_ESP_MAIN_TASK_STACK_SIZE=8192
```
