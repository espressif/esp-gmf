## elements/gmf_ai_audio/examples/aec_rec/sdkconfig.defaults.esp32
```kconfig
CONFIG_IDF_CMAKE=y
CONFIG_IDF_TARGET_ARCH_XTENSA=y
CONFIG_IDF_TARGET="esp32"
CONFIG_IDF_TARGET_ESP32=y
CONFIG_IDF_FIRMWARE_CHIP_ID=0x0000

#
# ESP System Settings
#
# CONFIG_ESP_DEFAULT_CPU_FREQ_MHZ_80 is not set
# CONFIG_ESP_DEFAULT_CPU_FREQ_MHZ_160 is not set
CONFIG_ESP_DEFAULT_CPU_FREQ_MHZ_240=y
CONFIG_ESP_DEFAULT_CPU_FREQ_MHZ=240

CONFIG_AUDIO_BOARD="LYRAT_MINI_V1"
```

## elements/gmf_ai_audio/examples/wwe/sdkconfig.defaults.esp32p4
```kconfig
CONFIG_IDF_TARGET="esp32p4"
CONFIG_IDF_TARGET_ESP32P4=y

CONFIG_IDF_EXPERIMENTAL_FEATURES=y

#
# Partition Table
#
CONFIG_PARTITION_TABLE_CUSTOM=y
CONFIG_PARTITION_TABLE_CUSTOM_FILENAME="partitions.csv"
CONFIG_PARTITION_TABLE_FILENAME="partitions.csv"
# end of Partition Table

#
# ESP Speech Recognition
#
CONFIG_MODEL_IN_FLASH=y
CONFIG_AFE_INTERFACE_V1=y
CONFIG_SR_NSN_WEBRTC=y
CONFIG_SR_VADN_WEBRTC=y
CONFIG_SR_WN_WN9S_HILEXIN=y
CONFIG_SR_MN_CN_MULTINET7_QUANT=y
CONFIG_SR_MN_EN_NONE=y
# end of ESP Speech Recognition

#
# ESP PSRAM
#
CONFIG_SPIRAM=y

#
# PSRAM config
#
CONFIG_SPIRAM_MODE_HEX=y
CONFIG_SPIRAM_SPEED_200M=y
CONFIG_SPIRAM_SPEED=200
CONFIG_SPIRAM_BOOT_INIT=y
CONFIG_SPIRAM_USE_MALLOC=y
CONFIG_SPIRAM_MEMTEST=y
CONFIG_SPIRAM_MALLOC_ALWAYSINTERNAL=16384
CONFIG_SPIRAM_MALLOC_RESERVE_INTERNAL=32768

#
# GMF AI Audio
#
CONFIG_GMF_AI_AUDIO_INIT_AEC=y
CONFIG_GMF_AI_AUDIO_INIT_AFE=y

CONFIG_GMF_AI_AUDIO_AFE_VAD_ENABLE=y
CONFIG_GMF_AI_AUDIO_AFE_AEC_ENABLE=y
CONFIG_GMF_AI_AUDIO_AEC_CH_ALLOCATION="MR"
CONFIG_GMF_AI_AUDIO_AFE_CH_ALLOCATION="MR"

CONFIG_GMF_AI_AUDIO_WAKEUP_ENABLE=y
CONFIG_GMF_AI_AUDIO_VOICE_COMMAND_ENABLE=y
# end of GMF AI Audio
```

## elements/gmf_ai_audio/examples/wwe/sdkconfig.defaults.esp32s31
```kconfig
# Partition Table
#
CONFIG_PARTITION_TABLE_CUSTOM=y
CONFIG_PARTITION_TABLE_CUSTOM_FILENAME="partitions.csv"
CONFIG_PARTITION_TABLE_FILENAME="partitions.csv"
CONFIG_PARTITION_TABLE_OFFSET=0x8000
CONFIG_PARTITION_TABLE_MD5=y
# end of Partition Table

#
# ESP Speech Recognition
#
CONFIG_MODEL_IN_FLASH=y
CONFIG_AFE_INTERFACE_V1=y
CONFIG_SR_WN_WN9_HILEXIN=y
CONFIG_SR_MN_CN_MULTINET7_QUANT=y
CONFIG_SR_MN_EN_NONE=y
# end of ESP Speech Recognition

#
# ESP PSRAM
#
CONFIG_SPIRAM=y

#
# GMF AI Audio
#
CONFIG_GMF_AI_AUDIO_INIT_AEC=y
CONFIG_GMF_AI_AUDIO_INIT_AFE=y
CONFIG_GMF_AI_AUDIO_INIT_WN=y

CONFIG_GMF_AI_AUDIO_AFE_VAD_ENABLE=y
CONFIG_GMF_AI_AUDIO_AFE_AEC_ENABLE=y
CONFIG_GMF_AI_AUDIO_WAKEUP_ENABLE=y
CONFIG_GMF_AI_AUDIO_VOICE_COMMAND_ENABLE=y
CONFIG_GMF_AI_AUDIO_AEC_CH_ALLOCATION="RMNN"
CONFIG_GMF_AI_AUDIO_WN_CH_ALLOCATION="RMNN"
CONFIG_GMF_AI_AUDIO_AFE_CH_ALLOCATION="RMNN"

# end of GMF AI Audio
```

## elements/test_apps/sdkconfig.defaults
```kconfig
# General options for additional checks
CONFIG_HEAP_POISONING_COMPREHENSIVE=y
CONFIG_COMPILER_WARN_WRITE_STRINGS=y
CONFIG_BOOTLOADER_LOG_LEVEL_WARN=y
CONFIG_FREERTOS_WATCHPOINT_END_OF_STACK=y
CONFIG_COMPILER_STACK_CHECK_MODE_STRONG=y
CONFIG_COMPILER_STACK_CHECK=y

# Serial flasher config
CONFIG_ESPTOOLPY_FLASHSIZE_8MB=y
CONFIG_ESPTOOLPY_FLASHSIZE="8MB"

# disable task watchdog since this app uses an interactive menu
CONFIG_ESP_TASK_WDT_INIT=n

# some tests verify file name encoding
CONFIG_FATFS_LFN_HEAP=y
CONFIG_FATFS_API_ENCODING_UTF_8=y
CONFIG_FATFS_CODEPAGE_936=y

# some of the tests verify concurrent operation of FAT partitions in
# an SD card and in Flash, so need to use a custom partition table.
CONFIG_PARTITION_TABLE_CUSTOM=y
CONFIG_PARTITION_TABLE_CUSTOM_FILENAME="partitions_4m.csv"

CONFIG_ESP_GDBSTUB_ENABLED=y

CONFIG_ESP_WIFI_STATIC_RX_BUFFER_NUM=20
CONFIG_ESP_WIFI_DYNAMIC_RX_BUFFER_NUM=128
CONFIG_ESP_WIFI_DYNAMIC_TX_BUFFER_NUM=128
CONFIG_ESP_WIFI_AMPDU_TX_ENABLED=y
CONFIG_ESP_WIFI_TX_BA_WIN=32
CONFIG_ESP_WIFI_AMPDU_RX_ENABLED=y
CONFIG_ESP_WIFI_RX_BA_WIN=32

# CONFIG_ESP_WIFI_IRAM_OPT is not set
# CONFIG_ESP_WIFI_EXTRA_IRAM_OPT is not set
# CONFIG_ESP_WIFI_RX_IRAM_OPT is not set
# CONFIG_ESP_WIFI_SLP_IRAM_OPT is not set
# CONFIG_LWIP_IRAM_OPTIMIZATION=y

CONFIG_LWIP_TCP_SND_BUF_DEFAULT=65535
CONFIG_LWIP_TCP_WND_DEFAULT=65535
CONFIG_LWIP_TCP_RECVMBOX_SIZE=64
CONFIG_LWIP_UDP_RECVMBOX_SIZE=64
CONFIG_LWIP_TCPIP_RECVMBOX_SIZE=64

CONFIG_FREERTOS_HZ=1000
CONFIG_COMPILER_OPTIMIZATION_PERF=y

CONFIG_ESPTOOLPY_FLASHMODE_QIO=y
CONFIG_ESPTOOLPY_FLASHFREQ_80M=y

CONFIG_SPIRAM=y
CONFIG_FREERTOS_ENABLE_BACKWARD_COMPATIBILITY=y

CONFIG_CODEC_I2C_BACKWARD_COMPATIBLE=n

CONFIG_LOG_DEFAULT_LEVEL_DEBUG=y
CONFIG_LOG_DEFAULT_LEVEL=4
CONFIG_UNITY_ENABLE_64BIT=y

#
# GMF Video Configurations
#

#
# GMF Video Codec
#
CONFIG_GMF_VIDEO_CODEC_INIT_DECODER=y
CONFIG_GMF_VIDEO_DEC_CODEC_TYPE_AUTO=y
CONFIG_GMF_VIDEO_DEC_CODEC_TYPE=0x00000000
CONFIG_GMF_VIDEO_CODEC_INIT_ENCODER=y
CONFIG_GMF_VIDEO_ENC_CODEC_TYPE_AUTO=y
CONFIG_GMF_VIDEO_ENC_CODEC_TYPE=0x00000000
# end of GMF Video Codec

#
# GMF Video Effects
#
CONFIG_GMF_VIDEO_EFFECTS_INIT_FPS_CONVERT=y
CONFIG_GMF_VIDEO_EFFECTS_INIT_OVERLAY=y
CONFIG_GMF_VIDEO_EFFECTS_INIT_COLOR_CONVERT=y

#
# Video effects color convert Configuration
#
CONFIG_GMF_VIDEO_EFFECTS_CC_INPUT_WIDTH=320
CONFIG_GMF_VIDEO_EFFECTS_CC_INPUT_HEIGHT=240
CONFIG_GMF_VIDEO_EFFECTS_CC_INPUT_FMT_GREY=y
CONFIG_GMF_VIDEO_EFFECTS_CC_INPUT_PIXEL_FORMAT=0x59455247
CONFIG_GMF_VIDEO_EFFECTS_CC_OUTPUT_FMT_RGB565_LE=y
CONFIG_GMF_VIDEO_EFFECTS_CC_OUTPUT_PIXEL_FORMAT=0x4C424752
CONFIG_GMF_VIDEO_EFFECTS_CC_COLOR_SPACE_BT601=y
CONFIG_GMF_VIDEO_EFFECTS_CC_COLOR_SPACE=0
# end of Video effects color convert Configuration

CONFIG_GMF_VIDEO_EFFECTS_INIT_SCALE=y

#
# Video effects scale Configuration
#
CONFIG_GMF_VIDEO_EFFECTS_SCALE_INPUT_WIDTH=320
CONFIG_GMF_VIDEO_EFFECTS_SCALE_INPUT_HEIGHT=240
CONFIG_GMF_VIDEO_EFFECTS_SCALE_INPUT_FMT_RGB565_LE=y
CONFIG_GMF_VIDEO_EFFECTS_SCALE_INPUT_PIXEL_FORMAT=0x4C424752
CONFIG_GMF_VIDEO_EFFECTS_SCALE_OUTPUT_WIDTH=160
CONFIG_GMF_VIDEO_EFFECTS_SCALE_OUTPUT_HEIGHT=120
CONFIG_GMF_VIDEO_EFFECTS_SCALE_FILTER_DOWN_RESAMPLE=y
CONFIG_GMF_VIDEO_EFFECTS_SCALE_FILTER_TYPE=0
# end of Video effects scale Configuration

CONFIG_GMF_VIDEO_EFFECTS_INIT_CROP=y

#
# Video effects crop Configuration
#
CONFIG_GMF_VIDEO_EFFECTS_CROP_INPUT_WIDTH=320
CONFIG_GMF_VIDEO_EFFECTS_CROP_INPUT_HEIGHT=240
CONFIG_GMF_VIDEO_EFFECTS_CROP_INPUT_FMT_RGB565_LE=y
CONFIG_GMF_VIDEO_EFFECTS_CROP_INPUT_PIXEL_FORMAT=0x4C424752
CONFIG_GMF_VIDEO_EFFECTS_CROP_X_POS=0
CONFIG_GMF_VIDEO_EFFECTS_CROP_Y_POS=0
CONFIG_GMF_VIDEO_EFFECTS_CROP_OUTPUT_WIDTH=160
CONFIG_GMF_VIDEO_EFFECTS_CROP_OUTPUT_HEIGHT=120
# end of Video effects crop Configuration

CONFIG_GMF_VIDEO_EFFECTS_INIT_ROTATE=y

#
# Video effects rotate Configuration
#
CONFIG_GMF_VIDEO_EFFECTS_ROTATE_INPUT_WIDTH=320
CONFIG_GMF_VIDEO_EFFECTS_ROTATE_INPUT_HEIGHT=240
CONFIG_GMF_VIDEO_EFFECTS_ROTATE_INPUT_FMT_RGB565_LE=y
CONFIG_GMF_VIDEO_EFFECTS_ROTATE_INPUT_PIXEL_FORMAT=0x4C424752
CONFIG_GMF_VIDEO_EFFECTS_ROTATE_DEGREE=0
# end of Video effects rotate Configuration
# end of GMF Video Effects
# end of GMF Video Configurations
# end of ESP GMF Loader
# ESP GMF Loader
#

#
# GMF IO Reader
#
CONFIG_GMF_IO_INIT_CODEC_DEV_RX=y
CONFIG_GMF_IO_INIT_FILE_READER=y
CONFIG_GMF_IO_INIT_HTTP_READER=y

#
# HTTP Reader Configuration
#
CONFIG_GMF_IO_HTTP_READER_TASK_STACK=3072
CONFIG_GMF_IO_HTTP_READER_TASK_CORE=0
CONFIG_GMF_IO_HTTP_READER_TASK_PRIORITY=5
CONFIG_GMF_IO_HTTP_READER_OUT_BUF_SIZE=8192
CONFIG_GMF_IO_HTTP_READER_CERT_PEM=""
# end of HTTP Reader Configuration

CONFIG_GMF_IO_INIT_FLASH_READER=y

#
# GMF IO Writer
#
CONFIG_GMF_IO_INIT_CODEC_DEV_TX=y
CONFIG_GMF_IO_INIT_FILE_WRITER=y
CONFIG_GMF_IO_INIT_HTTP_WRITER=y

#
# HTTP Writer Configuration
#
CONFIG_GMF_IO_HTTP_WRITER_TASK_STACK=3072
CONFIG_GMF_IO_HTTP_WRITER_TASK_CORE=0
CONFIG_GMF_IO_HTTP_WRITER_TASK_PRIORITY=5
CONFIG_GMF_IO_HTTP_WRITER_OUT_BUF_SIZE=8192
CONFIG_GMF_IO_HTTP_WRITER_CERT_PEM=""
# end of HTTP Writer Configuration
# end of GMF IO Writer
# end of GMF IO Configurations

#
# GMF Audio Codec
#
CONFIG_GMF_AUDIO_CODEC_INIT_DECODER=y
CONFIG_GMF_AUDIO_CODEC_DECODER_TYPE_PCM=y
# end of GMF Audio Codec

#
# PCM Decoder Configuration
#
CONFIG_GMF_AUDIO_CODEC_DEC_PCM_SAMPLE_RATE=44100
CONFIG_GMF_AUDIO_CODEC_DEC_PCM_CHANNEL=2
CONFIG_GMF_AUDIO_CODEC_DEC_PCM_BITS_PER_SAMPLE=16
# end of PCM Decoder Configuration

#
# AAC Encoder Configuration
#
CONFIG_GMF_AUDIO_CODEC_INIT_ENCODER=y
CONFIG_GMF_AUDIO_CODEC_ENCODER_TYPE_PCM=y
# end of AAC Encoder Configuration

#
# GMF Audio Effects
#
CONFIG_GMF_AUDIO_EFFECT_INIT_ALC=y
CONFIG_GMF_AUDIO_EFFECT_INIT_CH_CVT=y
CONFIG_GMF_AUDIO_EFFECT_CH_CVT_DEST_CH=2
CONFIG_GMF_AUDIO_EFFECT_INIT_BIT_CVT=y
CONFIG_GMF_AUDIO_EFFECT_BIT_CVT_DEST_BITS=16
CONFIG_GMF_AUDIO_EFFECT_INIT_RATE_CVT=y
CONFIG_GMF_AUDIO_EFFECT_RATE_CVT_DEST_RATE=48000
CONFIG_GMF_AUDIO_EFFECT_RATE_CVT_COMPLEXITY=1
CONFIG_GMF_AUDIO_EFFECT_RATE_CVT_PERF_TYPE_MEMORY=y
CONFIG_GMF_AUDIO_EFFECT_RATE_CVT_PERF_TYPE=0
CONFIG_GMF_AUDIO_EFFECT_INIT_DEINTERLEAVE=y
CONFIG_GMF_AUDIO_EFFECT_INIT_INTERLEAVE=y
CONFIG_GMF_AUDIO_EFFECT_INIT_MIXER=y
CONFIG_GMF_AUDIO_EFFECT_INIT_EQ=y
CONFIG_GMF_AUDIO_EFFECT_INIT_SONIC=y
CONFIG_GMF_AUDIO_EFFECT_INIT_FADE=y
# end of GMF Audio Effects

#
# GMF AI Audio
#
CONFIG_GMF_AI_AUDIO_INIT_AEC=y
CONFIG_GMF_AI_AUDIO_AEC_FILTER_LEN=4
CONFIG_GMF_AI_AUDIO_AEC_CH_ALLOCATION="RMNM"
# end of GMF AI Audio

#
# GMF Miscellaneous
#
CONFIG_GMF_MISC_INIT_COPIER=y
# end of GMF Miscellaneous
```

## gmf_core/test_apps/sdkconfig.defaults.esp32p4
```kconfig
# See gmf_core/test_apps/sdkconfig.defaults.esp32p4 for rationale: route console
# over USB-Serial-JTAG so pytest-embedded's writes to /dev/ttyACM0 reach the unity menu.
CONFIG_ESP_CONSOLE_USB_SERIAL_JTAG=y
CONFIG_ESP_CONSOLE_SECONDARY_NONE=y
```

## gmf_examples/basic_examples/pipeline_audio_effects/main/Kconfig.projbuild
```kconfig
menu "Pipeline Audio Effects Example"

config GMF_AUDIO_EFFECT_INIT_MIXER
    bool "Mixer"
    default y
    help
        Enable mixer demo mode

config GMF_AUDIO_EFFECT_INIT_ALC
    bool "ALC"
    default y
    help
        Enable ALC (Automatic Level Control) effect demo

config GMF_AUDIO_EFFECT_INIT_SONIC
    bool "Sonic"
    default y
    help
        Enable Sonic (pitch and speed shifting) effect demo

config GMF_AUDIO_EFFECT_INIT_EQ
    bool "EQ"
    default y
    help
        Enable EQ (Equalizer) effect demo

config GMF_AUDIO_EFFECT_INIT_FADE
    bool "Fade"
    default y
    help
        Enable Fade (fade-in/fade-out) effect demo

config GMF_AUDIO_EFFECT_INIT_DRC
    bool "DRC"
    default y
    help
        Enable DRC (Dynamic Range Control) effect demo

config GMF_AUDIO_EFFECT_INIT_MBC
    bool "MBC"
    default y
    help
        Enable MBC (Multi-Band Compressor) effect demo
endmenu
```
