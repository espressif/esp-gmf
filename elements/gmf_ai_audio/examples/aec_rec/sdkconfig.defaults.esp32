## gmf_examples/basic_examples/pipeline_play_http_music/sdkconfig.defaults
```kconfig
#
# Serial flasher config
#
CONFIG_ESPTOOLPY_FLASHFREQ_80M=y
CONFIG_ESPTOOLPY_FLASHSIZE_4MB=y

#
# Partition Table
#
CONFIG_PARTITION_TABLE_SINGLE_APP_LARGE=y
CONFIG_PARTITION_TABLE_OFFSET=0x8000
CONFIG_PARTITION_TABLE_MD5=y

#
# Compiler options
#
CONFIG_COMPILER_OPTIMIZATION_PERF=y

#
# FreeRTOS
#
CONFIG_FREERTOS_HZ=1000
CONFIG_FREERTOS_ENABLE_BACKWARD_COMPATIBILITY=y

#
# ESP PSRAM
#
CONFIG_SPIRAM=y
CONFIG_SPIRAM_SPEED_80M=y
CONFIG_SPIRAM_TRY_ALLOCATE_WIFI_LWIP=y
CONFIG_FREERTOS_TASK_CREATE_ALLOW_EXT_MEM=y
CONFIG_SPIRAM_MALLOC_ALWAYSINTERNAL=128

#
# GMF IO Reader
#
CONFIG_GMF_IO_INIT_CODEC_DEV_RX=n
CONFIG_GMF_IO_INIT_FILE_READER=n
CONFIG_GMF_IO_INIT_FLASH_READER=n
CONFIG_GMF_IO_INIT_HTTP_READER=y
CONFIG_GMF_IO_HTTP_READER_OUT_BUF_SIZE=32768

#
# GMF IO Writer
#
CONFIG_GMF_IO_INIT_CODEC_DEV_TX=y
CONFIG_GMF_IO_INIT_FILE_WRITER=n
CONFIG_GMF_IO_INIT_HTTP_WRITER=n

#
# GMF Audio Codec
#
CONFIG_GMF_AUDIO_CODEC_INIT_DECODER=y
CONFIG_GMF_AUDIO_CODEC_DECODER_TYPE_MP3=y
CONFIG_GMF_AUDIO_CODEC_INIT_ENCODER=n

#
# GMF Audio Effects
#
CONFIG_GMF_AUDIO_EFFECT_INIT_CH_CVT=y
CONFIG_GMF_AUDIO_EFFECT_CH_CVT_DEST_CH=2
CONFIG_GMF_AUDIO_EFFECT_INIT_BIT_CVT=y
CONFIG_GMF_AUDIO_EFFECT_BIT_CVT_DEST_BITS=16
CONFIG_GMF_AUDIO_EFFECT_INIT_RATE_CVT=y
CONFIG_GMF_AUDIO_EFFECT_RATE_CVT_DEST_RATE=48000
CONFIG_GMF_AUDIO_EFFECT_RATE_CVT_COMPLEXITY=2
CONFIG_GMF_AUDIO_EFFECT_RATE_CVT_PERF_TYPE_SPEED=y
CONFIG_GMF_AUDIO_EFFECT_RATE_CVT_PERF_TYPE=1

#
# Audio Decoder Configuration
#
CONFIG_AUDIO_DECODER_AAC_SUPPORT=n
CONFIG_AUDIO_DECODER_MP3_SUPPORT=y
CONFIG_AUDIO_DECODER_G711_SUPPORT=n
CONFIG_AUDIO_DECODER_AMRNB_SUPPORT=n
CONFIG_AUDIO_DECODER_AMRWB_SUPPORT=n
CONFIG_AUDIO_DECODER_FLAC_SUPPORT=n
CONFIG_AUDIO_DECODER_OPUS_SUPPORT=n
CONFIG_AUDIO_DECODER_VORBIS_SUPPORT=n
CONFIG_AUDIO_DECODER_ADPCM_SUPPORT=n
CONFIG_AUDIO_DECODER_ALAC_SUPPORT=n
CONFIG_AUDIO_DECODER_PCM_SUPPORT=n
CONFIG_AUDIO_DECODER_SBC_SUPPORT=n
CONFIG_AUDIO_DECODER_LC3_SUPPORT=n

#
# Audio Simple Decoder Configuration
#
CONFIG_AUDIO_SIMPLE_DEC_WAV_SUPPORT=n
CONFIG_AUDIO_SIMPLE_DEC_M4A_SUPPORT=n
CONFIG_AUDIO_SIMPLE_DEC_TS_SUPPORT=n

#
# Audio Encoder Configuration
#
CONFIG_AUDIO_ENCODER_AAC_SUPPORT=n
CONFIG_AUDIO_ENCODER_G711_SUPPORT=n
CONFIG_AUDIO_ENCODER_AMRNB_SUPPORT=n
CONFIG_AUDIO_ENCODER_AMRWB_SUPPORT=n
CONFIG_AUDIO_ENCODER_OPUS_SUPPORT=n
CONFIG_AUDIO_ENCODER_ADPCM_SUPPORT=n
CONFIG_AUDIO_ENCODER_ALAC_SUPPORT=n
CONFIG_AUDIO_ENCODER_PCM_SUPPORT=n
CONFIG_AUDIO_ENCODER_SBC_SUPPORT=n
CONFIG_AUDIO_ENCODER_LC3_SUPPORT=n
```

## gmf_examples/basic_examples/pipeline_play_http_music/sdkconfig.defaults.esp32
```kconfig
CONFIG_IDF_CMAKE=y
CONFIG_IDF_TARGET_ARCH_XTENSA=y
CONFIG_IDF_TARGET="esp32"
CONFIG_IDF_TARGET_ESP32=y
CONFIG_IDF_FIRMWARE_CHIP_ID=0x0000

CONFIG_AUDIO_BOARD="LYRAT_MINI_V1"
```

## gmf_examples/basic_examples/pipeline_play_multi_source_music/sdkconfig.defaults
```kconfig
#
# Serial flasher config
#
CONFIG_ESPTOOLPY_FLASHSIZE_4MB=y
CONFIG_ESPTOOLPY_FLASHFREQ_80M=y

#
# Partition Table
#
CONFIG_PARTITION_TABLE_SINGLE_APP=y
CONFIG_PARTITION_TABLE_CUSTOM=y
CONFIG_PARTITION_TABLE_CUSTOM_FILENAME="partitions.csv"
CONFIG_PARTITION_TABLE_FILENAME="partitions.csv"
CONFIG_PARTITION_TABLE_OFFSET=0x8000
CONFIG_PARTITION_TABLE_MD5=y

#
# Compiler options
#
CONFIG_COMPILER_OPTIMIZATION_PERF=y

#
# FreeRTOS
#
CONFIG_FREERTOS_HZ=1000
CONFIG_FREERTOS_ENABLE_BACKWARD_COMPATIBILITY=y

#
# ESP PSRAM
#
CONFIG_SPIRAM=y
CONFIG_SPIRAM_SPEED_80M=y
CONFIG_SPIRAM_TRY_ALLOCATE_WIFI_LWIP=y
CONFIG_FREERTOS_TASK_CREATE_ALLOW_EXT_MEM=y
CONFIG_SPIRAM_MALLOC_ALWAYSINTERNAL=128

#
# GMF IO Reader
#
CONFIG_GMF_IO_INIT_CODEC_DEV_RX=n
CONFIG_GMF_IO_INIT_FILE_READER=y
CONFIG_GMF_IO_FILE_READ_CACHE_SIZE=2048
CONFIG_GMF_IO_INIT_FLASH_READER=y
CONFIG_GMF_IO_INIT_HTTP_READER=y
CONFIG_GMF_IO_HTTP_READER_OUT_BUF_SIZE=32768

#
# GMF IO Writer
#
CONFIG_GMF_IO_INIT_CODEC_DEV_TX=y
CONFIG_GMF_IO_INIT_FILE_WRITER=n
CONFIG_GMF_IO_INIT_HTTP_WRITER=n

#
# GMF Audio Codec
#
CONFIG_GMF_AUDIO_CODEC_INIT_DECODER=y
CONFIG_GMF_AUDIO_CODEC_DECODER_TYPE_MP3=y
CONFIG_GMF_AUDIO_CODEC_INIT_ENCODER=n

#
# GMF Audio Effects
#
CONFIG_GMF_AUDIO_EFFECT_INIT_CH_CVT=y
CONFIG_GMF_AUDIO_EFFECT_CH_CVT_DEST_CH=2
CONFIG_GMF_AUDIO_EFFECT_INIT_BIT_CVT=y
CONFIG_GMF_AUDIO_EFFECT_BIT_CVT_DEST_BITS=16
CONFIG_GMF_AUDIO_EFFECT_INIT_RATE_CVT=y
CONFIG_GMF_AUDIO_EFFECT_RATE_CVT_DEST_RATE=16000
CONFIG_GMF_AUDIO_EFFECT_RATE_CVT_COMPLEXITY=2
CONFIG_GMF_AUDIO_EFFECT_RATE_CVT_PERF_TYPE_SPEED=y
CONFIG_GMF_AUDIO_EFFECT_RATE_CVT_PERF_TYPE=1
CONFIG_GMF_AUDIO_EFFECT_INIT_FADE=y
CONFIG_GMF_AUDIO_EFFECT_FADE_MODE_FADE_IN=y
CONFIG_GMF_AUDIO_EFFECT_FADE_CURVE_LINE=y
CONFIG_GMF_AUDIO_EFFECT_FADE_TRANSIT_TIME=1000
```

## gmf_examples/basic_examples/pipeline_play_sdcard_music/sdkconfig.defaults
```kconfig
CONFIG_FREERTOS_ENABLE_BACKWARD_COMPATIBILITY=y

#
# Serial flasher config
#
CONFIG_ESPTOOLPY_BEFORE_RESET=y
CONFIG_ESPTOOLPY_FLASHSIZE_4MB=y
# end of Serial flasher config

#
# Partition Table
#
CONFIG_PARTITION_TABLE_SINGLE_APP=y
CONFIG_PARTITION_TABLE_CUSTOM=y
CONFIG_PARTITION_TABLE_CUSTOM_FILENAME="partitions.csv"
CONFIG_PARTITION_TABLE_FILENAME="partitions.csv"
CONFIG_PARTITION_TABLE_OFFSET=0x8000
CONFIG_PARTITION_TABLE_MD5=y
# end of Partition Table

CONFIG_COMPILER_OPTIMIZATION_PERF=y

CONFIG_FREERTOS_HZ=1000

CONFIG_SPIRAM=y
CONFIG_SPIRAM_SPEED_80M=y
CONFIG_SPIRAM_TRY_ALLOCATE_WIFI_LWIP=y
CONFIG_SPIRAM_ALLOW_STACK_EXTERNAL_MEMORY=y
CONFIG_SPIRAM_MALLOC_ALWAYSINTERNAL=1024
CONFIG_SPIRAM_TYPE_AUTO=y

#
# FAT Filesystem support
#
CONFIG_FATFS_VOLUME_COUNT=2
CONFIG_FATFS_LFN_HEAP=y
CONFIG_FATFS_SECTOR_4096=y
CONFIG_FATFS_CODEPAGE_936=y
CONFIG_FATFS_CODEPAGE=936
CONFIG_FATFS_MAX_LFN=255
CONFIG_FATFS_API_ENCODING_UTF_8=y
CONFIG_FATFS_FS_LOCK=5
CONFIG_FATFS_TIMEOUT_MS=10000
CONFIG_FATFS_PER_FILE_CACHE=y
CONFIG_FATFS_VFS_FSTAT_BLKSIZE=0

#
# ESP GMF Loader
#

#
# GMF IO Configurations
#

#
# GMF IO Reader
#
CONFIG_GMF_IO_INIT_FILE_READER=y
# end of GMF IO Reader

#
# GMF IO Writer
#
CONFIG_GMF_IO_INIT_CODEC_DEV_TX=y
# end of GMF IO Writer
# end of GMF IO Configurations

#
# GMF Audio Configurations
#

#
# GMF Audio Codec
#
CONFIG_GMF_AUDIO_CODEC_INIT_DECODER=y
CONFIG_GMF_AUDIO_CODEC_DECODER_TYPE_AAC=y

#
# GMF Audio Effects
#
CONFIG_GMF_AUDIO_EFFECT_INIT_CH_CVT=y
CONFIG_GMF_AUDIO_EFFECT_CH_CVT_DEST_CH=2
CONFIG_GMF_AUDIO_EFFECT_INIT_BIT_CVT=y
CONFIG_GMF_AUDIO_EFFECT_BIT_CVT_DEST_BITS=16
CONFIG_GMF_AUDIO_EFFECT_INIT_RATE_CVT=y
CONFIG_GMF_AUDIO_EFFECT_RATE_CVT_DEST_RATE=44100
CONFIG_GMF_AUDIO_EFFECT_RATE_CVT_COMPLEXITY=2
CONFIG_GMF_AUDIO_EFFECT_RATE_CVT_PERF_TYPE_SPEED=y
CONFIG_GMF_AUDIO_EFFECT_RATE_CVT_PERF_TYPE=1
# end of GMF Audio Effects
```

## gmf_examples/basic_examples/pipeline_record_http/main/Kconfig.projbuild
```kconfig
menu "GMF Example Configuration"

config EXAMPLE_HTTP_SERVER_URL

    string "HTTP SERVER URL"
    default "http://192.168.1.101:8000/upload"
    help
        The HTTP server url with address, port and handle

endmenu
```

## gmf_examples/basic_examples/pipeline_record_http/sdkconfig.defaults
```kconfig
#
# Serial flasher config
#
CONFIG_ESPTOOLPY_BEFORE_RESET=y
CONFIG_ESPTOOLPY_FLASHSIZE_4MB=y
CONFIG_ESPTOOLPY_FLASHFREQ_80M=y

#
# Partition Table
#
CONFIG_PARTITION_TABLE_CUSTOM=y
CONFIG_PARTITION_TABLE_CUSTOM_FILENAME="partitions.csv"
CONFIG_PARTITION_TABLE_FILENAME="partitions.csv"
CONFIG_PARTITION_TABLE_OFFSET=0x8000
CONFIG_PARTITION_TABLE_MD5=y

#
# Compiler options
#
CONFIG_COMPILER_OPTIMIZATION_PERF=y

#
# FreeRTOS
#
CONFIG_FREERTOS_HZ=1000
CONFIG_FREERTOS_ENABLE_BACKWARD_COMPATIBILITY=y

#
# ESP PSRAM
#
CONFIG_SPIRAM=y
CONFIG_SPIRAM_SPEED_80M=y
CONFIG_SPIRAM_TRY_ALLOCATE_WIFI_LWIP=y
CONFIG_FREERTOS_TASK_CREATE_ALLOW_EXT_MEM=y
CONFIG_SPIRAM_MALLOC_ALWAYSINTERNAL=128

#
# GMF IO Reader
#
CONFIG_GMF_IO_INIT_CODEC_DEV_RX=y
CONFIG_GMF_IO_INIT_HTTP_READER=n
CONFIG_GMF_IO_INIT_FILE_READER=n
CONFIG_GMF_IO_INIT_FLASH_READER=n

#
# GMF IO Writer
#
CONFIG_GMF_IO_INIT_HTTP_WRITER=y
CONFIG_GMF_IO_INIT_FILE_WRITER=n
CONFIG_GMF_IO_INIT_CODEC_DEV_TX=n

#
# PCM Encoder Configuration
#
CONFIG_GMF_AUDIO_CODEC_INIT_ENCODER=y
CONFIG_GMF_AUDIO_CODEC_ENCODER_TYPE_PCM=y

#
# GMF Audio Codec
#
CONFIG_GMF_AUDIO_CODEC_INIT_ENCODER=y
CONFIG_GMF_AUDIO_CODEC_INIT_DECODER=n
```

## gmf_examples/basic_examples/pipeline_record_http/sdkconfig.defaults.esp32p4
```kconfig
#
# System Settings
#
CONFIG_ESP_DEFAULT_CPU_FREQ_MHZ_360=y

#
# SPI RAM config
#
CONFIG_IDF_EXPERIMENTAL_FEATURES=y
CONFIG_SPIRAM_SPEED_200M=y

#
# Wi-Fi Remote
#
CONFIG_SLAVE_IDF_TARGET_ESP32C6=y
CONFIG_ESP_WIFI_REMOTE_LIBRARY_HOSTED=y
CONFIG_EXAMPLE_CONNECT_WIFI=y
```

## gmf_examples/basic_examples/pipeline_record_http/sdkconfig.defaults.esp32s3
```kconfig
CONFIG_IDF_CMAKE=y
CONFIG_IDF_TARGET_ARCH_XTENSA=y
CONFIG_IDF_TARGET="esp32s3"
CONFIG_IDF_TARGET_ESP32S3=y
CONFIG_IDF_FIRMWARE_CHIP_ID=0x0009

CONFIG_ESP_DEFAULT_CPU_FREQ_MHZ_240=y

CONFIG_SPIRAM_MODE_OCT=y
```

## gmf_examples/basic_examples/pipeline_record_sdcard/sdkconfig.defaults
```kconfig
#
# Serial flasher config
#
CONFIG_ESPTOOLPY_FLASHSIZE_4MB=y
CONFIG_ESPTOOLPY_FLASHFREQ_80M=y

#
# Partition Table
#
CONFIG_PARTITION_TABLE_SINGLE_APP=y
CONFIG_PARTITION_TABLE_CUSTOM=y
CONFIG_PARTITION_TABLE_CUSTOM_FILENAME="partitions.csv"
CONFIG_PARTITION_TABLE_FILENAME="partitions.csv"
CONFIG_PARTITION_TABLE_OFFSET=0x8000
CONFIG_PARTITION_TABLE_MD5=y

#
# Compiler options
#
CONFIG_COMPILER_OPTIMIZATION_PERF=y

#
# FreeRTOS
#
CONFIG_FREERTOS_HZ=1000
CONFIG_FREERTOS_ENABLE_BACKWARD_COMPATIBILITY=y
CONFIG_FREERTOS_GENERATE_RUN_TIME_STATS=y
CONFIG_FREERTOS_VTASKLIST_INCLUDE_COREID=y

#
# ESP PSRAM
#
CONFIG_SPIRAM=y
CONFIG_SPIRAM_SPEED_80M=y
CONFIG_SPIRAM_TRY_ALLOCATE_WIFI_LWIP=y
CONFIG_FREERTOS_TASK_CREATE_ALLOW_EXT_MEM=y
CONFIG_SPIRAM_MALLOC_ALWAYSINTERNAL=128

#
# FAT Filesystem support
#
CONFIG_FATFS_LFN_HEAP=y

#
# GMF IO Reader
#
CONFIG_GMF_IO_INIT_CODEC_DEV_RX=y
CONFIG_GMF_IO_INIT_FILE_READER=n
CONFIG_GMF_IO_INIT_FLASH_READER=n
CONFIG_GMF_IO_INIT_HTTP_READER=n

#
# GMF IO Writer
#
CONFIG_GMF_IO_INIT_FILE_WRITER=y
CONFIG_GMF_IO_INIT_CODEC_DEV_TX=n
CONFIG_GMF_IO_INIT_HTTP_WRITER=n

#
# GMF Audio Codec
#
CONFIG_GMF_AUDIO_CODEC_INIT_DECODER=n
CONFIG_GMF_AUDIO_CODEC_INIT_ENCODER=y

#
# GMF Audio Effects
#
CONFIG_GMF_AUDIO_EFFECT_INIT_ALC=n
CONFIG_GMF_AUDIO_EFFECT_INIT_CH_CVT=n
CONFIG_GMF_AUDIO_EFFECT_INIT_BIT_CVT=n
CONFIG_GMF_AUDIO_EFFECT_INIT_RATE_CVT=n

#
# Power Management
#
CONFIG_PM_ENABLE=y
```

## gmf_examples/basic_examples/pipeline_record_sdcard/sdkconfig.defaults.esp32p4
```kconfig
#
# System Settings
#
CONFIG_ESP_DEFAULT_CPU_FREQ_MHZ_360=y

#
# SPI RAM config
#
CONFIG_IDF_EXPERIMENTAL_FEATURES=y
CONFIG_SPIRAM_SPEED_200M=y
```

## packages/esp_asrc/examples/asrc_demo/sdkconfig.defaults
```kconfig
#
# Serial flasher config
#
CONFIG_ESPTOOLPY_BEFORE_RESET=y
CONFIG_ESPTOOLPY_FLASHSIZE_4MB=y
CONFIG_ESPTOOLPY_FLASHMODE_QIO=y
CONFIG_ESPTOOLPY_FLASHFREQ_80M=y

#
# Partition Table
#
CONFIG_PARTITION_TABLE_CUSTOM=y
CONFIG_PARTITION_TABLE_CUSTOM_FILENAME="partition.csv"
CONFIG_PARTITION_TABLE_FILENAME="partition.csv"
CONFIG_PARTITION_TABLE_OFFSET=0xA000
CONFIG_PARTITION_TABLE_MD5=y

#
# Compiler options
#
CONFIG_COMPILER_OPTIMIZATION_SIZE=y

#
# FreeRTOS
#
CONFIG_FREERTOS_ENABLE_BACKWARD_COMPATIBILITY=y

#
# ESP PSRAM
#
CONFIG_SPIRAM=y
CONFIG_SPIRAM_SPEED_80M=y

#
# ESP System Settings
#
CONFIG_ESP_INT_WDT=n
CONFIG_ESP_TASK_WDT_EN=n
```

## packages/esp_asrc/examples/asrc_demo/sdkconfig.defaults.esp32s3
```kconfig
#
# ESP System Settings
#
CONFIG_ESP_DEFAULT_CPU_FREQ_MHZ_240=y

#
# ESP32-S3 Cache
#
CONFIG_ESP32S3_INSTRUCTION_CACHE_32KB=y
CONFIG_ESP32S3_INSTRUCTION_CACHE_SIZE=0x8000
CONFIG_ESP32S3_INSTRUCTION_CACHE_LINE_32B=y
CONFIG_ESP32S3_INSTRUCTION_CACHE_LINE_SIZE=32
CONFIG_ESP32S3_DATA_CACHE_64KB=y
CONFIG_ESP32S3_DATA_CACHE_SIZE=0x10000
CONFIG_ESP32S3_DATA_CACHE_LINE_64B=y
CONFIG_ESP32S3_DATA_CACHE_LINE_SIZE=64

#
# ESP PSRAM
#
CONFIG_ESP32S3_SPIRAM_SUPPORT=y
CONFIG_SPIRAM_MODE_OCT=y
CONFIG_SPIRAM_FETCH_INSTRUCTIONS=y
CONFIG_SPIRAM_RODATA=y
```
