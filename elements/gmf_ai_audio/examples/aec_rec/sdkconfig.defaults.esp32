## gmf_examples/basic_examples/pipeline_audio_effects/sdkconfig.defaults
```kconfig
#
# Serial flasher config
#
CONFIG_ESPTOOLPY_BEFORE_RESET=y
CONFIG_ESPTOOLPY_FLASHSIZE_8MB=y
CONFIG_ESPTOOLPY_FLASHFREQ_80M=y
CONFIG_ESPTOOLPY_FLASHMODE_QIO=y

#
# Partition Table
#
CONFIG_PARTITION_TABLE_SINGLE_APP=y
CONFIG_PARTITION_TABLE_CUSTOM=y
CONFIG_PARTITION_TABLE_CUSTOM_FILENAME="partitions.csv"
CONFIG_PARTITION_TABLE_FILENAME="partitions.csv"
CONFIG_PARTITION_TABLE_OFFSET=0x8000
CONFIG_PARTITION_TABLE_MD5=y

#
# Compiler options
#
CONFIG_COMPILER_OPTIMIZATION_PERF=y

#
# FreeRTOS
#
CONFIG_FREERTOS_HZ=1000
CONFIG_FREERTOS_ENABLE_BACKWARD_COMPATIBILITY=y

#
# ESP PSRAM
#
CONFIG_SPIRAM=y
CONFIG_SPIRAM_SPEED_80M=y
CONFIG_FREERTOS_TASK_CREATE_ALLOW_EXT_MEM=y
CONFIG_SPIRAM_MALLOC_ALWAYSINTERNAL=1024
CONFIG_SPIRAM_TYPE_AUTO=y

#
# GMF IO Reader
#
CONFIG_GMF_IO_INIT_CODEC_DEV_RX=n
CONFIG_GMF_IO_INIT_FILE_READER=n
CONFIG_GMF_IO_INIT_FLASH_READER=y
CONFIG_GMF_IO_INIT_HTTP_READER=n

#
# GMF IO Writer
#
CONFIG_GMF_IO_INIT_CODEC_DEV_TX=y
CONFIG_GMF_IO_INIT_FILE_WRITER=n
CONFIG_GMF_IO_INIT_HTTP_WRITER=n

#
# GMF Audio Codec
#
CONFIG_GMF_AUDIO_CODEC_INIT_ENCODER=n
CONFIG_GMF_AUDIO_CODEC_INIT_DECODER=y
CONFIG_GMF_AUDIO_CODEC_DECODER_TYPE_WAV=y
CONFIG_GMF_AUDIO_CODEC_DECODER_TYPE_MP3=y

#
# GMF Audio Effects
#
CONFIG_GMF_AUDIO_EFFECT_INIT_ALC=y
CONFIG_GMF_AUDIO_EFFECT_INIT_SONIC=y
CONFIG_GMF_AUDIO_EFFECT_INIT_FADE=y
CONFIG_GMF_AUDIO_EFFECT_INIT_EQ=y
CONFIG_GMF_AUDIO_EFFECT_INIT_DRC=y
CONFIG_GMF_AUDIO_EFFECT_INIT_MBC=y
CONFIG_GMF_AUDIO_EFFECT_INIT_RATE_CVT=y
CONFIG_GMF_AUDIO_EFFECT_INIT_CH_CVT=y
CONFIG_GMF_AUDIO_EFFECT_INIT_BIT_CVT=y
CONFIG_GMF_AUDIO_EFFECT_INIT_MIXER=y

CONFIG_GMF_AUDIO_EFFECT_FADE_MODE_FADE_IN=y
CONFIG_GMF_AUDIO_EFFECT_FADE_CURVE_LINE=y
CONFIG_GMF_AUDIO_EFFECT_FADE_TRANSIT_TIME=500

CONFIG_GMF_AUDIO_EFFECT_RATE_CVT_DEST_RATE=48000
CONFIG_GMF_AUDIO_EFFECT_RATE_CVT_COMPLEXITY=2
CONFIG_GMF_AUDIO_EFFECT_RATE_CVT_PERF_TYPE_SPEED=y
CONFIG_GMF_AUDIO_EFFECT_RATE_CVT_PERF_TYPE=1
CONFIG_GMF_AUDIO_EFFECT_CH_CVT_DEST_CH=2
CONFIG_GMF_AUDIO_EFFECT_BIT_CVT_DEST_BITS=16

CONFIG_GMF_AUDIO_EFFECT_MIXER_SRC_NUM=2
CONFIG_GMF_AUDIO_EFFECT_MIXER_SRC1_WEIGHT1=70
CONFIG_GMF_AUDIO_EFFECT_MIXER_SRC1_WEIGHT2=100
CONFIG_GMF_AUDIO_EFFECT_MIXER_SRC1_TRANSIT_TIME=500
CONFIG_GMF_AUDIO_EFFECT_MIXER_SRC2_WEIGHT1=70
CONFIG_GMF_AUDIO_EFFECT_MIXER_SRC2_WEIGHT2=0
CONFIG_GMF_AUDIO_EFFECT_MIXER_SRC2_TRANSIT_TIME=100

CONFIG_GMF_EQ_FILTER_NUM=10
CONFIG_ESP_AE_EQ_FILTER1_PEAK=y
CONFIG_GMF_EQ_FILTER1_TYPE=3
CONFIG_GMF_EQ_FILTER1_FC=31
CONFIG_GMF_EQ_FILTER1_QX1000=1414
CONFIG_GMF_EQ_FILTER1_GAINX10=0
CONFIG_ESP_AE_EQ_FILTER2_PEAK=y
CONFIG_GMF_EQ_FILTER2_TYPE=3
CONFIG_GMF_EQ_FILTER2_FC=62
CONFIG_GMF_EQ_FILTER2_QX1000=1414
CONFIG_GMF_EQ_FILTER2_GAINX10=0
CONFIG_ESP_AE_EQ_FILTER3_PEAK=y
CONFIG_GMF_EQ_FILTER3_TYPE=3
CONFIG_GMF_EQ_FILTER3_FC=125
CONFIG_GMF_EQ_FILTER3_QX1000=1414
CONFIG_GMF_EQ_FILTER3_GAINX10=0
CONFIG_ESP_AE_EQ_FILTER4_PEAK=y
CONFIG_GMF_EQ_FILTER4_TYPE=3
CONFIG_GMF_EQ_FILTER4_FC=250
CONFIG_GMF_EQ_FILTER4_QX1000=1414
CONFIG_GMF_EQ_FILTER4_GAINX10=0
CONFIG_ESP_AE_EQ_FILTER5_PEAK=y
CONFIG_GMF_EQ_FILTER5_TYPE=3
CONFIG_GMF_EQ_FILTER5_FC=500
CONFIG_GMF_EQ_FILTER5_QX1000=1414
CONFIG_GMF_EQ_FILTER5_GAINX10=0
CONFIG_ESP_AE_EQ_FILTER6_PEAK=y
CONFIG_GMF_EQ_FILTER6_TYPE=3
CONFIG_GMF_EQ_FILTER6_FC=1000
CONFIG_GMF_EQ_FILTER6_QX1000=1414
CONFIG_GMF_EQ_FILTER6_GAINX10=0
CONFIG_ESP_AE_EQ_FILTER7_PEAK=y
CONFIG_GMF_EQ_FILTER7_TYPE=3
CONFIG_GMF_EQ_FILTER7_FC=2000
CONFIG_GMF_EQ_FILTER7_QX1000=1414
CONFIG_GMF_EQ_FILTER7_GAINX10=0
CONFIG_ESP_AE_EQ_FILTER8_PEAK=y
CONFIG_GMF_EQ_FILTER8_TYPE=3
CONFIG_GMF_EQ_FILTER8_FC=4000
CONFIG_GMF_EQ_FILTER8_QX1000=1414
CONFIG_GMF_EQ_FILTER8_GAINX10=0
CONFIG_ESP_AE_EQ_FILTER9_PEAK=y
CONFIG_GMF_EQ_FILTER9_TYPE=3
CONFIG_GMF_EQ_FILTER9_FC=8000
CONFIG_GMF_EQ_FILTER9_QX1000=1414
CONFIG_GMF_EQ_FILTER9_GAINX10=0
CONFIG_ESP_AE_EQ_FILTER10_PEAK=y
CONFIG_GMF_EQ_FILTER10_TYPE=3
CONFIG_GMF_EQ_FILTER10_FC=16000
CONFIG_GMF_EQ_FILTER10_QX1000=1414
CONFIG_GMF_EQ_FILTER10_GAINX10=0

CONFIG_GMF_AUDIO_EFFECT_DRC_SAMPLE_RATE=48000
CONFIG_GMF_AUDIO_EFFECT_DRC_CHANNEL=2
CONFIG_GMF_AUDIO_EFFECT_DRC_BITS_PER_SAMPLE=16
CONFIG_GMF_AUDIO_EFFECT_DRC_ATTACK_TIME=10
CONFIG_GMF_AUDIO_EFFECT_DRC_RELEASE_TIME=80
CONFIG_GMF_AUDIO_EFFECT_DRC_HOLD_TIME=3
CONFIG_GMF_AUDIO_EFFECT_DRC_MAKEUP_X10=0
CONFIG_GMF_AUDIO_EFFECT_DRC_KNEE_X10=10
CONFIG_GMF_AUDIO_EFFECT_DRC_POINT_NUM=2
CONFIG_GMF_AUDIO_EFFECT_DRC_POINT1_X10=0
CONFIG_GMF_AUDIO_EFFECT_DRC_POINT1_Y10=0
CONFIG_GMF_AUDIO_EFFECT_DRC_POINT2_X10=-1000
CONFIG_GMF_AUDIO_EFFECT_DRC_POINT2_Y10=-1000

CONFIG_GMF_AUDIO_EFFECT_MBC_SAMPLE_RATE=48000
CONFIG_GMF_AUDIO_EFFECT_MBC_CHANNEL=2
CONFIG_GMF_AUDIO_EFFECT_MBC_BITS_PER_SAMPLE=16
CONFIG_GMF_AUDIO_EFFECT_MBC_FC_LOW=400
CONFIG_GMF_AUDIO_EFFECT_MBC_FC_MID=2100
CONFIG_GMF_AUDIO_EFFECT_MBC_FC_HIGH=6000
CONFIG_GMF_AUDIO_EFFECT_MBC_BAND1_THRESHOLD_X10=-1
CONFIG_GMF_AUDIO_EFFECT_MBC_BAND1_RATIO_X10=10
CONFIG_GMF_AUDIO_EFFECT_MBC_BAND1_MAKEUP_X10=0
CONFIG_GMF_AUDIO_EFFECT_MBC_BAND1_ATTACK_TIME=10
CONFIG_GMF_AUDIO_EFFECT_MBC_BAND1_RELEASE_TIME=100
CONFIG_GMF_AUDIO_EFFECT_MBC_BAND1_HOLD_TIME=0
CONFIG_GMF_AUDIO_EFFECT_MBC_BAND1_KNEE_X10=0
CONFIG_GMF_AUDIO_EFFECT_MBC_BAND2_THRESHOLD_X10=-180
CONFIG_GMF_AUDIO_EFFECT_MBC_BAND2_RATIO_X10=40
CONFIG_GMF_AUDIO_EFFECT_MBC_BAND2_MAKEUP_X10=60
CONFIG_GMF_AUDIO_EFFECT_MBC_BAND2_ATTACK_TIME=1
CONFIG_GMF_AUDIO_EFFECT_MBC_BAND2_RELEASE_TIME=200
CONFIG_GMF_AUDIO_EFFECT_MBC_BAND2_HOLD_TIME=0
CONFIG_GMF_AUDIO_EFFECT_MBC_BAND2_KNEE_X10=50
CONFIG_GMF_AUDIO_EFFECT_MBC_BAND3_THRESHOLD_X10=-200
CONFIG_GMF_AUDIO_EFFECT_MBC_BAND3_RATIO_X10=40
CONFIG_GMF_AUDIO_EFFECT_MBC_BAND3_MAKEUP_X10=70
CONFIG_GMF_AUDIO_EFFECT_MBC_BAND3_ATTACK_TIME=1
CONFIG_GMF_AUDIO_EFFECT_MBC_BAND3_RELEASE_TIME=200
CONFIG_GMF_AUDIO_EFFECT_MBC_BAND3_HOLD_TIME=0
CONFIG_GMF_AUDIO_EFFECT_MBC_BAND3_KNEE_X10=50
CONFIG_GMF_AUDIO_EFFECT_MBC_BAND4_THRESHOLD_X10=-1
CONFIG_GMF_AUDIO_EFFECT_MBC_BAND4_RATIO_X10=10
CONFIG_GMF_AUDIO_EFFECT_MBC_BAND4_MAKEUP_X10=0
CONFIG_GMF_AUDIO_EFFECT_MBC_BAND4_ATTACK_TIME=10
CONFIG_GMF_AUDIO_EFFECT_MBC_BAND4_RELEASE_TIME=100
CONFIG_GMF_AUDIO_EFFECT_MBC_BAND4_HOLD_TIME=0
CONFIG_GMF_AUDIO_EFFECT_MBC_BAND4_KNEE_X10=0

#
# Audio Decoder Configuration
#
CONFIG_AUDIO_DECODER_AAC_SUPPORT=n
CONFIG_AUDIO_DECODER_G711_SUPPORT=n
CONFIG_AUDIO_DECODER_AMRNB_SUPPORT=n
CONFIG_AUDIO_DECODER_AMRWB_SUPPORT=n
CONFIG_AUDIO_DECODER_FLAC_SUPPORT=n
CONFIG_AUDIO_DECODER_OPUS_SUPPORT=n
CONFIG_AUDIO_DECODER_VORBIS_SUPPORT=n
CONFIG_AUDIO_DECODER_ADPCM_SUPPORT=n
CONFIG_AUDIO_DECODER_ALAC_SUPPORT=n
CONFIG_AUDIO_DECODER_SBC_SUPPORT=n
CONFIG_AUDIO_DECODER_LC3_SUPPORT=n
```

## gmf_examples/basic_examples/pipeline_http_download_to_sdcard/sdkconfig.defaults
```kconfig
#
# Serial flasher config
#
CONFIG_ESPTOOLPY_FLASHMODE_QIO=y
CONFIG_ESPTOOLPY_FLASHFREQ_80M=y
CONFIG_ESPTOOLPY_FLASHSIZE_4MB=y

#
# Partition Table
#
CONFIG_PARTITION_TABLE_SINGLE_APP_LARGE=y

#
# Compiler options
#
CONFIG_COMPILER_OPTIMIZATION_PERF=y

#
# FreeRTOS
#
CONFIG_FREERTOS_HZ=1000
CONFIG_FREERTOS_ENABLE_BACKWARD_COMPATIBILITY=y
CONFIG_FREERTOS_GENERATE_RUN_TIME_STATS=y
CONFIG_FREERTOS_VTASKLIST_INCLUDE_COREID=y

#
# ESP PSRAM
#
CONFIG_SPIRAM=y
CONFIG_SPIRAM_SPEED_80M=y
CONFIG_SPIRAM_TRY_ALLOCATE_WIFI_LWIP=y
CONFIG_FREERTOS_TASK_CREATE_ALLOW_EXT_MEM=y
CONFIG_SPIRAM_MALLOC_ALWAYSINTERNAL=128

#
# Wi-Fi
#
CONFIG_ESP_WIFI_STATIC_RX_BUFFER_NUM=16
CONFIG_ESP_WIFI_STATIC_TX_BUFFER_NUM=8
CONFIG_ESP_WIFI_DYNAMIC_RX_BUFFER_NUM=128
CONFIG_ESP_WIFI_DYNAMIC_TX_BUFFER_NUM=32
CONFIG_ESP_WIFI_AMPDU_TX_ENABLED=y
CONFIG_ESP_WIFI_TX_BA_WIN=16
CONFIG_ESP_WIFI_AMPDU_RX_ENABLED=y
CONFIG_ESP_WIFI_RX_BA_WIN=32
CONFIG_ESP_WIFI_TASK_PINNED_TO_CORE_0=y
CONFIG_ESP_WIFI_RX_IRAM_OPT=y
CONFIG_ESP_WIFI_IRAM_OPT=y

#
# LWIP
#
# CONFIG_LWIP_IRAM_OPTIMIZATION is not set
CONFIG_LWIP_TCPIP_TASK_AFFINITY_CPU0=y
CONFIG_LWIP_TCP_SND_BUF_DEFAULT=16384
CONFIG_LWIP_TCP_WND_DEFAULT=65535
CONFIG_LWIP_TCP_RECVMBOX_SIZE=64
CONFIG_LWIP_UDP_RECVMBOX_SIZE=64
CONFIG_LWIP_TCPIP_RECVMBOX_SIZE=64

#
# FAT Filesystem support
#
CONFIG_FATFS_LFN_HEAP=y

#
# GMF IO Reader
#
CONFIG_GMF_IO_INIT_CODEC_DEV_RX=n
CONFIG_GMF_IO_INIT_FILE_READER=n
CONFIG_GMF_IO_INIT_FLASH_READER=n
CONFIG_GMF_IO_INIT_HTTP_READER=y

#
# HTTP Reader Configuration
#
CONFIG_GMF_IO_HTTP_READER_TASK_CORE=1
CONFIG_GMF_IO_HTTP_READER_STACK_IN_EXT=y
CONFIG_GMF_IO_HTTP_READER_OUT_BUF_SIZE=131072

#
# GMF IO Writer
#
CONFIG_GMF_IO_INIT_CODEC_DEV_TX=n
CONFIG_GMF_IO_INIT_HTTP_WRITER=n
CONFIG_GMF_IO_INIT_FILE_WRITER=y

#
# GMF Audio Codec
#
CONFIG_GMF_AUDIO_CODEC_INIT_DECODER=n
CONFIG_GMF_AUDIO_CODEC_INIT_ENCODER=n

#
# IO File Configuration
#
CONFIG_GMF_IO_FILE_WRITE_CACHE_SIZE=32768

#
# GMF Miscellaneous
#
CONFIG_GMF_MISC_INIT_COPIER=y
```

## gmf_examples/basic_examples/pipeline_http_download_to_sdcard/sdkconfig.defaults.esp32
```kconfig
#
# System Settings
#
CONFIG_ESP_DEFAULT_CPU_FREQ_MHZ_240=y

CONFIG_AUDIO_BOARD="LYRAT_MINI_V1"

#
# IO File Configuration
#
CONFIG_GMF_IO_FILE_WRITE_CACHE_SIZE=8192
```

## gmf_examples/basic_examples/pipeline_http_download_to_sdcard/sdkconfig.defaults.esp32p4
```kconfig
#
# System Settings
#
CONFIG_ESP_DEFAULT_CPU_FREQ_MHZ_360=y

#
# Chip revision
#
CONFIG_ESP32P4_SELECTS_REV_LESS_V3=y
CONFIG_ESP32P4_REV_MIN_1=y

#
# SPI RAM config
#
CONFIG_IDF_EXPERIMENTAL_FEATURES=y
CONFIG_SPIRAM_SPEED_200M=y

#
# IO File Configuration
#
CONFIG_GMF_IO_FILE_WRITE_CACHE_SIZE=65536

#
# Wi-Fi Remote
#
CONFIG_SLAVE_IDF_TARGET_ESP32C6=y
CONFIG_ESP_WIFI_REMOTE_LIBRARY_HOSTED=y
CONFIG_EXAMPLE_CONNECT_WIFI=y

#
# Wi-Fi configuration
#
CONFIG_WIFI_RMT_STATIC_RX_BUFFER_NUM=16
CONFIG_WIFI_RMT_DYNAMIC_RX_BUFFER_NUM=64
CONFIG_WIFI_RMT_STATIC_TX_BUFFER_NUM=10
CONFIG_WIFI_RMT_CACHE_TX_BUFFER_NUM=16
CONFIG_WIFI_RMT_AMPDU_TX_ENABLED=y
CONFIG_WIFI_RMT_TX_BA_WIN=6
CONFIG_WIFI_RMT_AMPDU_RX_ENABLED=y
CONFIG_WIFI_RMT_RX_BA_WIN=32
CONFIG_WIFI_RMT_IRAM_OPT=y
CONFIG_WIFI_RMT_RX_IRAM_OPT=y
CONFIG_WIFI_RMT_EXTRA_IRAM_OPT=n
CONFIG_WIFI_RMT_SLP_IRAM_OPT=n
```

## gmf_examples/basic_examples/pipeline_http_download_to_sdcard/sdkconfig.defaults.esp32s3
```kconfig
#
# System Settings
#
CONFIG_ESP_DEFAULT_CPU_FREQ_MHZ_240=y
CONFIG_ESP32S3_DATA_CACHE_LINE_64B=y

#
# SPI RAM config
#
CONFIG_SPIRAM_MODE_OCT=y
```

## gmf_examples/basic_examples/pipeline_loop_play_no_gap/sdkconfig.defaults
```kconfig
#
# Serial flasher config
#
CONFIG_ESPTOOLPY_FLASHSIZE_4MB=y
CONFIG_ESPTOOLPY_FLASHFREQ_80M=y

#
# Partition Table
#
CONFIG_PARTITION_TABLE_CUSTOM=y
CONFIG_PARTITION_TABLE_CUSTOM_FILENAME="partitions.csv"

#
# Compiler options
#
CONFIG_COMPILER_OPTIMIZATION_PERF=y

#
# FreeRTOS
#
CONFIG_FREERTOS_HZ=1000
CONFIG_FREERTOS_ENABLE_BACKWARD_COMPATIBILITY=y

#
# ESP PSRAM
#
CONFIG_SPIRAM=y
CONFIG_SPIRAM_SPEED_80M=y
CONFIG_FREERTOS_TASK_CREATE_ALLOW_EXT_MEM=y
CONFIG_SPIRAM_MALLOC_ALWAYSINTERNAL=1024

#
# FAT Filesystem support
#
CONFIG_FATFS_LFN_HEAP=y
CONFIG_FATFS_VFS_FSTAT_BLKSIZE=0

#
# GMF IO Reader
#
CONFIG_GMF_IO_INIT_FILE_READER=y
CONFIG_GMF_IO_FILE_READ_CACHE_SIZE=4096
CONFIG_GMF_IO_INIT_CODEC_DEV_RX=n
CONFIG_GMF_IO_INIT_FLASH_READER=n
CONFIG_GMF_IO_INIT_HTTP_READER=n

#
# GMF IO Writer
#
CONFIG_GMF_IO_INIT_CODEC_DEV_TX=y
CONFIG_GMF_IO_INIT_FILE_WRITER=n
CONFIG_GMF_IO_INIT_HTTP_WRITER=n

#
# GMF Audio Codec
#
CONFIG_GMF_AUDIO_CODEC_INIT_DECODER=y
CONFIG_GMF_AUDIO_CODEC_DECODER_TYPE_MP3=y
CONFIG_GMF_AUDIO_CODEC_INIT_ENCODER=n

#
# GMF Audio Effects
#
CONFIG_GMF_AUDIO_EFFECT_INIT_CH_CVT=y
CONFIG_GMF_AUDIO_EFFECT_CH_CVT_DEST_CH=2
CONFIG_GMF_AUDIO_EFFECT_INIT_BIT_CVT=y
CONFIG_GMF_AUDIO_EFFECT_BIT_CVT_DEST_BITS=16
CONFIG_GMF_AUDIO_EFFECT_INIT_RATE_CVT=y
CONFIG_GMF_AUDIO_EFFECT_RATE_CVT_DEST_RATE=16000
CONFIG_GMF_AUDIO_EFFECT_RATE_CVT_COMPLEXITY=2
CONFIG_GMF_AUDIO_EFFECT_RATE_CVT_PERF_TYPE_SPEED=y
CONFIG_GMF_AUDIO_EFFECT_RATE_CVT_PERF_TYPE=1

#
# GMF AI Audio
#
CONFIG_GMF_AI_AUDIO_INIT_AEC=n
CONFIG_GMF_AI_AUDIO_INIT_WN=n
CONFIG_GMF_AI_AUDIO_INIT_AFE=n

#
# GMF Miscellaneous
#
CONFIG_GMF_MISC_INIT_COPIER=y

CONFIG_ESP_CONSOLE_UART_DEFAULT=y
CONFIG_ESP_CONSOLE_UART_BAUDRATE=1000000
```

## gmf_examples/basic_examples/pipeline_play_embed_music/sdkconfig.defaults
```kconfig
#
# Serial flasher config
#
CONFIG_ESPTOOLPY_BEFORE_RESET=y
CONFIG_ESPTOOLPY_FLASHSIZE_4MB=y
CONFIG_ESPTOOLPY_FLASHFREQ_80M=y

#
# Partition Table
#
CONFIG_PARTITION_TABLE_SINGLE_APP=y
CONFIG_PARTITION_TABLE_CUSTOM=y
CONFIG_PARTITION_TABLE_CUSTOM_FILENAME="partitions.csv"
CONFIG_PARTITION_TABLE_FILENAME="partitions.csv"
CONFIG_PARTITION_TABLE_OFFSET=0x8000
CONFIG_PARTITION_TABLE_MD5=y

#
# Compiler options
#
CONFIG_COMPILER_OPTIMIZATION_PERF=y

#
# FreeRTOS
#
CONFIG_FREERTOS_HZ=1000
CONFIG_FREERTOS_ENABLE_BACKWARD_COMPATIBILITY=y

#
# ESP PSRAM
#
CONFIG_SPIRAM=y
CONFIG_SPIRAM_SPEED_80M=y
CONFIG_SPIRAM_TRY_ALLOCATE_WIFI_LWIP=y
CONFIG_FREERTOS_TASK_CREATE_ALLOW_EXT_MEM=y
CONFIG_SPIRAM_MALLOC_ALWAYSINTERNAL=128

#
# GMF IO Reader
#
CONFIG_GMF_IO_INIT_FLASH_READER=y
CONFIG_GMF_IO_INIT_CODEC_DEV_RX=n
CONFIG_GMF_IO_INIT_FILE_READER=n
CONFIG_GMF_IO_INIT_HTTP_READER=n

#
# GMF IO Writer
#
CONFIG_GMF_IO_INIT_CODEC_DEV_TX=y
CONFIG_GMF_IO_INIT_FILE_WRITER=n
CONFIG_GMF_IO_INIT_HTTP_WRITER=n

#
# GMF Audio Codec
#
CONFIG_GMF_AUDIO_CODEC_INIT_DECODER=y
CONFIG_GMF_AUDIO_CODEC_DECODER_TYPE_AAC=y
CONFIG_GMF_AUDIO_CODEC_INIT_ENCODER=n

#
# GMF Audio Effects
#
CONFIG_GMF_AUDIO_EFFECT_INIT_CH_CVT=y
CONFIG_GMF_AUDIO_EFFECT_CH_CVT_DEST_CH=2
CONFIG_GMF_AUDIO_EFFECT_INIT_BIT_CVT=y
CONFIG_GMF_AUDIO_EFFECT_BIT_CVT_DEST_BITS=16
CONFIG_GMF_AUDIO_EFFECT_INIT_RATE_CVT=y
CONFIG_GMF_AUDIO_EFFECT_RATE_CVT_DEST_RATE=44100
CONFIG_GMF_AUDIO_EFFECT_RATE_CVT_COMPLEXITY=2
CONFIG_GMF_AUDIO_EFFECT_RATE_CVT_PERF_TYPE_SPEED=y
CONFIG_GMF_AUDIO_EFFECT_RATE_CVT_PERF_TYPE=1
```
