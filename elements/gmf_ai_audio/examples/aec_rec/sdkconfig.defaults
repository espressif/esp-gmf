## elements/gmf_ai_audio/examples/aec_rec/sdkconfig.defaults
```kconfig
#
# Bootloader config
#
CONFIG_BOOTLOADER_LOG_LEVEL_WARN=y

#
# Serial flasher config
#
CONFIG_ESPTOOLPY_FLASH_MODE_AUTO_DETECT=y
CONFIG_ESPTOOLPY_FLASHMODE_DIO=y
CONFIG_ESPTOOLPY_FLASH_SAMPLE_MODE_STR=y
CONFIG_ESPTOOLPY_FLASHMODE="dio"
CONFIG_ESPTOOLPY_FLASHFREQ_80M=y
CONFIG_ESPTOOLPY_FLASHFREQ="80m"
CONFIG_ESPTOOLPY_FLASHSIZE_8MB=y
CONFIG_ESPTOOLPY_FLASHSIZE="8MB"

#
# Partition Table
#
CONFIG_PARTITION_TABLE_CUSTOM=y
CONFIG_PARTITION_TABLE_CUSTOM_FILENAME="partitions.csv"
CONFIG_PARTITION_TABLE_FILENAME="partitions.csv"
CONFIG_PARTITION_TABLE_OFFSET=0xA000
CONFIG_PARTITION_TABLE_MD5=y
# end of Partition Table


#
# Compiler options
#
CONFIG_COMPILER_OPTIMIZATION_PERF=y
CONFIG_COMPILER_DISABLE_DEFAULT_ERRORS=y
# end of Compiler options

#
# ESP PSRAM
#
CONFIG_SPIRAM=y
CONFIG_SPIRAM_TYPE_AUTO=y
CONFIG_SPIRAM_ALLOW_STACK_EXTERNAL_MEMORY=y
CONFIG_SPIRAM_SPEED_80M=y
CONFIG_SPIRAM_SPEED=80

CONFIG_FATFS_LFN_HEAP=y

CONFIG_FREERTOS_HZ=1000
CONFIG_FREERTOS_USE_TRACE_FACILITY=y
CONFIG_FREERTOS_USE_STATS_FORMATTING_FUNCTIONS=y
# CONFIG_FREERTOS_USE_LIST_DATA_INTEGRITY_CHECK_BYTES is not set
CONFIG_FREERTOS_VTASKLIST_INCLUDE_COREID=y
CONFIG_FREERTOS_GENERATE_RUN_TIME_STATS=y

CONFIG_GMF_AI_AUDIO_AEC_INPUT_SAMPLING_RATE_8K=y
CONFIG_GMF_AI_AUDIO_AEC_CH_ALLOCATION="RM"

#
# GMF IO (codec device record/playback and file reader are used)
#
CONFIG_GMF_IO_INIT_CODEC_DEV_RX=y
CONFIG_GMF_IO_INIT_CODEC_DEV_TX=y
CONFIG_GMF_IO_INIT_FILE_READER=y
CONFIG_GMF_IO_INIT_FILE_WRITER=n
CONFIG_GMF_IO_INIT_FLASH_READER=n
CONFIG_GMF_IO_INIT_HTTP_READER=n
CONFIG_GMF_IO_INIT_HTTP_WRITER=n

#
# GMF AI Audio (only AEC element is used)
#
CONFIG_GMF_AI_AUDIO_INIT_AEC=y
CONFIG_GMF_AI_AUDIO_INIT_WN=n
CONFIG_GMF_AI_AUDIO_INIT_AFE=n
CONFIG_GMF_AI_AUDIO_INIT_VAD=n
CONFIG_GMF_AI_AUDIO_INIT_NS=n
CONFIG_GMF_AI_AUDIO_INIT_DOA=n

#
# GMF Audio Effects (only rate/channel/bit conversion is used)
#
CONFIG_GMF_AUDIO_EFFECT_INIT_RATE_CVT=y
CONFIG_GMF_AUDIO_EFFECT_INIT_CH_CVT=y
CONFIG_GMF_AUDIO_EFFECT_INIT_BIT_CVT=y
CONFIG_GMF_AUDIO_EFFECT_INIT_ALC=n
CONFIG_GMF_AUDIO_EFFECT_INIT_ASRC=n
CONFIG_GMF_AUDIO_EFFECT_INIT_DEINTERLEAVE=n
CONFIG_GMF_AUDIO_EFFECT_INIT_INTERLEAVE=n
CONFIG_GMF_AUDIO_EFFECT_INIT_MIXER=n
CONFIG_GMF_AUDIO_EFFECT_INIT_EQ=n
CONFIG_GMF_AUDIO_EFFECT_INIT_DRC=n
CONFIG_GMF_AUDIO_EFFECT_INIT_MBC=n
CONFIG_GMF_AUDIO_EFFECT_INIT_HOWL=n
CONFIG_GMF_AUDIO_EFFECT_INIT_SONIC=n
CONFIG_GMF_AUDIO_EFFECT_INIT_FADE=n

#
# GMF Miscellaneous (unused)
#
CONFIG_GMF_MISC_INIT_COPIER=n

#
# GMF Video Effects (unused)
#
CONFIG_GMF_VIDEO_EFFECTS_INIT_PPA=n
CONFIG_GMF_VIDEO_EFFECTS_INIT_FPS_CONVERT=n
CONFIG_GMF_VIDEO_EFFECTS_INIT_OVERLAY=n
CONFIG_GMF_VIDEO_EFFECTS_INIT_SCALE=n
CONFIG_GMF_VIDEO_EFFECTS_INIT_CROP=n
CONFIG_GMF_VIDEO_EFFECTS_INIT_ROTATE=n
CONFIG_GMF_VIDEO_EFFECTS_INIT_COLOR_CONVERT=n

#
# GMF Audio Codec (only MP3 decoder for play pipeline)
#
CONFIG_GMF_AUDIO_CODEC_INIT_DECODER=y
CONFIG_GMF_AUDIO_CODEC_DECODER_TYPE_MP3=y
CONFIG_GMF_AUDIO_CODEC_INIT_ENCODER=n

#
# GMF Audio Muxer (unused)
#
CONFIG_GMF_AUDIO_MUXER_INIT=n

#
# GMF Video Codec (unused)
#
CONFIG_GMF_VIDEO_CODEC_INIT_DECODER=n
CONFIG_GMF_VIDEO_CODEC_INIT_ENCODER=n

#
# Audio Decoder Configuration
#
CONFIG_AUDIO_DECODER_AAC_SUPPORT=n
CONFIG_AUDIO_DECODER_MP3_SUPPORT=y
CONFIG_AUDIO_DECODER_G711_SUPPORT=n
CONFIG_AUDIO_DECODER_AMRNB_SUPPORT=n
CONFIG_AUDIO_DECODER_AMRWB_SUPPORT=n
CONFIG_AUDIO_DECODER_FLAC_SUPPORT=n
CONFIG_AUDIO_DECODER_OPUS_SUPPORT=n
CONFIG_AUDIO_DECODER_VORBIS_SUPPORT=n
CONFIG_AUDIO_DECODER_ADPCM_SUPPORT=n
CONFIG_AUDIO_DECODER_ALAC_SUPPORT=n
CONFIG_AUDIO_DECODER_PCM_SUPPORT=n
CONFIG_AUDIO_DECODER_SBC_SUPPORT=n
CONFIG_AUDIO_DECODER_LC3_SUPPORT=n
CONFIG_AUDIO_DECODER_G722_SUPPORT=n

#
# Audio Simple Decoder Configuration
#
CONFIG_AUDIO_SIMPLE_DEC_WAV_SUPPORT=n
CONFIG_AUDIO_SIMPLE_DEC_M4A_SUPPORT=n
CONFIG_AUDIO_SIMPLE_DEC_TS_SUPPORT=n
CONFIG_AUDIO_SIMPLE_DEC_OGG_SUPPORT=n

#
# Audio Encoder Configuration
#
CONFIG_AUDIO_ENCODER_AAC_SUPPORT=n
CONFIG_AUDIO_ENCODER_G711_SUPPORT=n
CONFIG_AUDIO_ENCODER_AMRNB_SUPPORT=n
CONFIG_AUDIO_ENCODER_AMRWB_SUPPORT=n
CONFIG_AUDIO_ENCODER_OPUS_SUPPORT=n
CONFIG_AUDIO_ENCODER_ADPCM_SUPPORT=n
CONFIG_AUDIO_ENCODER_ALAC_SUPPORT=n
CONFIG_AUDIO_ENCODER_PCM_SUPPORT=n
CONFIG_AUDIO_ENCODER_SBC_SUPPORT=n
CONFIG_AUDIO_ENCODER_LC3_SUPPORT=n
CONFIG_AUDIO_ENCODER_G722_SUPPORT=n

#
# ESP_Muxer Configuration
#
CONFIG_ESP_MUXER_MP4_SUPPORT=n
CONFIG_ESP_MUXER_TS_SUPPORT=n
CONFIG_ESP_MUXER_OGG_SUPPORT=n
CONFIG_ESP_MUXER_WAV_SUPPORT=n
CONFIG_ESP_MUXER_FLV_SUPPORT=n
CONFIG_ESP_MUXER_CAF_SUPPORT=n
CONFIG_ESP_MUXER_AVI_SUPPORT=n

#
# Video Decoder Configuration
#
CONFIG_VIDEO_DECODER_SW_H264_SUPPORT=n
CONFIG_VIDEO_DECODER_SW_MJPEG_SUPPORT=n
CONFIG_VIDEO_DECODER_HW_MJPEG_SUPPORT=n

#
# Video Encoder Configuration
#
CONFIG_VIDEO_ENCODER_HW_H264_SUPPORT=n
CONFIG_VIDEO_ENCODER_SW_H264_SUPPORT=n
CONFIG_VIDEO_ENCODER_HW_MJPEG_SUPPORT=n
CONFIG_VIDEO_ENCODER_SW_MJPEG_SUPPORT=n
```

## elements/gmf_ai_audio/examples/aec_rec/sdkconfig.defaults.esp32s31
```kconfig
CONFIG_COMPILER_OPTIMIZATION_PERF=y
CONFIG_COMPILER_DISABLE_DEFAULT_ERRORS=y

CONFIG_GMF_AI_AUDIO_AEC_INPUT_SAMPLING_RATE_16K=y
CONFIG_GMF_AI_AUDIO_AEC_CH_ALLOCATION="MRMN"
```

## elements/gmf_ai_audio/examples/wwe/sdkconfig.defaults
```kconfig
#
# Bootloader config
#
CONFIG_BOOTLOADER_LOG_LEVEL_WARN=y

#
# Serial flasher config
#
CONFIG_ESPTOOLPY_FLASH_MODE_AUTO_DETECT=y
CONFIG_ESPTOOLPY_FLASHMODE_DIO=y
CONFIG_ESPTOOLPY_FLASH_SAMPLE_MODE_STR=y
CONFIG_ESPTOOLPY_FLASHMODE="dio"
CONFIG_ESPTOOLPY_FLASHFREQ_80M=y
CONFIG_ESPTOOLPY_FLASHFREQ="80m"
CONFIG_ESPTOOLPY_FLASHSIZE_8MB=y
CONFIG_ESPTOOLPY_FLASHSIZE="8MB"

#
# Compiler options
#
CONFIG_COMPILER_OPTIMIZATION_PERF=y
CONFIG_COMPILER_DISABLE_DEFAULT_ERRORS=y
# end of Compiler options

#
# ESP PSRAM
#
CONFIG_SPIRAM=y
CONFIG_SPIRAM_TYPE_AUTO=y
CONFIG_SPIRAM_ALLOW_STACK_EXTERNAL_MEMORY=y

CONFIG_FATFS_LFN_HEAP=y

CONFIG_FREERTOS_HZ=1000
CONFIG_FREERTOS_USE_TRACE_FACILITY=y
CONFIG_FREERTOS_USE_STATS_FORMATTING_FUNCTIONS=y
# CONFIG_FREERTOS_USE_LIST_DATA_INTEGRITY_CHECK_BYTES is not set
CONFIG_FREERTOS_VTASKLIST_INCLUDE_COREID=y
CONFIG_FREERTOS_GENERATE_RUN_TIME_STATS=y

#
# GMF IO (only codec device reader is used)
#
CONFIG_GMF_IO_INIT_CODEC_DEV_RX=y
CONFIG_GMF_IO_INIT_CODEC_DEV_TX=n
CONFIG_GMF_IO_INIT_FILE_READER=n
CONFIG_GMF_IO_INIT_FILE_WRITER=n
CONFIG_GMF_IO_INIT_FLASH_READER=n
CONFIG_GMF_IO_INIT_HTTP_READER=n
CONFIG_GMF_IO_INIT_HTTP_WRITER=n

#
# GMF Audio Effects (unused)
#
CONFIG_GMF_AUDIO_EFFECT_INIT_ALC=n
CONFIG_GMF_AUDIO_EFFECT_INIT_CH_CVT=n
CONFIG_GMF_AUDIO_EFFECT_INIT_BIT_CVT=n
CONFIG_GMF_AUDIO_EFFECT_INIT_RATE_CVT=n
CONFIG_GMF_AUDIO_EFFECT_INIT_ASRC=n
CONFIG_GMF_AUDIO_EFFECT_INIT_DEINTERLEAVE=n
CONFIG_GMF_AUDIO_EFFECT_INIT_INTERLEAVE=n
CONFIG_GMF_AUDIO_EFFECT_INIT_MIXER=n
CONFIG_GMF_AUDIO_EFFECT_INIT_EQ=n
CONFIG_GMF_AUDIO_EFFECT_INIT_DRC=n
CONFIG_GMF_AUDIO_EFFECT_INIT_MBC=n
CONFIG_GMF_AUDIO_EFFECT_INIT_HOWL=n
CONFIG_GMF_AUDIO_EFFECT_INIT_SONIC=n
CONFIG_GMF_AUDIO_EFFECT_INIT_FADE=n

#
# GMF Miscellaneous (unused)
#
CONFIG_GMF_MISC_INIT_COPIER=n

#
# GMF Video Effects (unused)
#
CONFIG_GMF_VIDEO_EFFECTS_INIT_PPA=n
CONFIG_GMF_VIDEO_EFFECTS_INIT_FPS_CONVERT=n
CONFIG_GMF_VIDEO_EFFECTS_INIT_OVERLAY=n
CONFIG_GMF_VIDEO_EFFECTS_INIT_SCALE=n
CONFIG_GMF_VIDEO_EFFECTS_INIT_CROP=n
CONFIG_GMF_VIDEO_EFFECTS_INIT_ROTATE=n
CONFIG_GMF_VIDEO_EFFECTS_INIT_COLOR_CONVERT=n

#
# GMF Audio Codec (unused in WWE)
#
CONFIG_GMF_AUDIO_CODEC_INIT_DECODER=n
CONFIG_GMF_AUDIO_CODEC_INIT_ENCODER=n

#
# GMF Audio Muxer (unused)
#
CONFIG_GMF_AUDIO_MUXER_INIT=n

#
# GMF Video Codec (unused)
#
CONFIG_GMF_VIDEO_CODEC_INIT_DECODER=n
CONFIG_GMF_VIDEO_CODEC_INIT_ENCODER=n

#
# Audio Decoder Configuration
#
CONFIG_AUDIO_DECODER_AAC_SUPPORT=n
CONFIG_AUDIO_DECODER_MP3_SUPPORT=n
CONFIG_AUDIO_DECODER_G711_SUPPORT=n
CONFIG_AUDIO_DECODER_AMRNB_SUPPORT=n
CONFIG_AUDIO_DECODER_AMRWB_SUPPORT=n
CONFIG_AUDIO_DECODER_FLAC_SUPPORT=n
CONFIG_AUDIO_DECODER_OPUS_SUPPORT=n
CONFIG_AUDIO_DECODER_VORBIS_SUPPORT=n
CONFIG_AUDIO_DECODER_ADPCM_SUPPORT=n
CONFIG_AUDIO_DECODER_ALAC_SUPPORT=n
CONFIG_AUDIO_DECODER_PCM_SUPPORT=n
CONFIG_AUDIO_DECODER_SBC_SUPPORT=n
CONFIG_AUDIO_DECODER_LC3_SUPPORT=n
CONFIG_AUDIO_DECODER_G722_SUPPORT=n

#
# Audio Simple Decoder Configuration
#
CONFIG_AUDIO_SIMPLE_DEC_WAV_SUPPORT=n
CONFIG_AUDIO_SIMPLE_DEC_M4A_SUPPORT=n
CONFIG_AUDIO_SIMPLE_DEC_TS_SUPPORT=n
CONFIG_AUDIO_SIMPLE_DEC_OGG_SUPPORT=n

#
# Audio Encoder Configuration
#
CONFIG_AUDIO_ENCODER_AAC_SUPPORT=n
CONFIG_AUDIO_ENCODER_G711_SUPPORT=n
CONFIG_AUDIO_ENCODER_AMRNB_SUPPORT=n
CONFIG_AUDIO_ENCODER_AMRWB_SUPPORT=n
CONFIG_AUDIO_ENCODER_OPUS_SUPPORT=n
CONFIG_AUDIO_ENCODER_ADPCM_SUPPORT=n
CONFIG_AUDIO_ENCODER_ALAC_SUPPORT=n
CONFIG_AUDIO_ENCODER_PCM_SUPPORT=n
CONFIG_AUDIO_ENCODER_SBC_SUPPORT=n
CONFIG_AUDIO_ENCODER_LC3_SUPPORT=n
CONFIG_AUDIO_ENCODER_G722_SUPPORT=n

#
# ESP_Muxer Configuration
#
CONFIG_ESP_MUXER_MP4_SUPPORT=n
CONFIG_ESP_MUXER_TS_SUPPORT=n
CONFIG_ESP_MUXER_OGG_SUPPORT=n
CONFIG_ESP_MUXER_WAV_SUPPORT=n
CONFIG_ESP_MUXER_FLV_SUPPORT=n
CONFIG_ESP_MUXER_CAF_SUPPORT=n
CONFIG_ESP_MUXER_AVI_SUPPORT=n

#
# Video Decoder Configuration
#
CONFIG_VIDEO_DECODER_SW_H264_SUPPORT=n
CONFIG_VIDEO_DECODER_SW_MJPEG_SUPPORT=n
CONFIG_VIDEO_DECODER_HW_MJPEG_SUPPORT=n

#
# Video Encoder Configuration
#
CONFIG_VIDEO_ENCODER_HW_H264_SUPPORT=n
CONFIG_VIDEO_ENCODER_SW_H264_SUPPORT=n
CONFIG_VIDEO_ENCODER_HW_MJPEG_SUPPORT=n
CONFIG_VIDEO_ENCODER_SW_MJPEG_SUPPORT=n
```

## elements/gmf_ai_audio/examples/wwe/sdkconfig.defaults.esp32c5
```kconfig
CONFIG_COMPILER_DISABLE_DEFAULT_ERRORS=y

#
# Serial flasher config
#
CONFIG_ESPTOOLPY_FLASHSIZE_8MB=y
CONFIG_ESPTOOLPY_FLASHSIZE="8MB"

#
# Partition Table
#
CONFIG_PARTITION_TABLE_CUSTOM=y
CONFIG_PARTITION_TABLE_CUSTOM_FILENAME="partitions_8M.csv"
CONFIG_PARTITION_TABLE_FILENAME="partitions_8M.csv"
CONFIG_PARTITION_TABLE_OFFSET=0xA000
CONFIG_PARTITION_TABLE_MD5=y
# end of Partition Table

#
# ESP Speech Recognition
#
CONFIG_AFE_INTERFACE_V1=y
CONFIG_SR_NSN_WEBRTC=y
CONFIG_SR_VADN_WEBRTC=y

#
# Load Multiple Wake Words
#
CONFIG_SR_WN_WN9S_HILEXIN=y
# CONFIG_SR_WN_WN9S_HIESP is not set
# CONFIG_SR_WN_WN9S_NIHAOXIAOZHI is not set
# CONFIG_SR_WN_WN9S_HIJASON is not set
# end of Load Multiple Wake Words

CONFIG_SR_MN_CN_NONE=y
CONFIG_SR_MN_EN_NONE=y
# end of ESP Speech Recognition

CONFIG_GMF_AI_AUDIO_INIT_WN=y
CONFIG_GMF_AI_AUDIO_INIT_AEC=n
CONFIG_GMF_AI_AUDIO_INIT_AFE=n
CONFIG_GMF_AI_AUDIO_INIT_VAD=n
CONFIG_GMF_AI_AUDIO_INIT_NS=n
CONFIG_GMF_AI_AUDIO_INIT_DOA=n
CONFIG_GMF_AI_AUDIO_WN_CH_ALLOCATION="MR"

CONFIG_ESP_CONSOLE_USB_SERIAL_JTAG=y
```

## elements/gmf_ai_audio/test_apps/sdkconfig.defaults
```kconfig
# Unity interactive menu runner
CONFIG_ESP_TASK_WDT_INIT=n
CONFIG_ESP_GDBSTUB_ENABLED=y
CONFIG_UNITY_ENABLE_64BIT=y
CONFIG_UNITY_CRITICAL_LEAK_LEVEL_GENERAL=1400
CONFIG_COMPILER_DISABLE_DEFAULT_ERRORS=y

#
# ESP Speech Recognition (common)
#
CONFIG_MODEL_IN_FLASH=y
CONFIG_AFE_INTERFACE_V1=y
CONFIG_SR_NSN_WEBRTC=y
CONFIG_SR_VADN_WEBRTC=y

#
# GMF AI Audio
#
CONFIG_GMF_AI_AUDIO_INIT_AEC=y
CONFIG_GMF_AI_AUDIO_AEC_FILTER_LEN=4
CONFIG_GMF_AI_AUDIO_AEC_CH_ALLOCATION="RMNM"
```

## elements/gmf_ai_audio/test_apps/sdkconfig.defaults.esp32
```kconfig
CONFIG_IDF_TARGET="esp32"

CONFIG_ESPTOOLPY_FLASHSIZE_16MB=y
CONFIG_ESPTOOLPY_FLASHSIZE="16MB"

#
# Partition Table
#
CONFIG_PARTITION_TABLE_CUSTOM=y
CONFIG_PARTITION_TABLE_CUSTOM_FILENAME="partitions_16m.csv"
CONFIG_PARTITION_TABLE_FILENAME="partitions_16m.csv"
CONFIG_PARTITION_TABLE_OFFSET=0xA000
CONFIG_PARTITION_TABLE_MD5=y
# end of Partition Table

#
# ESP Speech Recognition models
#
CONFIG_SR_WN_WN9_HILEXIN=y
```

## elements/gmf_ai_audio/test_apps/sdkconfig.defaults.esp32p4
```kconfig
CONFIG_IDF_TARGET="esp32p4"

CONFIG_FLASHMODE_QIO=y
CONFIG_ESPTOOLPY_FLASHSIZE_16MB=y
CONFIG_ESPTOOLPY_FLASHSIZE="16MB"

CONFIG_SPIRAM=y
CONFIG_SPIRAM_SPEED_200M=y

# Route console over USB-Serial-JTAG so pytest-embedded reaches the unity menu.
CONFIG_ESP_CONSOLE_USB_SERIAL_JTAG=y
CONFIG_ESP_CONSOLE_SECONDARY_NONE=y

#
# Partition Table
#
CONFIG_PARTITION_TABLE_CUSTOM=y
CONFIG_PARTITION_TABLE_CUSTOM_FILENAME="partitions_16m.csv"
CONFIG_PARTITION_TABLE_FILENAME="partitions_16m.csv"
CONFIG_PARTITION_TABLE_OFFSET=0xA000
CONFIG_PARTITION_TABLE_MD5=y
# end of Partition Table

#
# ESP Speech Recognition models
#
CONFIG_SR_WN_WN9_HILEXIN=y
CONFIG_SR_MN_CN_MULTINET7_QUANT=y
CONFIG_SR_MN_EN_NONE=y
```

## elements/gmf_ai_audio/test_apps/sdkconfig.defaults.esp32s31
```kconfig
CONFIG_IDF_TARGET="esp32s31"

CONFIG_ESPTOOLPY_FLASHFREQ_80M=y
CONFIG_ESPTOOLPY_FLASHFREQ="80m"
CONFIG_ESPTOOLPY_FLASHSIZE_16MB=y
CONFIG_ESPTOOLPY_FLASHSIZE="16MB"

#
# Partition Table
#
CONFIG_PARTITION_TABLE_CUSTOM=y
CONFIG_PARTITION_TABLE_CUSTOM_FILENAME="partitions_16m.csv"
CONFIG_PARTITION_TABLE_FILENAME="partitions_16m.csv"
CONFIG_PARTITION_TABLE_OFFSET=0xA000
CONFIG_PARTITION_TABLE_MD5=y
# end of Partition Table

#
# ESP Speech Recognition models
#
CONFIG_SR_WN_WN9_HILEXIN=y
CONFIG_SR_MN_CN_MULTINET6_QUANT=y
CONFIG_SR_MN_EN_NONE=y

CONFIG_SPIRAM=y
CONFIG_SPIRAM_SPEED_80M=y
CONFIG_SPIRAM_TRY_ALLOCATE_WIFI_LWIP=y
CONFIG_SPIRAM_ALLOW_STACK_EXTERNAL_MEMORY=y
CONFIG_SPIRAM_MALLOC_ALWAYSINTERNAL=1024
CONFIG_SPIRAM_MODE_OCT=y
CONFIG_SPIRAM_TYPE_AUTO=y
```

## elements/test_apps/sdkconfig.defaults.esp32
```kconfig
CONFIG_ESPTOOLPY_FLASHSIZE_8MB=y
CONFIG_ESPTOOLPY_FLASHSIZE="8MB"

#
# Partition Table
#
CONFIG_PARTITION_TABLE_CUSTOM=y
CONFIG_PARTITION_TABLE_CUSTOM_FILENAME="partitions_8m.csv"
CONFIG_PARTITION_TABLE_FILENAME="partitions_8m.csv"
CONFIG_PARTITION_TABLE_OFFSET=0xA000
CONFIG_PARTITION_TABLE_MD5=y
# end of Partition Table
```

## elements/test_apps/sdkconfig.defaults.esp32c3
```kconfig
#
# ESP Speech Recognition
#
CONFIG_AFE_INTERFACE_V1=y
CONFIG_SR_NSN_WEBRTC=y
CONFIG_SR_VADN_WEBRTC=y

#
# Load Multiple Wake Words
#
CONFIG_SR_WN_WN9S_HILEXIN=y
# CONFIG_SR_WN_WN9S_HIESP is not set
# CONFIG_SR_WN_WN9S_NIHAOXIAOZHI is not set
# CONFIG_SR_WN_WN9S_HIJASON is not set
# end of Load Multiple Wake Words

CONFIG_SR_MN_CN_NONE=y
CONFIG_SR_MN_EN_NONE=y
# end of ESP Speech Recognition
```

## elements/test_apps/sdkconfig.defaults.esp32c5
```kconfig
#
# ESP Speech Recognition
#
CONFIG_AFE_INTERFACE_V1=y
CONFIG_SR_NSN_WEBRTC=y
CONFIG_SR_VADN_WEBRTC=y

#
# Load Multiple Wake Words
#
CONFIG_SR_WN_WN9S_HILEXIN=y
# CONFIG_SR_WN_WN9S_HIESP is not set
# CONFIG_SR_WN_WN9S_NIHAOXIAOZHI is not set
# CONFIG_SR_WN_WN9S_HIJASON is not set
# end of Load Multiple Wake Words

CONFIG_SR_MN_CN_NONE=y
CONFIG_SR_MN_EN_NONE=y
# end of ESP Speech Recognition

CONFIG_GMF_AI_AUDIO_INIT_WN=y

CONFIG_ESP_CONSOLE_USB_SERIAL_JTAG=y
```

## elements/test_apps/sdkconfig.defaults.esp32s3
```kconfig
CONFIG_IDF_TARGET="esp32s3"

CONFIG_ESPTOOLPY_FLASHFREQ_80M=y
CONFIG_ESPTOOLPY_FLASHFREQ="80m"
# CI ESP32-S3 runners use 8MB flash (see esptool "available flash size of 8MB")
CONFIG_ESPTOOLPY_FLASHSIZE_8MB=y
CONFIG_ESPTOOLPY_FLASHSIZE="8MB"

#
# Partition Table
#
CONFIG_PARTITION_TABLE_CUSTOM=y
CONFIG_PARTITION_TABLE_CUSTOM_FILENAME="partitions_8m.csv"
CONFIG_PARTITION_TABLE_FILENAME="partitions_8m.csv"
CONFIG_PARTITION_TABLE_OFFSET=0xA000
CONFIG_PARTITION_TABLE_MD5=y
# end of Partition Table

CONFIG_SPIRAM_SPEED_80M=y
CONFIG_SPIRAM_TRY_ALLOCATE_WIFI_LWIP=y
CONFIG_SPIRAM_ALLOW_STACK_EXTERNAL_MEMORY=y
CONFIG_SPIRAM_MALLOC_ALWAYSINTERNAL=1024
CONFIG_SPIRAM_MODE_OCT=y
CONFIG_SPIRAM_TYPE_AUTO=y

CONFIG_ESP32S3_DEFAULT_CPU_FREQ_240=y
CONFIG_ESP32S3_INSTRUCTION_CACHE_32KB=y
CONFIG_ESP32S3_DATA_CACHE_LINE_64B=y
```
