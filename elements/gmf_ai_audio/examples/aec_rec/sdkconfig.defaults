## elements/test_apps/sdkconfig.defaults.esp32s31
```kconfig
CONFIG_IDF_TARGET="esp32s31"
CONFIG_IDF_TARGET_ESP32S31=y

CONFIG_ESPTOOLPY_FLASHFREQ_80M=y
CONFIG_ESPTOOLPY_FLASHFREQ="80m"
CONFIG_ESPTOOLPY_FLASHSIZE_16MB=y
CONFIG_ESPTOOLPY_FLASHSIZE="16MB"

#
# Partition Table
#
CONFIG_PARTITION_TABLE_CUSTOM=y
CONFIG_PARTITION_TABLE_CUSTOM_FILENAME="partitions_16m.csv"
CONFIG_PARTITION_TABLE_FILENAME="partitions_16m.csv"
CONFIG_PARTITION_TABLE_OFFSET=0xA000
CONFIG_PARTITION_TABLE_MD5=y
# end of Partition Table

CONFIG_SPIRAM_SPEED_80M=y
CONFIG_SPIRAM_TRY_ALLOCATE_WIFI_LWIP=y
CONFIG_SPIRAM_ALLOW_STACK_EXTERNAL_MEMORY=y
CONFIG_SPIRAM_MALLOC_ALWAYSINTERNAL=1024
CONFIG_SPIRAM_MODE_OCT=y
CONFIG_SPIRAM_TYPE_AUTO=y

# CONFIG_LOG_DEFAULT_LEVEL_DEBUG is not set
CONFIG_LOG_DEFAULT_LEVEL_INFO=y
CONFIG_LOG_DEFAULT_LEVEL=3
CONFIG_LOG_MAXIMUM_LEVEL_INFO=y
CONFIG_LOG_MAXIMUM_LEVEL=3
CONFIG_LOG_MAXIMUM_EQUALS_DEFAULT=y

# Register vid_ppa in gmf_loader pool (required by gmf_video_el_test on esp32s31)
CONFIG_GMF_VIDEO_EFFECTS_INIT_PPA=y
```

## gmf_examples/basic_examples/pipeline_howl/sdkconfig.defaults
```kconfig
#
# Serial flasher config
#
CONFIG_ESPTOOLPY_BEFORE_RESET=y
CONFIG_ESPTOOLPY_FLASHSIZE_4MB=y
CONFIG_ESPTOOLPY_FLASHFREQ_80M=y

#
# Partition Table
#
CONFIG_PARTITION_TABLE_SINGLE_APP=y
CONFIG_PARTITION_TABLE_CUSTOM=y
CONFIG_PARTITION_TABLE_CUSTOM_FILENAME="partitions.csv"
CONFIG_PARTITION_TABLE_FILENAME="partitions.csv"
CONFIG_PARTITION_TABLE_OFFSET=0xA000
CONFIG_PARTITION_TABLE_MD5=y

#
# Compiler options
#
CONFIG_COMPILER_OPTIMIZATION_PERF=y

#
# FreeRTOS
#
CONFIG_FREERTOS_HZ=1000
CONFIG_FREERTOS_ENABLE_BACKWARD_COMPATIBILITY=y

#
# ESP PSRAM
#
CONFIG_SPIRAM=y
CONFIG_SPIRAM_SPEED_80M=y
CONFIG_SPIRAM_TRY_ALLOCATE_WIFI_LWIP=y
CONFIG_FREERTOS_TASK_CREATE_ALLOW_EXT_MEM=y
CONFIG_SPIRAM_MALLOC_ALWAYSINTERNAL=128

#
# FAT Filesystem support
#
CONFIG_FATFS_LFN_HEAP=y

#
# GMF IO Reader
#
CONFIG_GMF_IO_INIT_CODEC_DEV_RX=y
CONFIG_GMF_IO_INIT_FILE_READER=y
CONFIG_GMF_IO_INIT_FLASH_READER=n
CONFIG_GMF_IO_INIT_HTTP_READER=n

#
# GMF IO Writer
#
CONFIG_GMF_IO_INIT_CODEC_DEV_TX=y
CONFIG_GMF_IO_INIT_FILE_WRITER=n
CONFIG_GMF_IO_INIT_HTTP_WRITER=n

#
# GMF Audio Codec (WAV only for embedded PCM)
#
CONFIG_GMF_AUDIO_CODEC_INIT_DECODER=y
CONFIG_GMF_AUDIO_CODEC_INIT_ENCODER=n
CONFIG_GMF_AUDIO_CODEC_DECODER_TYPE_WAV=y

#
# GMF Audio Effects: only HOWL (disable other defaults to reduce image size)
#
CONFIG_GMF_AUDIO_EFFECT_INIT_CH_CVT=y
CONFIG_GMF_AUDIO_EFFECT_INIT_BIT_CVT=y
CONFIG_GMF_AUDIO_EFFECT_INIT_RATE_CVT=y
CONFIG_GMF_AUDIO_EFFECT_INIT_MIXER=y
CONFIG_GMF_AUDIO_EFFECT_MIXER_SRC_NUM=2
CONFIG_GMF_AUDIO_EFFECT_MIXER_SRC_NUM=2
CONFIG_GMF_AUDIO_EFFECT_MIXER_SRC1_WEIGHT1=50
CONFIG_GMF_AUDIO_EFFECT_MIXER_SRC1_WEIGHT2=100
CONFIG_GMF_AUDIO_EFFECT_MIXER_SRC1_TRANSIT_TIME=100
CONFIG_GMF_AUDIO_EFFECT_MIXER_SRC2_WEIGHT1=50
CONFIG_GMF_AUDIO_EFFECT_MIXER_SRC2_WEIGHT2=100
CONFIG_GMF_AUDIO_EFFECT_MIXER_SRC2_TRANSIT_TIME=100

CONFIG_GMF_AUDIO_EFFECT_INIT_HOWL=y
CONFIG_GMF_AUDIO_EFFECT_HOWL_PAPR_X10=80
CONFIG_GMF_AUDIO_EFFECT_HOWL_PHPR_X10=450
CONFIG_GMF_AUDIO_EFFECT_HOWL_PNPR_X10=450
CONFIG_GMF_AUDIO_EFFECT_HOWL_IMSD_X10=50
CONFIG_GMF_AUDIO_EFFECT_HOWL_ENABLE_IMSD=y
```

## gmf_examples/basic_examples/pipeline_play_http_music/sdkconfig.defaults.esp32p4
```kconfig
#
# System Settings
#
CONFIG_ESP_DEFAULT_CPU_FREQ_MHZ_360=y

#
# SPI RAM config
#
CONFIG_IDF_EXPERIMENTAL_FEATURES=y
CONFIG_SPIRAM_SPEED_200M=y

#
# Wi-Fi Remote
#
CONFIG_SLAVE_IDF_TARGET_ESP32C6=y
CONFIG_ESP_WIFI_REMOTE_LIBRARY_HOSTED=y
CONFIG_EXAMPLE_CONNECT_WIFI=y

#
# Partition Table
#
CONFIG_PARTITION_TABLE_CUSTOM=y
CONFIG_PARTITION_TABLE_CUSTOM_FILENAME="partitions_8m.csv"
CONFIG_PARTITION_TABLE_FILENAME="partitions_8m.csv"
CONFIG_PARTITION_TABLE_OFFSET=0xA000
CONFIG_PARTITION_TABLE_MD5=y
# end of Partition Table

#
# Serial flasher config
#
CONFIG_ESPTOOLPY_FLASHFREQ_80M=y
CONFIG_ESPTOOLPY_FLASHSIZE_8MB=y
```

## gmf_examples/basic_examples/pipeline_record_audio_muxer/sdkconfig.defaults
```kconfig
CONFIG_FREERTOS_ENABLE_BACKWARD_COMPATIBILITY=y

#
# Serial flasher config
#
CONFIG_ESPTOOLPY_FLASHSIZE_4MB=y
CONFIG_ESPTOOLPY_FLASHFREQ_80M=y

#
# Partition Table
#
CONFIG_PARTITION_TABLE_SINGLE_APP=y
CONFIG_PARTITION_TABLE_CUSTOM=y
CONFIG_PARTITION_TABLE_CUSTOM_FILENAME="partitions.csv"
CONFIG_PARTITION_TABLE_FILENAME="partitions.csv"
CONFIG_PARTITION_TABLE_OFFSET=0x8000
CONFIG_PARTITION_TABLE_MD5=y

#
# Compiler options
#
CONFIG_COMPILER_OPTIMIZATION_PERF=y

#
# FreeRTOS
#
CONFIG_FREERTOS_HZ=1000
CONFIG_FREERTOS_ENABLE_BACKWARD_COMPATIBILITY=y

#
# ESP PSRAM
#
CONFIG_SPIRAM=y
CONFIG_SPIRAM_SPEED_80M=y
CONFIG_SPIRAM_TRY_ALLOCATE_WIFI_LWIP=y
CONFIG_SPIRAM_ALLOW_STACK_EXTERNAL_MEMORY=y
CONFIG_SPIRAM_MALLOC_ALWAYSINTERNAL=1024
CONFIG_SPIRAM_TYPE_AUTO=y

#
# FAT Filesystem support
#
CONFIG_FATFS_LFN_HEAP=y

#
# GMF IO Reader
#
CONFIG_GMF_IO_INIT_CODEC_DEV_RX=y
CONFIG_GMF_IO_INIT_FILE_READER=n
CONFIG_GMF_IO_INIT_FLASH_READER=n
CONFIG_GMF_IO_INIT_HTTP_READER=n

#
# GMF IO Writer
#
CONFIG_GMF_IO_INIT_FILE_WRITER=n
CONFIG_GMF_IO_INIT_CODEC_DEV_TX=n
CONFIG_GMF_IO_INIT_HTTP_WRITER=n

#
# GMF Audio Codec
#
CONFIG_GMF_AUDIO_CODEC_INIT_DECODER=n
CONFIG_GMF_AUDIO_CODEC_INIT_ENCODER=y
CONFIG_GMF_AUDIO_MUXER_INIT=y
CONFIG_GMF_AUDIO_MUXER_TYPE_MP4=y
CONFIG_GMF_AUDIO_MUXER_TYPE_TS=n
CONFIG_GMF_AUDIO_MUXER_TYPE_FLV=n
CONFIG_GMF_AUDIO_MUXER_TYPE_WAV=n
CONFIG_GMF_AUDIO_MUXER_TYPE_CAF=n
CONFIG_GMF_AUDIO_MUXER_TYPE_OGG=n

#
# GMF Audio Effects
#
CONFIG_GMF_AUDIO_EFFECT_INIT_ALC=n
CONFIG_GMF_AUDIO_EFFECT_INIT_CH_CVT=n
CONFIG_GMF_AUDIO_EFFECT_INIT_BIT_CVT=n
CONFIG_GMF_AUDIO_EFFECT_INIT_RATE_CVT=n
```

## packages/esp_audio_simple_player/Kconfig
```kconfig
menu "ESP Audio Simple Player"

    menu "Audio Simple Player IO Stream"
        config ESP_AUDIO_SIMPLE_PLAYER_HTTP_EN
            bool "Enable HTTP IO stream"
            default y
            help
                Include support for HTTP IO stream in the audio player.

        config ESP_AUDIO_SIMPLE_PLAYER_FILE_EN
            bool "Enable FILE IO stream"
            default y
            help
                Include support for FILE IO stream in the audio player.

        config ESP_AUDIO_SIMPLE_PLAYER_EMBED_FLASH_EN
            bool "Enable Embedded Flash IO stream"
            default y
            help
                Include support for Embedded Flash IO stream in the audio player.
    endmenu

    menu "Audio Simple Player Filters"

        config ESP_AUDIO_SIMPLE_PLAYER_RESAMPLE_EN
            bool "Enable resampling"
            default y
            help
                Allow the audio player to perform resampling of audio streams.

        if ESP_AUDIO_SIMPLE_PLAYER_RESAMPLE_EN

            config AUDIO_SIMPLE_PLAYER_RESAMPLE_DEST_RATE
                int "Destination sample rate for resampling"
                default 48000
                range 8000 96000
                help
                    Set the target sample rate for audio resampling.

        endif

        config ESP_AUDIO_SIMPLE_PLAYER_CH_CVT_EN
            bool "Enable channel conversion"
            default n
            help
                Allow the audio player to convert between different channel configurations (e.g., mono to stereo).

        if ESP_AUDIO_SIMPLE_PLAYER_CH_CVT_EN

            config AUDIO_SIMPLE_PLAYER_CH_CVT_DEST
                int "Target channel count for conversion"
                default 2
                range 1 2
                help
                    Set the target number of audio channels for conversion.

        endif

        config ESP_AUDIO_SIMPLE_PLAYER_BIT_CVT_EN
            bool "Enable bit depth conversion"
            default n
            help
                Allow the audio player to convert audio data between different bit depths (e.g., 16-bit to 24-bit).

        if ESP_AUDIO_SIMPLE_PLAYER_BIT_CVT_EN

            choice AUDIO_SIMPLE_PLAYER_BIT_CVT_CONFIG
                prompt "Destination bit depth for conversion"
                default AUDIO_SIMPLE_PLAYER_BIT_CVT_DEST_16BIT
                help
                    Choose the target bit depth for audio conversion.

                config AUDIO_SIMPLE_PLAYER_BIT_CVT_DEST_16BIT
                    bool "16-bit depth"

                config AUDIO_SIMPLE_PLAYER_BIT_CVT_DEST_24BIT
                    bool "24-bit depth"

                config AUDIO_SIMPLE_PLAYER_BIT_CVT_DEST_32BIT
                    bool "32-bit depth"
            endchoice

            config AUDIO_SIMPLE_PLAYER_BIT_CVT_DEST_BITS
                int
                default 16 if AUDIO_SIMPLE_PLAYER_BIT_CVT_DEST_16BIT
                default 24 if AUDIO_SIMPLE_PLAYER_BIT_CVT_DEST_24BIT
                default 32 if AUDIO_SIMPLE_PLAYER_BIT_CVT_DEST_32BIT

        endif

    endmenu

endmenu
```

## packages/esp_bt_audio/Kconfig
```kconfig
menu "ESP Bluetooth Audio"

config ESP_BT_AUDIO_GMF_IO_SUPPORT
    bool "Enable GMF IO Support"
    default n
    help
        Enable GMF IO support for ESP Bluetooth Audio.

config ESP_BT_AUDIO_LE_TX_QUEUE_DEPTH
    int "LE source TX queue depth"
    depends on BT_AUDIO && BT_ISO
    range 2 20
    default 10
    help
        Number of SDUs each LE source stream keeps in its host TX queue.
        Credits hold every member of a CIG or BIG at this depth, so they share
        the same host transmit latency (this many SDU intervals). Raise it if
        the encoder cannot keep up and underruns are heard, lower it for less
        latency.

menuconfig ESP_BT_AUDIO_MONITOR
    bool "Enable ESP Bluetooth Audio monitor features"
    default n
    help
        Enable configuration of ESP Bluetooth Audio monitor GPIO features.

if ESP_BT_AUDIO_MONITOR

config ESP_BT_AUDIO_LE_PLAYBACK_SYNC_MONITOR
    bool "Enable LE playback sync monitor"
    default n
    help
        Toggle a GPIO through ETM on each LE playback sync event.

config ESP_BT_AUDIO_LE_PLAYBACK_SYNC_MONITOR_GPIO
    int "LE playback sync monitor GPIO"
    range 0 48
    default 13
    depends on ESP_BT_AUDIO_LE_PLAYBACK_SYNC_MONITOR

config ESP_BT_AUDIO_LE_CLK_SYNC_MONITOR
    bool "Enable LE clock sync monitor"
    default n
    help
        Toggle a GPIO through ETM on each LE clock sync event.

config ESP_BT_AUDIO_LE_CLK_SYNC_MONITOR_GPIO
    int "LE clock sync monitor GPIO"
    range 0 48
    default 14
    depends on ESP_BT_AUDIO_LE_CLK_SYNC_MONITOR

config ESP_BT_AUDIO_LE_STREAM_MONITOR
    bool "Enable LE sink stream monitor"
    default n
    help
        Toggle a GPIO when a sink stream receives an ISO packet. The GPIO is
        initialized when the sink stream starts and driven low when it stops.

config ESP_BT_AUDIO_LE_STREAM_MONITOR_GPIO
    int "LE sink stream monitor GPIO"
    range 0 48
    default 15
    depends on ESP_BT_AUDIO_LE_STREAM_MONITOR

endif

endmenu
```
