## packages/esp_bt_audio/examples/bt_audio/main/Kconfig.projbuild
```kconfig
menu "BT Audio Basic Example (GMF)"

    config GMF_EXAMPLE_BT_DEVICE_NAME
        string "Bluetooth device name"
        default "ESP_BT_AUDIO"
        help
            Set the Bluetooth device name advertised by this example.

    config GMF_EXAMPLE_BT_DEVICE_NAME_APPEND_MAC
        bool "Append MAC address suffix to Bluetooth device name"
        default y
        help
            Append the last two bytes of the Bluetooth MAC address to the
            configured device name, for example esp_bt_audio_A1B2.

    menu "BT UI Configuration"

        config EXAMPLE_BT_UI_ENABLE
            bool "Enable LVGL UI"
            default y if IDF_TARGET_ESP32S31
            default n
            help
                Enable the on-device LVGL touch-screen UI (splash, media control,
                dialer, volume bar). Requires a board with LCD and touch
                support (e.g. ESP32-S31 Korvo1), as well as the LVGL, esp_lvgl_port,
                and esp_jpeg components in the project dependencies.

    endmenu

    config GMF_EXAMPLE_AUDIO_TECH_CLASSIC
        bool "Enable Classic Bluetooth"
        depends on BT_CLASSIC_ENABLED
        default y
        help
            Enable classic Bluetooth profile examples (A2DP/HFP/AVRCP/PBAP).

    menu "Classic Audio Roles Configuration"
        depends on BT_CLASSIC_ENABLED && GMF_EXAMPLE_AUDIO_TECH_CLASSIC

        choice
            prompt "A2DP role"
            depends on BT_A2DP_ENABLE
            default GMF_EXAMPLE_A2DP_SINK

        config GMF_EXAMPLE_A2DP_NONE
            bool "None"
            help
                Disable A2DP role

        config GMF_EXAMPLE_A2DP_SINK
            bool "A2DP Sink"
            help
                Enable A2DP Sink role

        config GMF_EXAMPLE_A2DP_SOURCE
            bool "A2DP Source"
            help
                Enable A2DP Source role

        endchoice

        choice
            prompt "HFP role"
            depends on BT_HFP_CLIENT_ENABLE || BT_HFP_AG_ENABLE
            default GMF_EXAMPLE_HFP_HF if BT_HFP_CLIENT_ENABLE
            default GMF_EXAMPLE_HFP_AG if BT_HFP_AG_ENABLE

        config GMF_EXAMPLE_HFP_NONE
            bool "None"
            help
                Disable HFP role

        config GMF_EXAMPLE_HFP_HF
            bool "HFP Handsfree"
            depends on BT_HFP_CLIENT_ENABLE
            help
                Enable HFP Handsfree role

        config GMF_EXAMPLE_HFP_AG
            bool "HFP Audio Gateway"
            depends on BT_HFP_AG_ENABLE
            help
                Enable HFP Audio Gateway role

        endchoice

        config GMF_EXAMPLE_AVRC_CT
            depends on BT_AVRCP_ENABLED
            bool "AVRC Controller"
            default y
            help
                Enable AVRC Controller role

        config GMF_EXAMPLE_AVRC_TG
            depends on BT_AVRCP_ENABLED
            bool "AVRC Target"
            default y
            help
                Enable AVRC Target role

        config GMF_EXAMPLE_PBAP_PCE
            depends on BT_PBAC_ENABLED && GMF_EXAMPLE_HFP_HF
            bool "Phone book client equipment"
            default n
            help
                Enable phone book client equipment role
    endmenu

    config GMF_EXAMPLE_AUDIO_TECH_LE
        bool "Enable LE Audio"
        depends on BT_AUDIO && BT_ISO
        default y
        help
            Enable LE Audio unicast server example flow. This option can be
            enabled together with Classic Bluetooth when the selected BT host
            and controller configuration support both technologies.

    menu "LE Audio Configuration"
        depends on GMF_EXAMPLE_AUDIO_TECH_LE

        choice
            prompt "LE Audio user case"
            default GMF_EXAMPLE_LE_USER_CASE_TMAP
            help
                Select the LE Audio user case used by the example.

        config GMF_EXAMPLE_LE_USER_CASE_TMAP
            bool "TMAP"
            help
                Enable the Telephony and Media Audio Profile user case.

        endchoice

        config GMF_EXAMPLE_LE_TMAP_ROLE_CT
            bool "TMAP call terminal role"
            depends on GMF_EXAMPLE_LE_USER_CASE_TMAP
            default y
            help
                Enable the TMAP Call Terminal role.

        config GMF_EXAMPLE_LE_TMAP_ROLE_UMR
            bool "TMAP unicast media receiver role"
            depends on GMF_EXAMPLE_LE_USER_CASE_TMAP
            default y
            help
                Enable the TMAP Unicast Media Receiver role.

        config GMF_EXAMPLE_LE_TMAP_ROLE_BMR
            bool "TMAP broadcast media receiver role"
            depends on GMF_EXAMPLE_LE_USER_CASE_TMAP
            default y
            help
                Enable the TMAP Broadcast Media Receiver role.

        config GMF_EXAMPLE_LE_TMAP_ROLE_BMS
            bool "TMAP broadcast media sender role"
            depends on GMF_EXAMPLE_LE_USER_CASE_TMAP && BT_BAP_BROADCAST_SOURCE
            default n
            help
                Enable the TMAP Broadcast Media Sender role. The example sends
                local microSD media files as an LC3 BIS broadcast source.

        config GMF_EXAMPLE_LE_BSRC_NAME
            string "LE Audio broadcast source name"
            depends on GMF_EXAMPLE_LE_TMAP_ROLE_BMS
            default "GMF_BIS_Source"
            help
                Set the Broadcast_Name field advertised by the BIS source.

        config GMF_EXAMPLE_LE_BSRC_CODE
            string "LE Audio broadcast code string (optional)"
            depends on GMF_EXAMPLE_LE_TMAP_ROLE_BMS
            default ""
            help
                Set the broadcast code as a plain string. The example copies up
                to 16 characters into the 16-byte Broadcast_Code field and pads
                the rest with zeros. Keep this empty to advertise an unencrypted
                broadcast.

        config GMF_EXAMPLE_LE_BSRC_STREAM_NUM
            int "LE Audio broadcast source stream count"
            depends on GMF_EXAMPLE_LE_TMAP_ROLE_BMS
            default 1
            range 1 2
            help
                Set the number of BIS source streams requested by the example.
                The esp_bt_audio component clamps this value to the ESP-IDF
                CONFIG_BT_BAP_BROADCAST_SRC_STREAM_COUNT limit.

        choice GMF_EXAMPLE_LE_LOCATION
            prompt "LE Audio location"
            default GMF_EXAMPLE_LE_LOCATION_FRONT_RIGHT

            config GMF_EXAMPLE_LE_LOCATION_FRONT_LEFT
                bool "Front left"
                help
                    Advertise the LE Audio front left location.

            config GMF_EXAMPLE_LE_LOCATION_FRONT_RIGHT
                bool "Front right"
                help
                    Advertise the LE Audio front right location.

            config GMF_EXAMPLE_LE_LOCATION_FRONT_LEFT_RIGHT
                bool "Front left and right"
                help
                    Advertise both LE Audio front left and front right locations.

        endchoice

        config GMF_EXAMPLE_LE_SOURCE_ENABLE
            bool "Enable LE Audio source capability"
            default y
            help
                Enable LE Audio source capability and source ASE count.

        config GMF_EXAMPLE_LE_COORDINATE_SET_SIZE
            int "LE Audio coordinate set size"
            default 2
            range 0 2
            help
                Set the CSIP coordinated set size advertised by the LE Audio example.

        config GMF_EXAMPLE_LE_COORDINATE_SET_RANK
            int
            default 1 if GMF_EXAMPLE_LE_LOCATION_FRONT_LEFT
            default 2 if GMF_EXAMPLE_LE_LOCATION_FRONT_RIGHT
            default 2 if GMF_EXAMPLE_LE_LOCATION_FRONT_LEFT_RIGHT
            default 2
            range 1 2
            help
                Set the CSIP rank for this set member based on the advertised location.

        config GMF_EXAMPLE_LE_CSIP_SIRK
            string "CSIP SIRK (16 hex bytes)"
            depends on GMF_EXAMPLE_LE_COORDINATE_SET_SIZE > 1
            default "b803aac6afbb65625a41f15305698f84"
            help
                CSIP Set Identity Resolving Key as 32 hex characters
                (representing 16 bytes). The default value matches the
                previously hardcoded SIRK.

        config GMF_EXAMPLE_LE_SCAN_TIMEOUT_MS
            int "Default LE scan timeout (ms)"
            default 10000
            range 1000 60000
            help
                Default timeout used by LE scan command.

    endmenu

endmenu
```

## packages/esp_bt_audio/examples/bt_audio/sdkconfig.defaults
```kconfig
#
# Bootloader config
#
CONFIG_BOOTLOADER_LOG_LEVEL_WARN=y

#
# Serial flasher config
#
CONFIG_ESPTOOLPY_FLASHFREQ_80M=y
CONFIG_ESPTOOLPY_FLASHFREQ="80m"

CONFIG_ESPTOOLPY_FLASHSIZE_4MB=y
CONFIG_ESPTOOLPY_FLASHSIZE="4MB"

#
# Partition Table
#
CONFIG_PARTITION_TABLE_CUSTOM=y
CONFIG_PARTITION_TABLE_CUSTOM_FILENAME="partitions.csv"
CONFIG_PARTITION_TABLE_FILENAME="partitions.csv"
CONFIG_PARTITION_TABLE_OFFSET=0xA000
# end of Partition Table

#
# FreeRTOS
#
CONFIG_FREERTOS_HZ=1000
CONFIG_FREERTOS_TASK_CREATE_ALLOW_EXT_MEM=y
# end of Kernel

CONFIG_ESP_BT_AUDIO_GMF_IO_SUPPORT=y

CONFIG_SPIRAM=y

#
# Bluetooth: place host/controller allocations in PSRAM when available
#
CONFIG_BT_ALLOCATION_FROM_SPIRAM_FIRST=y
CONFIG_BT_BLUEDROID_TASK_STACK_IN_EXT_MEM=y
CONFIG_BT_BLUEDROID_BTU_TASK_STACK_IN_EXT_MEM=y
CONFIG_BT_BLUEDROID_HCI_TASK_STACK_IN_EXT_MEM=y
CONFIG_BT_BLE_DYNAMIC_ENV_MEMORY=y
CONFIG_BT_CTRL_ALLOW_MALLOC_FROM_SPIRAM=y
CONFIG_BT_ISO_BSS_SEG_EXTERNAL_MEMORY=y
CONFIG_BT_ISO_HEAP_EXTERNAL_MEMORY=y
CONFIG_BT_AUDIO_BSS_SEG_EXTERNAL_MEMORY=y
CONFIG_BT_AUDIO_HEAP_EXTERNAL_MEMORY=y

CONFIG_COMPILER_OPTIMIZATION_PERF=y
```

## packages/esp_bt_audio/examples/bt_audio/sdkconfig.defaults.esp32s31.bluedroid
```kconfig
#
# Default sdkconfig for esp32s31: BlueDroid host with Classic BT + LE Audio.
#
# To use, override SDKCONFIG_DEFAULTS before set-target/build:
#     export SDKCONFIG_DEFAULTS=sdkconfig.defaults.esp32s31.bluedroid
#

#
# Serial flasher config
#
CONFIG_ESPTOOLPY_FLASHFREQ_80M=y
CONFIG_ESPTOOLPY_FLASHFREQ="80m"

CONFIG_FLASHMODE_QIO=y
CONFIG_ESPTOOLPY_FLASHMODE_QIO=y

CONFIG_ESPTOOLPY_FLASHSIZE_16MB=y
CONFIG_ESPTOOLPY_FLASHSIZE="16MB"

#
# Partition Table
#
CONFIG_PARTITION_TABLE_CUSTOM=y
CONFIG_PARTITION_TABLE_CUSTOM_FILENAME="partitions_esp32s31.csv"
CONFIG_PARTITION_TABLE_FILENAME="partitions_esp32s31.csv"
CONFIG_PARTITION_TABLE_OFFSET=0xA000
# end of Partition Table

#
# Bluetooth (Classic + LE Audio via BlueDroid)
#
CONFIG_BT_ENABLED=y
CONFIG_BT_BLUEDROID_ENABLED=y
# CONFIG_BT_NIMBLE_ENABLED is not set
# CONFIG_BT_CONTROLLER_ONLY is not set
CONFIG_BT_CONTROLLER_ENABLED=y
# CONFIG_BT_CONTROLLER_DISABLED is not set
CONFIG_BTDM_CTRL_BR_EDR_MAX_SYNC_CONN=1
CONFIG_BT_ALLOCATION_FROM_SPIRAM_FIRST=y
CONFIG_BT_BLE_DYNAMIC_ENV_MEMORY=y

#
# Bluedroid Options
#
CONFIG_BT_CLASSIC_ENABLED=y
CONFIG_BT_ENC_KEY_SIZE_CTRL_VSC=y
# CONFIG_BT_CLASSIC_BQB_ENABLED is not set
CONFIG_BT_A2DP_ENABLE=y
CONFIG_BT_A2DP_USE_EXTERNAL_CODEC=y
CONFIG_BT_AVRCP_ENABLED=y

#
# AVRCP Features
#
CONFIG_BT_AVRCP_CT_COVER_ART_ENABLED=y
# end of AVRCP Features

CONFIG_BT_HFP_ENABLE=y
CONFIG_BT_HFP_CLIENT_ENABLE=y
CONFIG_BT_HFP_AG_ENABLE=y
# CONFIG_BT_HFP_AUDIO_DATA_PATH_PCM is not set
CONFIG_BT_HFP_AUDIO_DATA_PATH_HCI=y
CONFIG_BT_HFP_USE_EXTERNAL_CODEC=y
CONFIG_BT_PBAC_ENABLED=y
CONFIG_GMF_EXAMPLE_PBAP_PCE=y

#
# BLE Options
#
CONFIG_BT_BLE_ENABLED=y
CONFIG_BT_BLE_50_FEATURES_SUPPORTED=y
CONFIG_BT_ACL_CONNECTIONS=1
CONFIG_BT_GATT_MAX_SR_PROFILES=12
CONFIG_BT_GATTC_NOTIF_REG_MAX=64
CONFIG_BT_BLE_FEAT_ISO_EN=y
CONFIG_BT_BLE_FEAT_PERIODIC_ADV_SYNC_TRANSFER=y

#
# Controller Options
#
CONFIG_BTDM_CTRL_MODE_BTDM=y
# end of Controller Options

#
# LE Audio profiles
#
CONFIG_BT_LE_ISO_SUPPORT=y
CONFIG_BT_ISO_MAX_CHAN=2

CONFIG_BT_TMAP=y
CONFIG_BT_CAP_INITIATOR=y
CONFIG_BT_CAP_ACCEPTOR=y
CONFIG_BT_CAP_ACCEPTOR_SET_MEMBER=y
CONFIG_BT_ASCS_MAX_ASE_SNK_COUNT=2
CONFIG_BT_ASCS_MAX_ASE_SRC_COUNT=2
CONFIG_BT_ASCS_MAX_ACTIVE_ASES=2
CONFIG_BT_BAP_UNICAST_SERVER=y
CONFIG_BT_BAP_BROADCAST_SOURCE=y
CONFIG_BT_BAP_BROADCAST_SRC_SUBGROUP_COUNT=1
CONFIG_BT_BAP_BROADCAST_SRC_COUNT=1
CONFIG_BT_BAP_BROADCAST_SRC_STREAM_COUNT=1
CONFIG_BT_BAP_BROADCAST_SINK=y
CONFIG_BT_BAP_BROADCAST_SNK_SUBGROUP_COUNT=1
CONFIG_BT_BAP_BROADCAST_SNK_COUNT=1
CONFIG_BT_BAP_BROADCAST_SNK_STREAM_COUNT=2
CONFIG_BT_BAP_SCAN_DELEGATOR=y
CONFIG_BT_BAP_SCAN_DELEGATOR_RECV_STATE_COUNT=1
CONFIG_BT_BAP_SCAN_DELEGATOR_BUF_TIMEOUT=50
CONFIG_BT_PAC_SNK_NOTIFIABLE=y
CONFIG_BT_PAC_SNK_LOC_WRITEABLE=y
CONFIG_BT_PAC_SNK_LOC_NOTIFIABLE=y
CONFIG_BT_PAC_SRC_NOTIFIABLE=y
CONFIG_BT_PAC_SRC_LOC_WRITEABLE=y
CONFIG_BT_PAC_SRC_LOC_NOTIFIABLE=y
CONFIG_BT_PACS_SUPPORTED_CONTEXT_NOTIFIABLE=y
CONFIG_BT_VCP_VOL_REND=y
CONFIG_BT_AICS_MAX_INSTANCE_COUNT=1
CONFIG_BT_AICS=y
CONFIG_BT_VCP_VOL_REND_VOCS_INSTANCE_COUNT=1
CONFIG_BT_VCP_VOL_REND_VOCS=y
CONFIG_BT_VCP_VOL_REND_AICS_INSTANCE_COUNT=1
CONFIG_BT_VCP_VOL_REND_AICS=y
CONFIG_BT_VCP_VOL_REND_VOL_FLAGS_NOTIFIABLE=y
CONFIG_BT_VOCS_MAX_INSTANCE_COUNT=1
CONFIG_BT_VOCS=y
CONFIG_BT_MCC=y
CONFIG_BT_MCC_OTS=y
CONFIG_BT_CSIP_SET_MEMBER=y
CONFIG_BT_CSIP_SET_MEMBER_ENC_SIRK_SUPPORT=y
CONFIG_BT_CSIP_SET_MEMBER_MAX_INSTANCE_COUNT=1
CONFIG_BT_TBS_CLIENT_GTBS=y
CONFIG_BT_TBS_CLIENT_TBS=y
CONFIG_BT_TBS_CLIENT_CCID=y
CONFIG_BT_TBS_CLIENT_ORIGINATE_CALL=y
CONFIG_BT_TBS_CLIENT_TERMINATE_CALL=y
CONFIG_BT_TBS_CLIENT_HOLD_CALL=y
CONFIG_BT_TBS_CLIENT_RETRIEVE_CALL=y
CONFIG_BT_TBS_CLIENT_BEARER_URI_SCHEMES_SUPPORTED_LIST=y
CONFIG_BT_AUDIO_CODEC_CFG_MAX_METADATA_SIZE=128
# end of Bluetooth

#
# FreeRTOS
#
CONFIG_FREERTOS_HZ=1000
# end of Kernel

CONFIG_ESP_BT_AUDIO_GMF_IO_SUPPORT=y

CONFIG_SPIRAM=y
CONFIG_SPIRAM_XIP_FROM_PSRAM=y
CONFIG_SPIRAM_MALLOC_ALWAYSINTERNAL=0
CONFIG_SPIRAM_TRY_ALLOCATE_WIFI_LWIP=y
CONFIG_SPIRAM_ALLOW_BSS_SEG_EXTERNAL_MEMORY=y
CONFIG_SPIRAM_ALLOW_NOINIT_SEG_EXTERNAL_MEMORY=y

#
# Board display / touch (required when CONFIG_EXAMPLE_BT_UI_ENABLE=y)
#
CONFIG_ESP_BOARD_DEV_DISPLAY_LCD_SUPPORT=y
CONFIG_ESP_BOARD_DEV_LCD_TOUCH_SUPPORT=y
CONFIG_ESP_BOARD_DEV_DISPLAY_LCD_SUB_RGB_SUPPORT=y
CONFIG_ESP_BOARD_DEV_LCD_TOUCH_SUB_I2C_SUPPORT=y
CONFIG_ESP_BOARD_DEV_LCD_TOUCH_I2C_SUPPORT=y

#
# LVGL (required when CONFIG_EXAMPLE_BT_UI_ENABLE=y)
#
CONFIG_LV_CONF_SKIP=y
CONFIG_LV_USE_CLIB_MALLOC=y
CONFIG_LV_COLOR_DEPTH_16=y
CONFIG_LV_COLOR_DEPTH=16
# CONFIG_LV_BUILD_EXAMPLES is not set
# CONFIG_LV_BUILD_DEMOS is not set
# CONFIG_LV_FONT_MONTSERRAT_14 is not set
CONFIG_LV_FONT_MONTSERRAT_28=y
CONFIG_LV_FONT_MONTSERRAT_32=y
CONFIG_LV_FONT_FMT_TXT_LARGE=y
CONFIG_LV_FONT_CUSTOM_DECLARE="LV_FONT_DECLARE(lv_font_notosanssc_regular_28)"
CONFIG_LV_FONT_DEFAULT_CUSTOM=y
CONFIG_LV_USE_LABEL=y
CONFIG_LV_USE_BUTTON=y
CONFIG_LV_USE_TABVIEW=y
CONFIG_LV_USE_LIST=y
CONFIG_LV_USE_CANVAS=y
CONFIG_LV_USE_IMAGE=y
CONFIG_LV_USE_FLEX=y
CONFIG_LV_USE_GRID=y
```
